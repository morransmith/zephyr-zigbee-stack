## Kconfig
```kconfig
# SPDX-License-Identifier: Apache-2.0

menuconfig ZZB
	bool "Zigbee stack"
	select NET_BUF
	select HWINFO
	select CRC
	select PSA_CRYPTO
	select PSA_WANT_KEY_TYPE_AES
	select PSA_WANT_ALG_ECB_NO_PADDING
	select PSA_WANT_ALG_CCM
	help
	  Zigbee PRO R22 stack with Base Device Behavior 3.0.1 and ZCL rev 8.

if ZZB

config ZZB_NODE_COUNT
	int "Maximum number of nodes"
	default 1

config ZZB_BUF_COUNT
	int "Frame buffers shared by all nodes"
	default 16

config ZZB_WORKQ_STACK_SIZE
	int "Stack thread stack size"
	default 4096
	help
	  The thread uses up to 2568 bytes on ESP32-H2, measured with an
	  application callback that calls printk().

config ZZB_WORKQ_PRIORITY
	int "Stack thread cooperative priority"
	default 8

config ZZB_KEY_CACHE_SIZE
	int "PSA keys imported at a time"
	default 4
	help
	  Entries of the PSA key cache shared by all nodes. Each entry holds one
	  PSA key slot.

config ZZB_MAC
	bool "MAC layer"
	default y
	depends on IEEE802154_RAW_MODE || NET_L2_CUSTOM_IEEE802154
	help
	  IEEE 802.15.4 MAC sublayer. Tests that fake the MAC turn it off.

config ZZB_NWK
	bool "NWK layer"
	default ZZB_MAC
	select SETTINGS
	help
	  Zigbee network layer. The application enables a settings backend for the
	  frame counter. Tests that fake NWK turn it off.

config ZZB_APS
	bool "APS sublayer"
	default ZZB_NWK
	select SETTINGS
	help
	  Zigbee application support sublayer. The application enables a settings
	  backend for the link keys and the frame counter. Tests that fake APS turn
	  it off.

config ZZB_APS_TX_COUNT
	int "APS transmissions in progress"
	range 1 32
	default 4
	help
	  Entries of the APS transmission table. Each APSDE-DATA.request takes
	  one until its confirm.

config ZZB_APS_DUP_COUNT
	int "APS duplicate rejection table entries"
	range 1 255
	default 8

config ZZB_APS_KEY_PAIR_COUNT
	int "Key-pair table entries"
	default 1
	help
	  Entries of apsDeviceKeyPairSet. An end device shares a link key only
	  with the trust center.

config ZZB_APS_BINDING_COUNT
	int "Binding table entries"
	range 1 255
	default 8
	help
	  Entries of apsBindingTable. ZDO Bind_req adds them, and APSDE-DATA
	  with binding sends to them.

config ZZB_APS_GROUP_COUNT
	int "Group table entries"
	range 1 255
	default 8
	help
	  Entries of apsGroupTable, one per group and endpoint. BDB 6.6 asks
	  for at least 8 memberships on a node that is not a sleepy end device.

config ZZB_ZDO
	bool "ZDO"
	default ZZB_APS
	help
	  Zigbee device object: the ZDO server, the ZDO client and the processing
	  of the APS key indications. Tests that fake ZDO turn it off.

config ZZB_BDB
	bool "BDB"
	default ZZB_ZDO
	help
	  Base Device Behavior: initialization, network steering, the trust
	  center link key exchange and the resets. Tests that fake BDB turn it
	  off.

config ZZB_ZCL
	bool "ZCL"
	default ZZB_BDB
	select SETTINGS
	help
	  Zigbee Cluster Library: the foundation commands and the Basic,
	  Identify and On/Off servers on the application endpoints. The
	  application enables a settings backend for the non-volatile
	  attributes. Tests that fake ZCL turn it off.

config ZZB_BDB_PRIMARY_CHANNELS
	hex "bdbPrimaryChannelSet"
	range 0 0x07fff800
	default 0x02108800
	help
	  Channels that network steering scans first, bit n for channel n. The
	  default holds channels 11, 15, 20 and 25 (BDB 5.3.8).

config ZZB_BDB_SECONDARY_CHANNELS
	hex "bdbSecondaryChannelSet"
	range 0 0x07fff800
	default 0x05ef7000
	help
	  Channels that network steering scans when it finds no network on the
	  primary channels. The default holds the other channels of 11 to 26.

config ZZB_ZDO_TRANSACTION_COUNT
	int "ZDO client transactions"
	range 1 32
	default 4
	help
	  Requests of the ZDO client that wait for their response at the same
	  time.

config ZZB_FRAME_COUNTER_JUMP
	int "Outgoing frame counter jump at boot"
	default 1024
	help
	  Distance between the outgoing frame counter and its saved watermark.
	  On boot the counter starts at the watermark, which moves by this value.

config ZZB_NEIGHBOR_COUNT
	int "Neighbor table entries"
	default 16

config ZZB_NWK_NETWORK_COUNT
	int "Networks reported by a network discovery"
	default 8

config ZZB_NWK_ED_TIMEOUT
	int "Requested Timeout Enumeration of the End Device Timeout Request"
	range 0 14
	default 8
	help
	  0 is 10 seconds, n from 1 to 14 is 2^n minutes. The default 8 is
	  nwkEndDeviceTimeoutDefault, 256 minutes.

config ZZB_NWK_PARENT_FAILURES
	int "Failed transmissions to the parent before a parent link failure"
	range 1 255
	default 3
	help
	  Consecutive frames and polls without an ACK from the parent, after
	  the MAC retries, before NLME-NWK-STATUS.indication reports parent
	  link failure.

endif # ZZB
```

## samples/ballast/Kconfig
```kconfig
# SPDX-License-Identifier: Apache-2.0

mainmenu "zzb ballast sample"

rsource "../common/Kconfig"

choice SAMPLE_BALLAST
	prompt "Device type"

config SAMPLE_ON_OFF_BALLAST
	bool "On/Off Ballast (0x0108)"

config SAMPLE_DIMMABLE_BALLAST
	bool "Dimmable Ballast (0x0109)"

endchoice

config SAMPLE_MODEL_ID
	string
	default "on_off_ballast" if SAMPLE_ON_OFF_BALLAST
	default "dimmable_ballast" if SAMPLE_DIMMABLE_BALLAST

source "Kconfig.zephyr"
```

## samples/ballast/sample.yaml
```yaml
# SPDX-License-Identifier: Apache-2.0

sample:
  name: zzb ballast
common:
  build_only: true
  platform_allow:
    - nrf52840dk/nrf52840
    - esp32c6_devkitc/esp32c6/hpcore
    - esp32h2_devkitm/esp32h2
  integration_platforms:
    - nrf52840dk/nrf52840
tests:
  sample.zzb.ballast.on_off_ballast:
    extra_configs:
      - CONFIG_SAMPLE_ON_OFF_BALLAST=y
  sample.zzb.ballast.dimmable_ballast:
    extra_configs:
      - CONFIG_SAMPLE_DIMMABLE_BALLAST=y
```

## samples/common/Kconfig
```kconfig
# SPDX-License-Identifier: Apache-2.0

config SAMPLE_SLEEPY
	bool
	help
	  The device type runs on a battery, so the node is a sleepy end
	  device.
```

## samples/controller/Kconfig
```kconfig
# SPDX-License-Identifier: Apache-2.0

mainmenu "zzb controller sample"

rsource "../common/Kconfig"

choice SAMPLE_CONTROLLER
	prompt "Device type"

config SAMPLE_SCENE_SELECTOR
	bool "Scene Selector (0x0004)"
	select SAMPLE_SLEEPY
	select SAMPLE_GROUPS
	select SAMPLE_SCENES

config SAMPLE_CONFIGURATION_TOOL
	bool "Configuration Tool (0x0005)"
	select SAMPLE_GROUPS

config SAMPLE_REMOTE_CONTROL
	bool "Remote Control (0x0006)"
	select SAMPLE_SLEEPY
	select SAMPLE_GROUPS
	select SAMPLE_ON_OFF
	select SAMPLE_LEVEL
	select SAMPLE_COLOR

config SAMPLE_COMBINED_INTERFACE
	bool "Combined Interface (0x0007)"
	select SAMPLE_GROUPS
	select SAMPLE_SCENES
	select SAMPLE_ON_OFF
	select SAMPLE_LEVEL
	select SAMPLE_COLOR

config SAMPLE_COLOR_CONTROLLER
	bool "Color Controller (0x0800)"
	select SAMPLE_SLEEPY
	select SAMPLE_GROUPS
	select SAMPLE_ON_OFF
	select SAMPLE_LEVEL
	select SAMPLE_COLOR

config SAMPLE_COLOR_SCENE_CONTROLLER
	bool "Color Scene Controller (0x0810)"
	select SAMPLE_SLEEPY
	select SAMPLE_GROUPS
	select SAMPLE_SCENES
	select SAMPLE_ON_OFF
	select SAMPLE_LEVEL
	select SAMPLE_COLOR

config SAMPLE_NON_COLOR_CONTROLLER
	bool "Non-Color Controller (0x0820)"
	select SAMPLE_SLEEPY
	select SAMPLE_GROUPS
	select SAMPLE_ON_OFF
	select SAMPLE_LEVEL

config SAMPLE_NON_COLOR_SCENE_CONTROLLER
	bool "Non-Color Scene Controller (0x0830)"
	select SAMPLE_SLEEPY
	select SAMPLE_GROUPS
	select SAMPLE_SCENES
	select SAMPLE_ON_OFF
	select SAMPLE_LEVEL

config SAMPLE_CONTROL_BRIDGE
	bool "Control Bridge (0x0840)"
	select SAMPLE_GROUPS
	select SAMPLE_SCENES
	select SAMPLE_ON_OFF
	select SAMPLE_LEVEL
	select SAMPLE_COLOR
	select SAMPLE_SENSING

config SAMPLE_ON_OFF_SENSOR
	bool "On/Off Sensor (0x0850)"
	select SAMPLE_SLEEPY
	select SAMPLE_ON_OFF

endchoice

config SAMPLE_GROUPS
	bool

config SAMPLE_SCENES
	bool

config SAMPLE_ON_OFF
	bool

config SAMPLE_LEVEL
	bool

config SAMPLE_COLOR
	bool

# Clients of Illuminance Measurement, Illuminance Level Sensing and Occupancy Sensing
config SAMPLE_SENSING
	bool

config SAMPLE_MODEL_ID
	string
	default "scene_selector" if SAMPLE_SCENE_SELECTOR
	default "configuration_tool" if SAMPLE_CONFIGURATION_TOOL
	default "remote_control" if SAMPLE_REMOTE_CONTROL
	default "combined_interface" if SAMPLE_COMBINED_INTERFACE
	default "color_controller" if SAMPLE_COLOR_CONTROLLER
	default "color_scene_controller" if SAMPLE_COLOR_SCENE_CONTROLLER
	default "non_color_controller" if SAMPLE_NON_COLOR_CONTROLLER
	default "non_color_scene_controller" if SAMPLE_NON_COLOR_SCENE_CONTROLLER
	default "control_bridge" if SAMPLE_CONTROL_BRIDGE
	default "on_off_sensor" if SAMPLE_ON_OFF_SENSOR

source "Kconfig.zephyr"
```

## samples/controller/sample.yaml
```yaml
# SPDX-License-Identifier: Apache-2.0

sample:
  name: zzb controller
common:
  build_only: true
  platform_allow:
    - nrf52840dk/nrf52840
    - esp32c6_devkitc/esp32c6/hpcore
    - esp32h2_devkitm/esp32h2
  integration_platforms:
    - nrf52840dk/nrf52840
tests:
  sample.zzb.controller.scene_selector:
    extra_configs:
      - CONFIG_SAMPLE_SCENE_SELECTOR=y
  sample.zzb.controller.configuration_tool:
    extra_configs:
      - CONFIG_SAMPLE_CONFIGURATION_TOOL=y
  sample.zzb.controller.remote_control:
    extra_configs:
      - CONFIG_SAMPLE_REMOTE_CONTROL=y
  sample.zzb.controller.combined_interface:
    extra_configs:
      - CONFIG_SAMPLE_COMBINED_INTERFACE=y
  sample.zzb.controller.color_controller:
    extra_configs:
      - CONFIG_SAMPLE_COLOR_CONTROLLER=y
  sample.zzb.controller.color_scene_controller:
    extra_configs:
      - CONFIG_SAMPLE_COLOR_SCENE_CONTROLLER=y
  sample.zzb.controller.non_color_controller:
    extra_configs:
      - CONFIG_SAMPLE_NON_COLOR_CONTROLLER=y
  sample.zzb.controller.non_color_scene_controller:
    extra_configs:
      - CONFIG_SAMPLE_NON_COLOR_SCENE_CONTROLLER=y
  sample.zzb.controller.control_bridge:
    extra_configs:
      - CONFIG_SAMPLE_CONTROL_BRIDGE=y
  sample.zzb.controller.on_off_sensor:
    extra_configs:
      - CONFIG_SAMPLE_ON_OFF_SENSOR=y
```

## samples/covering/Kconfig
```kconfig
# SPDX-License-Identifier: Apache-2.0

mainmenu "zzb covering sample"

rsource "../common/Kconfig"

choice SAMPLE_COVERING
	prompt "Device type"

config SAMPLE_WINDOW_COVERING
	bool "Window Covering (0x0202)"

config SAMPLE_WINDOW_COVERING_CONTROLLER
	bool "Window Covering Controller (0x0203)"
	select SAMPLE_SLEEPY

endchoice

config SAMPLE_MODEL_ID
	string
	default "window_covering" if SAMPLE_WINDOW_COVERING
	default "window_covering_controller" if SAMPLE_WINDOW_COVERING_CONTROLLER

source "Kconfig.zephyr"
```

## samples/covering/sample.yaml
```yaml
# SPDX-License-Identifier: Apache-2.0

sample:
  name: zzb covering
common:
  build_only: true
  platform_allow:
    - nrf52840dk/nrf52840
    - esp32c6_devkitc/esp32c6/hpcore
    - esp32h2_devkitm/esp32h2
  integration_platforms:
    - nrf52840dk/nrf52840
tests:
  sample.zzb.covering.window_covering:
    extra_configs:
      - CONFIG_SAMPLE_WINDOW_COVERING=y
  sample.zzb.covering.window_covering_controller:
    extra_configs:
      - CONFIG_SAMPLE_WINDOW_COVERING_CONTROLLER=y
```

## samples/door_lock/Kconfig
```kconfig
# SPDX-License-Identifier: Apache-2.0

mainmenu "zzb door_lock sample"

rsource "../common/Kconfig"

choice SAMPLE_DOOR_LOCK_FAMILY
	prompt "Device type"

config SAMPLE_DOOR_LOCK
	bool "Door Lock (0x000a)"

config SAMPLE_DOOR_LOCK_CONTROLLER
	bool "Door Lock Controller (0x000b)"
	select SAMPLE_SLEEPY

endchoice

config SAMPLE_MODEL_ID
	string
	default "door_lock" if SAMPLE_DOOR_LOCK
	default "door_lock_controller" if SAMPLE_DOOR_LOCK_CONTROLLER

source "Kconfig.zephyr"
```

## samples/door_lock/sample.yaml
```yaml
# SPDX-License-Identifier: Apache-2.0

sample:
  name: zzb door_lock
common:
  build_only: true
  platform_allow:
    - nrf52840dk/nrf52840
    - esp32c6_devkitc/esp32c6/hpcore
    - esp32h2_devkitm/esp32h2
  integration_platforms:
    - nrf52840dk/nrf52840
tests:
  sample.zzb.door_lock.door_lock:
    extra_configs:
      - CONFIG_SAMPLE_DOOR_LOCK=y
  sample.zzb.door_lock.door_lock_controller:
    extra_configs:
      - CONFIG_SAMPLE_DOOR_LOCK_CONTROLLER=y
```

## samples/hvac/Kconfig
```kconfig
# SPDX-License-Identifier: Apache-2.0

mainmenu "zzb hvac sample"

rsource "../common/Kconfig"

choice SAMPLE_HVAC
	prompt "Device type"

config SAMPLE_THERMOSTAT
	bool "Thermostat (0x0301)"

config SAMPLE_HEATING_COOLING_UNIT
	bool "Heating/Cooling Unit (0x0300)"

config SAMPLE_AIR_PURIFIER
	bool "Air Purifier (0x0308)"

endchoice

config SAMPLE_MODEL_ID
	string
	default "thermostat" if SAMPLE_THERMOSTAT
	default "heating_cooling_unit" if SAMPLE_HEATING_COOLING_UNIT
	default "air_purifier" if SAMPLE_AIR_PURIFIER

source "Kconfig.zephyr"
```

## samples/hvac/sample.yaml
```yaml
# SPDX-License-Identifier: Apache-2.0

sample:
  name: zzb hvac
common:
  build_only: true
  platform_allow:
    - nrf52840dk/nrf52840
    - esp32c6_devkitc/esp32c6/hpcore
    - esp32h2_devkitm/esp32h2
  integration_platforms:
    - nrf52840dk/nrf52840
tests:
  sample.zzb.hvac.thermostat:
    extra_configs:
      - CONFIG_SAMPLE_THERMOSTAT=y
  sample.zzb.hvac.heating_cooling_unit:
    extra_configs:
      - CONFIG_SAMPLE_HEATING_COOLING_UNIT=y
  sample.zzb.hvac.air_purifier:
    extra_configs:
      - CONFIG_SAMPLE_AIR_PURIFIER=y
```

## samples/ias/Kconfig
```kconfig
# SPDX-License-Identifier: Apache-2.0

mainmenu "zzb ias sample"

rsource "../common/Kconfig"

choice SAMPLE_IAS
	prompt "Device type"

config SAMPLE_IAS_ZONE
	bool "IAS Zone (0x0402)"
	select SAMPLE_SLEEPY
	select SAMPLE_ZONE

config SAMPLE_IAS_WARNING_DEVICE
	bool "IAS Warning Device (0x0403)"
	select SAMPLE_ZONE

config SAMPLE_IAS_ACE
	bool "IAS Ancillary Control Equipment (0x0401)"
	select SAMPLE_SLEEPY
	select SAMPLE_ZONE

config SAMPLE_IAS_CIE
	bool "IAS Control and Indication Equipment (0x0400)"

endchoice

config SAMPLE_ZONE
	bool

config SAMPLE_MODEL_ID
	string
	default "ias_zone" if SAMPLE_IAS_ZONE
	default "ias_warning_device" if SAMPLE_IAS_WARNING_DEVICE
	default "ias_ace" if SAMPLE_IAS_ACE
	default "ias_cie" if SAMPLE_IAS_CIE

source "Kconfig.zephyr"
```

## samples/ias/sample.yaml
```yaml
# SPDX-License-Identifier: Apache-2.0

sample:
  name: zzb ias
common:
  build_only: true
  platform_allow:
    - nrf52840dk/nrf52840
    - esp32c6_devkitc/esp32c6/hpcore
    - esp32h2_devkitm/esp32h2
  integration_platforms:
    - nrf52840dk/nrf52840
tests:
  sample.zzb.ias.ias_zone:
    extra_configs:
      - CONFIG_SAMPLE_IAS_ZONE=y
  sample.zzb.ias.ias_warning_device:
    extra_configs:
      - CONFIG_SAMPLE_IAS_WARNING_DEVICE=y
  sample.zzb.ias.ias_ace:
    extra_configs:
      - CONFIG_SAMPLE_IAS_ACE=y
  sample.zzb.ias.ias_cie:
    extra_configs:
      - CONFIG_SAMPLE_IAS_CIE=y
```

## samples/light/Kconfig
```kconfig
# SPDX-License-Identifier: Apache-2.0

mainmenu "zzb light sample"

rsource "../common/Kconfig"

choice SAMPLE_LIGHT
	prompt "Device type"

config SAMPLE_ON_OFF_LIGHT
	bool "On/Off Light (0x0100)"

config SAMPLE_DIMMABLE_LIGHT
	bool "Dimmable Light (0x0101)"
	select SAMPLE_LEVEL

config SAMPLE_COLOR_DIMMABLE_LIGHT
	bool "Color Dimmable Light (0x0102)"
	select SAMPLE_LEVEL
	select SAMPLE_COLOR_XY

config SAMPLE_COLOR_TEMPERATURE_LIGHT
	bool "Color Temperature Light (0x010c)"
	select SAMPLE_LEVEL
	select SAMPLE_COLOR_TEMPERATURE

config SAMPLE_EXTENDED_COLOR_LIGHT
	bool "Extended Color Light (0x010d)"
	select SAMPLE_LEVEL
	select SAMPLE_COLOR_XY
	select SAMPLE_COLOR_TEMPERATURE

endchoice

config SAMPLE_LEVEL
	bool

config SAMPLE_COLOR_XY
	bool

config SAMPLE_COLOR_TEMPERATURE
	bool

config SAMPLE_COLOR
	bool
	default y if SAMPLE_COLOR_XY || SAMPLE_COLOR_TEMPERATURE

config SAMPLE_MODEL_ID
	string
	default "on_off_light" if SAMPLE_ON_OFF_LIGHT
	default "dimmable_light" if SAMPLE_DIMMABLE_LIGHT
	default "color_dimmable_light" if SAMPLE_COLOR_DIMMABLE_LIGHT
	default "color_temperature_light" if SAMPLE_COLOR_TEMPERATURE_LIGHT
	default "extended_color_light" if SAMPLE_EXTENDED_COLOR_LIGHT

source "Kconfig.zephyr"
```
