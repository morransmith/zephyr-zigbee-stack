## samples/light/sample.yaml
```yaml
# SPDX-License-Identifier: Apache-2.0

sample:
  name: zzb light
common:
  build_only: true
  platform_allow:
    - nrf52840dk/nrf52840
    - esp32c6_devkitc/esp32c6/hpcore
    - esp32h2_devkitm/esp32h2
  integration_platforms:
    - nrf52840dk/nrf52840
tests:
  sample.zzb.light.on_off_light:
    extra_configs:
      - CONFIG_SAMPLE_ON_OFF_LIGHT=y
  sample.zzb.light.dimmable_light:
    extra_configs:
      - CONFIG_SAMPLE_DIMMABLE_LIGHT=y
  sample.zzb.light.color_dimmable_light:
    extra_configs:
      - CONFIG_SAMPLE_COLOR_DIMMABLE_LIGHT=y
  sample.zzb.light.color_temperature_light:
    extra_configs:
      - CONFIG_SAMPLE_COLOR_TEMPERATURE_LIGHT=y
  sample.zzb.light.extended_color_light:
    extra_configs:
      - CONFIG_SAMPLE_EXTENDED_COLOR_LIGHT=y
```

## samples/lock_contact/sample.yaml
```yaml
# SPDX-License-Identifier: Apache-2.0

sample:
  name: zzb lock contact
tests:
  sample.zzb.lock_contact:
    build_only: true
    platform_allow:
      - nrf52840dk/nrf52840
      - esp32c6_devkitc/esp32c6/hpcore
      - esp32h2_devkitm/esp32h2
    integration_platforms:
      - nrf52840dk/nrf52840
```

## samples/output/Kconfig
```kconfig
# SPDX-License-Identifier: Apache-2.0

mainmenu "zzb output sample"

rsource "../common/Kconfig"

choice SAMPLE_OUTPUT
	prompt "Device type"

config SAMPLE_ON_OFF_OUTPUT
	bool "On/Off Output (0x0002)"

config SAMPLE_LEVEL_CONTROLLABLE_OUTPUT
	bool "Level Controllable Output (0x0003)"
	select SAMPLE_LEVEL

config SAMPLE_MAINS_POWER_OUTLET
	bool "Mains Power Outlet (0x0009)"

# Level Control lets the unit process the commands with On/Off sent to a group with dimmable
# lights (DTL 31.3.1)
config SAMPLE_ON_OFF_PLUG_IN_UNIT
	bool "On/Off Plug-in Unit (0x010a)"
	select SAMPLE_LEVEL

config SAMPLE_DIMMABLE_PLUG_IN_UNIT
	bool "Dimmable Plug-In Unit (0x010b)"
	select SAMPLE_LEVEL

endchoice

config SAMPLE_LEVEL
	bool

config SAMPLE_MODEL_ID
	string
	default "on_off_output" if SAMPLE_ON_OFF_OUTPUT
	default "level_controllable_output" if SAMPLE_LEVEL_CONTROLLABLE_OUTPUT
	default "mains_power_outlet" if SAMPLE_MAINS_POWER_OUTLET
	default "on_off_plug_in_unit" if SAMPLE_ON_OFF_PLUG_IN_UNIT
	default "dimmable_plug_in_unit" if SAMPLE_DIMMABLE_PLUG_IN_UNIT

source "Kconfig.zephyr"
```

## samples/output/sample.yaml
```yaml
# SPDX-License-Identifier: Apache-2.0

sample:
  name: zzb output
common:
  build_only: true
  platform_allow:
    - nrf52840dk/nrf52840
    - esp32c6_devkitc/esp32c6/hpcore
    - esp32h2_devkitm/esp32h2
  integration_platforms:
    - nrf52840dk/nrf52840
tests:
  sample.zzb.output.on_off_output:
    extra_configs:
      - CONFIG_SAMPLE_ON_OFF_OUTPUT=y
  sample.zzb.output.level_controllable_output:
    extra_configs:
      - CONFIG_SAMPLE_LEVEL_CONTROLLABLE_OUTPUT=y
  sample.zzb.output.mains_power_outlet:
    extra_configs:
      - CONFIG_SAMPLE_MAINS_POWER_OUTLET=y
  sample.zzb.output.on_off_plug_in_unit:
    extra_configs:
      - CONFIG_SAMPLE_ON_OFF_PLUG_IN_UNIT=y
  sample.zzb.output.dimmable_plug_in_unit:
    extra_configs:
      - CONFIG_SAMPLE_DIMMABLE_PLUG_IN_UNIT=y
```

## samples/pump/Kconfig
```kconfig
# SPDX-License-Identifier: Apache-2.0

mainmenu "zzb pump sample"

rsource "../common/Kconfig"

choice SAMPLE_PUMP_TYPE
	prompt "Device type"

config SAMPLE_PUMP
	bool "Pump (0x0303)"

config SAMPLE_PUMP_CONTROLLER
	bool "Pump Controller (0x0304)"
	select SAMPLE_SLEEPY

endchoice

config SAMPLE_MODEL_ID
	string
	default "pump" if SAMPLE_PUMP
	default "pump_controller" if SAMPLE_PUMP_CONTROLLER

source "Kconfig.zephyr"
```

## samples/pump/sample.yaml
```yaml
# SPDX-License-Identifier: Apache-2.0

sample:
  name: zzb pump
common:
  build_only: true
  platform_allow:
    - nrf52840dk/nrf52840
    - esp32c6_devkitc/esp32c6/hpcore
    - esp32h2_devkitm/esp32h2
  integration_platforms:
    - nrf52840dk/nrf52840
tests:
  sample.zzb.pump.pump:
    extra_configs:
      - CONFIG_SAMPLE_PUMP=y
  sample.zzb.pump.pump_controller:
    extra_configs:
      - CONFIG_SAMPLE_PUMP_CONTROLLER=y
```

## samples/sensor/Kconfig
```kconfig
# SPDX-License-Identifier: Apache-2.0

mainmenu "zzb sensor sample"

rsource "../common/Kconfig"

choice SAMPLE_SENSOR
	prompt "Device type"

config SAMPLE_SIMPLE_SENSOR
	bool "Simple Sensor (0x000c)"
	select SAMPLE_SLEEPY

config SAMPLE_LIGHT_SENSOR
	bool "Light Sensor (0x0106)"
	select SAMPLE_SLEEPY
	select SAMPLE_MEASURED

config SAMPLE_OCCUPANCY_SENSOR
	bool "Occupancy Sensor (0x0107)"
	select SAMPLE_SLEEPY

config SAMPLE_LIGHT_LEVEL_SENSOR
	bool "Light Level Sensor (0x010e)"
	select SAMPLE_SLEEPY
	select SAMPLE_MEASURED

config SAMPLE_TEMPERATURE_SENSOR
	bool "Temperature Sensor (0x0302)"
	select SAMPLE_SLEEPY
	select SAMPLE_MEASURED

config SAMPLE_PRESSURE_SENSOR
	bool "Pressure Sensor (0x0305)"
	select SAMPLE_SLEEPY
	select SAMPLE_MEASURED

config SAMPLE_FLOW_SENSOR
	bool "Flow Sensor (0x0306)"
	select SAMPLE_SLEEPY
	select SAMPLE_MEASURED

endchoice

config SAMPLE_MEASURED
	bool
	help
	  The device type sets a synthetic measured value every 60 s and at a
	  short press.

config SAMPLE_MODEL_ID
	string
	default "simple_sensor" if SAMPLE_SIMPLE_SENSOR
	default "light_sensor" if SAMPLE_LIGHT_SENSOR
	default "occupancy_sensor" if SAMPLE_OCCUPANCY_SENSOR
	default "light_level_sensor" if SAMPLE_LIGHT_LEVEL_SENSOR
	default "temperature_sensor" if SAMPLE_TEMPERATURE_SENSOR
	default "pressure_sensor" if SAMPLE_PRESSURE_SENSOR
	default "flow_sensor" if SAMPLE_FLOW_SENSOR

source "Kconfig.zephyr"
```

## samples/sensor/sample.yaml
```yaml
# SPDX-License-Identifier: Apache-2.0

sample:
  name: zzb sensor
common:
  build_only: true
  platform_allow:
    - nrf52840dk/nrf52840
    - esp32c6_devkitc/esp32c6/hpcore
    - esp32h2_devkitm/esp32h2
  integration_platforms:
    - nrf52840dk/nrf52840
tests:
  sample.zzb.sensor.simple_sensor:
    extra_configs:
      - CONFIG_SAMPLE_SIMPLE_SENSOR=y
  sample.zzb.sensor.light_sensor:
    extra_configs:
      - CONFIG_SAMPLE_LIGHT_SENSOR=y
  sample.zzb.sensor.occupancy_sensor:
    extra_configs:
      - CONFIG_SAMPLE_OCCUPANCY_SENSOR=y
  sample.zzb.sensor.light_level_sensor:
    extra_configs:
      - CONFIG_SAMPLE_LIGHT_LEVEL_SENSOR=y
  sample.zzb.sensor.temperature_sensor:
    extra_configs:
      - CONFIG_SAMPLE_TEMPERATURE_SENSOR=y
  sample.zzb.sensor.pressure_sensor:
    extra_configs:
      - CONFIG_SAMPLE_PRESSURE_SENSOR=y
  sample.zzb.sensor.flow_sensor:
    extra_configs:
      - CONFIG_SAMPLE_FLOW_SENSOR=y
```

## samples/switch/Kconfig
```kconfig
# SPDX-License-Identifier: Apache-2.0

mainmenu "zzb switch sample"

rsource "../common/Kconfig"

choice SAMPLE_SWITCH
	prompt "Device type"

config SAMPLE_ON_OFF_SWITCH
	bool "On/Off Switch (0x0000)"
	select SAMPLE_SLEEPY

config SAMPLE_LEVEL_CONTROL_SWITCH
	bool "Level Control Switch (0x0001)"
	select SAMPLE_SLEEPY
	select SAMPLE_LEVEL

config SAMPLE_ON_OFF_LIGHT_SWITCH
	bool "On/Off Light Switch (0x0103)"
	select SAMPLE_SLEEPY

config SAMPLE_DIMMER_SWITCH
	bool "Dimmer Switch (0x0104)"
	select SAMPLE_SLEEPY
	select SAMPLE_LEVEL

config SAMPLE_COLOR_DIMMER_SWITCH
	bool "Color Dimmer Switch (0x0105)"
	select SAMPLE_SLEEPY
	select SAMPLE_LEVEL
	select SAMPLE_COLOR

endchoice

config SAMPLE_LEVEL
	bool

config SAMPLE_COLOR
	bool

config SAMPLE_MODEL_ID
	string
	default "on_off_switch" if SAMPLE_ON_OFF_SWITCH
	default "level_control_switch" if SAMPLE_LEVEL_CONTROL_SWITCH
	default "on_off_light_switch" if SAMPLE_ON_OFF_LIGHT_SWITCH
	default "dimmer_switch" if SAMPLE_DIMMER_SWITCH
	default "color_dimmer_switch" if SAMPLE_COLOR_DIMMER_SWITCH

source "Kconfig.zephyr"
```

## samples/switch/sample.yaml
```yaml
# SPDX-License-Identifier: Apache-2.0

sample:
  name: zzb switch
common:
  build_only: true
  platform_allow:
    - nrf52840dk/nrf52840
    - esp32c6_devkitc/esp32c6/hpcore
    - esp32h2_devkitm/esp32h2
  integration_platforms:
    - nrf52840dk/nrf52840
tests:
  sample.zzb.switch.on_off_switch:
    extra_configs:
      - CONFIG_SAMPLE_ON_OFF_SWITCH=y
  sample.zzb.switch.level_control_switch:
    extra_configs:
      - CONFIG_SAMPLE_LEVEL_CONTROL_SWITCH=y
  sample.zzb.switch.on_off_light_switch:
    extra_configs:
      - CONFIG_SAMPLE_ON_OFF_LIGHT_SWITCH=y
  sample.zzb.switch.dimmer_switch:
    extra_configs:
      - CONFIG_SAMPLE_DIMMER_SWITCH=y
  sample.zzb.switch.color_dimmer_switch:
    extra_configs:
      - CONFIG_SAMPLE_COLOR_DIMMER_SWITCH=y
```
