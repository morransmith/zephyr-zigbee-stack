## CMakeLists.txt
```
# SPDX-License-Identifier: Apache-2.0

cmake_minimum_required(VERSION 3.20.0)

find_package(Zephyr REQUIRED HINTS $ENV{ZEPHYR_BASE})
project(zzb_integration_nwk_join)

target_include_directories(app PRIVATE
  ${ZEPHYR_ZZB_MODULE_DIR}/subsys/zzb
  ${ZEPHYR_ZZB_MODULE_DIR}/tests/common
)
target_sources(app PRIVATE
  src/aps.c
  src/main.c
  ${ZEPHYR_ZZB_MODULE_DIR}/tests/common/fake_radio.c
  ${ZEPHYR_ZZB_MODULE_DIR}/tests/common/parent.c
)
```

## prj.conf
```kconfig
# SPDX-License-Identifier: Apache-2.0

CONFIG_ZTEST=y
CONFIG_ZZB=y
CONFIG_ZZB_NODE_COUNT=1
# The test defines the APSDE and APSME callbacks
CONFIG_ZZB_ZDO=n
# 10 s, so the keepalive runs every 3.33 s
CONFIG_ZZB_NWK_ED_TIMEOUT=0
CONFIG_NETWORKING=y
CONFIG_NET_L2_CUSTOM_IEEE802154=y
CONFIG_NET_IPV6=n
# A frame reaches the receiving port within the tx() of the sending radio
CONFIG_NET_TC_RX_COUNT=0
# native_sim enables Ethernet, which would add a TAP interface
CONFIG_NET_L2_ETHERNET=n
# ci/check-frame-log.sh reads the frame log of the medium
CONFIG_LOG=y
CONFIG_LOG_MODE_IMMEDIATE=y
CONFIG_FLASH=y
CONFIG_FLASH_MAP=y
CONFIG_NVS=y
# Every run starts with erased flash
CONFIG_NATIVE_EXTRA_CMDLINE_ARGS="--flash_in_ram"
```

## src/main.c
```c
/* SPDX-License-Identifier: Apache-2.0 */

#include <string.h>
#include <zephyr/kernel.h>
#include <zephyr/net_buf.h>
#include <zephyr/ztest.h>
#include <zzb/zzb.h>

#include "aps/aps.h"
#include "child.h"
#include "common/node.h"
#include "fake_radio.h"
#include "nwk/nwk.h"
#include "parent.h"

#define ROUTER_ADDR  0x2222
#define ROUTER_EUI64 0x00124b0000000002ULL

/* Receiver on when idle, allocate address */
#define CAPABILITY (ZZB_NWK_CAP_RX_ON_IDLE | ZZB_NWK_CAP_ALLOC_ADDR)

struct zzb_node *child;
struct child_log child_log;

/* NLME callbacks, which ZDO defines from milestone 10 */
static struct {
	int discovery_count;
	uint8_t discovery_status;
	struct zzb_nwk_network network;
	size_t network_count;
	int join_count;
	uint8_t join_status;
	int leave_count;
	uint8_t leave_status;
	int leave_ind_count;
	bool leave_ind_rejoin;
	int status_count;
	uint8_t status_code;
} nlme;

void zzb_nlme_network_discovery_conf(struct zzb_node *node, uint8_t status,
				     const struct zzb_nwk_network *networks, size_t count)
{
	nlme.discovery_count++;
	nlme.discovery_status = status;
	nlme.network_count = count;
	if (count > 0) {
		nlme.network = networks[0];
	}
}

void zzb_nlme_join_conf(struct zzb_node *node, uint8_t status)
{
	nlme.join_count++;
	nlme.join_status = status;
}

void zzb_nlme_nwk_status_ind(struct zzb_node *node, uint8_t code, uint16_t addr)
{
	nlme.status_count++;
	nlme.status_code = code;
}

void zzb_nlme_leave_conf(struct zzb_node *node, uint8_t status)
{
	nlme.leave_count++;
	nlme.leave_status = status;
}

void zzb_nlme_leave_ind(struct zzb_node *node, uint64_t ext_addr, bool rejoin)
{
	nlme.leave_ind_count++;
	nlme.leave_ind_rejoin = rejoin;
}

/* APS callbacks, which ZDO defines from milestone 10 */
void zzb_apsme_transport_key_ind(struct zzb_node *node, uint64_t src_addr,
				 enum zzb_aps_key_type type, const uint8_t *key, uint8_t seq)
{
	child_log.transport_keys++;
	if (type == ZZB_APS_KEY_TC_LINK) {
		/* BDB 10.2.5 step 9 */
		zassert_ok(zzb_apsme_set_link_key(node, src_addr, key, ZZB_APS_KEY_UNVERIFIED,
						  ZZB_APS_LINK_KEY_UNIQUE));
		return;
	}

	zassert_ok(zzb_apsme_set_tc_addr(node, src_addr));
	zzb_nlme_set_nwk_key(node, key, seq);
}

void zzb_apsme_switch_key_ind(struct zzb_node *node, uint64_t src_addr, uint8_t seq)
{
	zassert_ok(zzb_nlme_set_active_key(node, seq));
}

void zzb_apsme_confirm_key_ind(struct zzb_node *node, uint8_t status, uint64_t src_addr,
			       enum zzb_aps_key_type type)
{
	child_log.confirm_keys++;
	child_log.confirm_status = status;
}

void zzb_apsde_data_ind(struct zzb_node *node, struct net_buf *buf, const struct zzb_apsde_ind *ind)
{
	child_log.data_inds++;
	net_buf_unref(buf);
}

void zzb_apsde_data_conf(struct zzb_node *node, uint8_t handle, uint8_t status)
{
	child_log.data_confs++;
	child_log.data_status = status;
}

/* The trust center sends the network key; the child sets it and the trust center address */
static void receive_network_key(void)
{
	int count = child_log.transport_keys;

	parent_send_transport_key();
	k_sleep(K_MSEC(10));
	zassert_equal(child_log.transport_keys, count + 1);
	zassert_false(child->nwk.key_pending);
	zassert_equal(child->aps.aib.tc_addr, PARENT_EUI64);
}

/* Discovery on two channels, association, then the network key from the trust center */
static void join(void)
{
	zassert_ok(zzb_nlme_network_discovery_req(child, BIT(11) | BIT(CHANNEL), 0));

	/* Two channels of aBaseSuperframeDuration * 2, 30.72 ms each, in ticks of 10 ms */
	k_sleep(K_MSEC(200));
	zassert_equal(nlme.discovery_count, 1);
	zassert_equal(nlme.discovery_status, ZZB_MAC_STATUS_SUCCESS);
	zassert_equal(nlme.network_count, 1);
	zassert_equal(nlme.network.ext_pan_id, EXT_PAN_ID);
	zassert_equal(nlme.network.pan_id, PAN_ID);
	zassert_equal(nlme.network.channel, CHANNEL);
	zassert_true(nlme.network.permit_join);
	zassert_equal(parent_log.beacon_reqs, 1);

	zassert_ok(
		zzb_nlme_join_req(child, EXT_PAN_ID, ZZB_NWK_JOIN_ASSOC, 0, 0, CAPABILITY, false));

	/* macResponseWaitTime before the data request */
	k_sleep(K_MSEC(550));
	zassert_equal(nlme.join_count, 1);
	zassert_equal(nlme.join_status, ZZB_MAC_STATUS_SUCCESS);
	zassert_equal(child->nwk.nib.short_addr, CHILD_ADDR);
	zassert_equal(zzb_nwk_neighbor_parent(child)->ext_addr, PARENT_EUI64);

	receive_network_key();
}

void child_init(void)
{
	const struct zzb_node_config cfg = {
		.radio = fake_radios[1],
	};

	if (child != NULL) {
		return;
	}

	fake_radio_reset();
	zassert_ok(zzb_node_init(&cfg, &child));
}

void child_join(void)
{
	memset(&nlme, 0, sizeof(nlme));
	memset(&child_log, 0, sizeof(child_log));
	parent_start(PARENT_ADDR, PARENT_EUI64, CHILD_ADDR, ZZB_NWK_PARENT_POLL_KEEPALIVE);
	zassert_ok(zzb_nlme_reset_req(child));
	zzb_aps_reset(child);
	join();
}

static void *setup(void)
{
	child_init();
	return NULL;
}

static void before(void *fixture)
{
	child_join();
}

/* R22 3.6.10.2: the request follows the network key */
ZTEST(zzb_nwk_join, test_end_device_timeout)
{
	zassert_equal(parent_log.ed_timeout_reqs, 1);
	zassert_true(parent_log.hdr.flags & ZZB_NWK_SECURITY);
	zassert_equal(parent_log.hdr.src, CHILD_ADDR);
	zassert_equal(parent_log.cmd.ed_timeout_req.timeout, CONFIG_ZZB_NWK_ED_TIMEOUT);
	zassert_equal(child->nwk.nib.parent_info, ZZB_NWK_PARENT_POLL_KEEPALIVE);
}

/* Three MAC data polls per timeout of 10 s (R22 3.6.10.3) */
ZTEST(zzb_nwk_join, test_keepalive_polls_the_parent)
{
	k_sleep(K_MSEC(3300));
	zassert_equal(parent_log.polls, 0);
	k_sleep(K_MSEC(100));
	zassert_equal(parent_log.polls, 1);
	k_sleep(K_MSEC(3333));
	zassert_equal(parent_log.polls, 2);
	zassert_equal(nlme.status_count, 0);
}

static void rejoin(bool secure)
{
	zassert_ok(zzb_nlme_join_req(child, EXT_PAN_ID, ZZB_NWK_JOIN_REJOIN, BIT(CHANNEL), 0,
				     CAPABILITY, secure));
	k_sleep(K_MSEC(100));

	zassert_equal(nlme.join_count, 1);
	zassert_equal(nlme.join_status, ZZB_NWK_STATUS_SUCCESS);
	zassert_equal(parent_log.rejoin_reqs, 1);
	zassert_equal(child->nwk.nib.short_addr, CHILD_ADDR);
}

ZTEST(zzb_nwk_join, test_secure_rejoin)
{
	nlme.join_count = 0;
	rejoin(true);

	zassert_true(parent_log.rejoin_hdr.flags & ZZB_NWK_SECURITY);
	zassert_equal(parent_log.ed_timeout_reqs, 2);
	zassert_equal(zzb_nwk_neighbor_parent(child)->ext_addr, PARENT_EUI64);
}

/* The child knows the new parent from its beacon only, until the secured response */
ZTEST(zzb_nwk_join, test_secure_rejoin_to_a_new_parent)
{
	parent_start(ROUTER_ADDR, ROUTER_EUI64, CHILD_ADDR, ZZB_NWK_PARENT_POLL_KEEPALIVE);
	nlme.join_count = 0;
	rejoin(true);

	zassert_false(parent_log.rejoin_hdr.flags & ZZB_NWK_DST_IEEE);
	zassert_equal(zzb_nwk_neighbor_parent(child)->short_addr, ROUTER_ADDR);
	zassert_equal(zzb_nwk_neighbor_parent(child)->ext_addr, ROUTER_EUI64);
	zassert_equal(parent_log.ed_timeout_reqs, 1);
}

/* R22 4.6.3.3.2: without NWK security, then the key from the trust center */
ZTEST(zzb_nwk_join, test_trust_center_rejoin)
{
	nlme.join_count = 0;
	rejoin(false);

	zassert_false(parent_log.rejoin_hdr.flags & ZZB_NWK_SECURITY);
	zassert_true(child->nwk.key_pending);
	zassert_equal(parent_log.ed_timeout_reqs, 1);

	receive_network_key();
	zassert_equal(parent_log.ed_timeout_reqs, 2);
}

/* R22 3.6.10.4.1: a parent that has aged the child out asks it to rejoin */
ZTEST(zzb_nwk_join, test_leave_request_with_rejoin)
{
	parent_send_leave_request(true);
	k_sleep(K_MSEC(10));

	zassert_equal(parent_log.leaves, 1);
	zassert_equal(parent_log.cmd.leave_options, ZZB_NWK_LEAVE_REJOIN);
	zassert_equal(parent_log.hdr.dst, 0xfffd);
	zassert_equal(nlme.leave_ind_count, 1);
	zassert_true(nlme.leave_ind_rejoin);
	zassert_equal(child->nwk.nib.ext_pan_id, EXT_PAN_ID);
}

ZTEST(zzb_nwk_join, test_leave_without_rejoin)
{
	zassert_ok(zzb_nlme_leave_req(child, false));
	k_sleep(K_MSEC(10));

	zassert_equal(parent_log.leaves, 1);
	zassert_equal(parent_log.cmd.leave_options, 0);
	zassert_equal(nlme.leave_count, 1);
	zassert_equal(nlme.leave_status, ZZB_MAC_STATUS_SUCCESS);
	zassert_equal(child->nwk.nib.ext_pan_id, 0);
	zassert_equal(child->mac.pan_id, 0xffff);
	zassert_equal(child->mac.short_addr, 0xffff);
}

ZTEST_SUITE(zzb_nwk_join, NULL, setup, before, NULL, NULL);
```

## src/aps.c
```c
/* SPDX-License-Identifier: Apache-2.0 */

#include <zephyr/kernel.h>
#include <zephyr/net_buf.h>
#include <zephyr/ztest.h>

#include "aps/aps.h"
#include "child.h"
#include "common/buf.h"
#include "common/node.h"
#include "parent.h"

/* On/Off command Toggle to the trust center */
static void send_data(uint8_t tx_options)
{
	static const uint8_t asdu[] = {0x01, 0x42, 0x02};
	const struct zzb_apsde_req req = {
		.dst_mode = ZZB_APS_ADDR_SHORT,
		.dst_addr = PARENT_ADDR,
		.dst_ep = 0x01,
		.profile = 0x0104,
		.cluster = 0x0006,
		.src_ep = 0x01,
		.tx_options = tx_options,
	};
	struct net_buf *buf = zzb_buf_alloc(K_NO_WAIT);

	zassert_not_null(buf);
	net_buf_reserve(buf, ZZB_APSDE_HEADROOM);
	net_buf_add_mem(buf, asdu, sizeof(asdu));
	zassert_ok(zzb_apsde_data_req(child, buf, &req));
}

static void *setup(void)
{
	child_init();
	return NULL;
}

static void before(void *fixture)
{
	child_join();
}

/* BDB 10.2.5 steps 7 to 12 */
ZTEST(zzb_aps_join, test_trust_center_link_key_exchange)
{
	struct zzb_aps_key_pair *pair;

	zassert_ok(zzb_apsme_request_key_req(child, PARENT_EUI64));
	k_sleep(K_MSEC(10));
	zassert_equal(parent_log.aps_cmd.id, ZZB_APS_CMD_REQUEST_KEY);
	zassert_equal(child_log.transport_keys, 2);
	pair = zzb_aps_key_pair_find(child, PARENT_EUI64);
	zassert_mem_equal(pair->key, tc_link_key_b, ZZB_SEC_KEY_LEN);
	zassert_equal(pair->attr, ZZB_APS_KEY_UNVERIFIED);

	zassert_ok(zzb_apsme_verify_key_req(child, PARENT_EUI64, ZZB_APS_KEY_TC_LINK));
	k_sleep(K_MSEC(10));
	zassert_equal(parent_log.aps_cmd.id, ZZB_APS_CMD_VERIFY_KEY);
	zassert_equal(child_log.confirm_keys, 1);
	zassert_equal(child_log.confirm_status, ZZB_APS_STATUS_SUCCESS);
	zassert_equal(pair->attr, ZZB_APS_KEY_VERIFIED);
}

ZTEST(zzb_aps_join, test_acknowledged_data)
{
	send_data(ZZB_APS_TX_ACK);
	k_sleep(K_MSEC(10));

	zassert_equal(parent_log.aps_data, 1);
	zassert_equal(child_log.data_confs, 1);
	zassert_equal(child_log.data_status, ZZB_APS_STATUS_SUCCESS);
}

/* R22 2.2.8.4.4: the same APS counter, a higher frame counter */
ZTEST(zzb_aps_join, test_retransmission)
{
	uint8_t counter;
	uint32_t fc;

	parent_withhold_aps_acks(1);
	send_data(ZZB_APS_TX_ACK | ZZB_APS_TX_SECURITY);
	k_sleep(K_MSEC(10));
	zassert_equal(parent_log.aps_data, 1);
	zassert_equal(child_log.data_confs, 0);
	counter = parent_log.aps_hdr.counter;
	fc = parent_log.aps_fc;

	k_sleep(K_MSEC(1700));
	zassert_equal(parent_log.aps_data, 2);
	zassert_equal(parent_log.aps_hdr.counter, counter);
	zassert_true(parent_log.aps_fc > fc);
	zassert_equal(child_log.data_confs, 1);
	zassert_equal(child_log.data_status, ZZB_APS_STATUS_SUCCESS);
}

/* The first ACK of the child is lost, so the trust center repeats the frame */
ZTEST(zzb_aps_join, test_duplicate)
{
	parent_send_aps_data(0x40);
	k_sleep(K_MSEC(10));
	zassert_equal(child_log.data_inds, 1);
	zassert_equal(parent_log.aps_acks, 1);

	parent_send_aps_data(0x40);
	k_sleep(K_MSEC(10));
	zassert_equal(child_log.data_inds, 1);
	zassert_equal(parent_log.aps_acks, 2);
}

/* R22 4.6.3.4.2: the next frames of the child use network key 1 */
ZTEST(zzb_aps_join, test_network_key_switch)
{
	const struct zzb_nib *nib = &child->nwk.nib;

	parent_send_nwk_key_update();
	k_sleep(K_MSEC(10));
	zassert_equal(child_log.transport_keys, 2);
	zassert_equal(nib->keys[nib->active_key].seq, 1);

	send_data(0);
	k_sleep(K_MSEC(10));
	zassert_equal(parent_log.aps_data, 1);
	zassert_equal(parent_log.nwk_key_seq, 1);
}

ZTEST_SUITE(zzb_aps_join, NULL, setup, before, NULL, NULL);
```

## src/child.h
```c
/* SPDX-License-Identifier: Apache-2.0 */

#ifndef ZZB_TESTS_INTEGRATION_NWK_JOIN_CHILD_H_
#define ZZB_TESTS_INTEGRATION_NWK_JOIN_CHILD_H_

#include <stdint.h>

#define PARENT_ADDR  0x0000
#define PARENT_EUI64 0x00124b0000000001ULL
#define CHILD_ADDR   0x1234

/* The zzb node on fake radio 1 */
extern struct zzb_node *child;

/* What the APS callbacks of the child received; the test does what ZDO and BDB will do */
struct child_log {
	int transport_keys;
	int confirm_keys;
	uint8_t confirm_status;
	int data_confs;
	uint8_t data_status;
	int data_inds;
};

extern struct child_log child_log;

/* Initializes the child on the first call */
void child_init(void);

/* Starts the parent, resets the child and joins it: discovery, association, network key */
void child_join(void);

#endif /* ZZB_TESTS_INTEGRATION_NWK_JOIN_CHILD_H_ */
```

## src/parent.c
```c
/* SPDX-License-Identifier: Apache-2.0 */

#include <string.h>
#include <zephyr/kernel.h>
#include <zephyr/net/ieee802154_radio.h>
#include <zephyr/sys/byteorder.h>
#include <zephyr/ztest.h>

#include "aps/aps.h"
#include "aps/frame.h"
#include "common/buf.h"
#include "common/queue.h"
#include "fake_radio.h"
#include "mac/frame.h"
#include "nwk/frame.h"
#include "parent.h"
#include "sec/aux_hdr.h"
#include "sec/ccm.h"
#include "sec/hmac.h"
#include "sec/key_cache.h"

/* A coordinator that permits association */
#define SUPERFRAME (0x0fff | ZZB_MAC_SF_PAN_COORD | ZZB_MAC_SF_ASSOC_PERMIT)

const uint8_t nwk_key[ZZB_SEC_KEY_LEN] = {
	0x00, 0x01, 0x02, 0x03, 0x04, 0x05, 0x06, 0x07,
	0x08, 0x09, 0x0a, 0x0b, 0x0c, 0x0d, 0x0e, 0x0f,
};

struct parent_log parent_log;

static struct {
	uint16_t short_addr;
	uint64_t eui64;
	uint16_t child_addr;
	uint64_t child_eui64;
	uint8_t parent_info;
	bool assoc_pending;
	uint8_t dsn;
	uint8_t nwk_seq;
	uint32_t fc;
	uint8_t aps_counter;
	uint32_t aps_fc;
} parent;

static struct zzb_mac_addr short_addr(uint16_t addr)
{
	return (struct zzb_mac_addr){
		.mode = ZZB_MAC_ADDR_SHORT,
		.pan_id = PAN_ID,
		.short_addr = addr,
	};
}

static struct zzb_mac_addr ext_addr(uint64_t addr)
{
	return (struct zzb_mac_addr){
		.mode = ZZB_MAC_ADDR_EXT,
		.pan_id = PAN_ID,
		.ext_addr = addr,
	};
}

static void send_mac(struct zzb_mac_hdr *hdr, const uint8_t *payload, size_t len)
{
	uint8_t frame[ZZB_BUF_SIZE];
	size_t hdr_len;

	hdr->seq = parent.dsn++;
	hdr_len = zzb_mac_hdr_write(hdr, frame);
	memcpy(frame + hdr_len, payload, len);
	fake_radio_send(0, frame, hdr_len + len);
}

static void send_beacon(void)
{
	struct zzb_mac_hdr hdr = {
		.type = ZZB_MAC_FRAME_BEACON,
		.src = short_addr(parent.short_addr),
	};
	const struct zzb_nwk_beacon beacon = {
		.stack_profile = 2,
		.protocol_version = 2,
		.router_capacity = true,
		.ed_capacity = true,
		.ext_pan_id = EXT_PAN_ID,
		.tx_offset = 0xffffff,
	};
	uint8_t payload[ZZB_BUF_SIZE];
	size_t len = zzb_mac_beacon_write(SUPERFRAME, payload);

	len += zzb_nwk_beacon_write(&beacon, payload + len);
	send_mac(&hdr, payload, len);
}

/* R22 Table D-3, first form */
static void send_assoc_rsp(void)
{
	struct zzb_mac_hdr hdr = {
		.type = ZZB_MAC_FRAME_CMD,
		.flags = ZZB_FRAME_ACK_REQ,
		.dst = ext_addr(parent.child_eui64),
		.src = ext_addr(parent.eui64),
	};
	const struct zzb_mac_cmd cmd = {
		.id = ZZB_MAC_CMD_ASSOC_RSP,
		.assoc_rsp = {.short_addr = parent.child_addr},
	};
	uint8_t payload[8];

	send_mac(&hdr, payload, zzb_mac_cmd_write(&cmd, payload));
}

/* Sends payload to the child with radius 1, secured when flags has ZZB_NWK_SECURITY */
static void send_nwk(enum zzb_nwk_frame_type type, uint16_t flags, const uint8_t *payload,
		     size_t payload_len)
{
	struct zzb_mac_hdr mac = {
		.type = ZZB_MAC_FRAME_DATA,
		.flags = ZZB_FRAME_ACK_REQ,
		.dst = short_addr(parent.child_addr),
		.src = short_addr(parent.short_addr),
	};
	const struct zzb_nwk_hdr hdr = {
		.type = type,
		.flags = flags,
		.dst = parent.child_addr,
		.src = parent.short_addr,
		.radius = 1,
		.seq = parent.nwk_seq++,
		.dst_ext = parent.child_eui64,
		.src_ext = parent.eui64,
	};
	const struct zzb_sec_aux_hdr aux = {
		.key_id = ZZB_SEC_KEY_NWK,
		.ext_nonce = true,
		.frame_counter = parent.fc++,
		.src_addr = parent.eui64,
	};
	bool secure = flags & ZZB_NWK_SECURITY;
	uint8_t frame[ZZB_BUF_SIZE];
	size_t hdr_len = zzb_nwk_hdr_write(&hdr, frame);
	size_t len = hdr_len;
	psa_key_id_t id;

	if (secure) {
		len += zzb_sec_aux_hdr_write(&aux, frame + len);
	}

	memcpy(frame + len, payload, payload_len);
	len += payload_len;
	if (secure) {
		zassert_ok(zzb_sec_key_get(nwk_key, &id));
		zassert_ok(zzb_sec_frame_encrypt(id, parent.eui64, frame, hdr_len, len));
		len += ZZB_SEC_MIC_LEN;
	}

	send_mac(&mac, frame, len);
}

/* Sends cmd to the child with both IEEE addresses */
static void send_nwk_cmd(const struct zzb_nwk_cmd *cmd, bool secure)
{
	uint8_t payload[ZZB_BUF_SIZE];

	send_nwk(ZZB_NWK_FRAME_CMD,
		 ZZB_NWK_SRC_IEEE | ZZB_NWK_DST_IEEE | (secure ? ZZB_NWK_SECURITY : 0), payload,
		 zzb_nwk_cmd_write(cmd, payload));
}

/* The key of key_id derived from link_key (R22 4.5.3) */
static void frame_key(const uint8_t *link_key, enum zzb_sec_key_id key_id,
		      uint8_t key[ZZB_SEC_KEY_LEN])
{
	if (key_id == ZZB_SEC_KEY_DATA) {
		memcpy(key, link_key, ZZB_SEC_KEY_LEN);
		return;
	}

	zassert_ok(zzb_sec_hmac(link_key, key_id == ZZB_SEC_KEY_TRANSPORT ? 0x00 : 0x02, key));
}

/*
 * Writes an APS command of the trust center to p, secured with the key key_id of link_key unless
 * link_key is NULL, and returns its length
 */
static size_t write_aps_cmd(uint8_t *p, const struct zzb_aps_cmd *cmd, const uint8_t *link_key,
			    enum zzb_sec_key_id key_id)
{
	const struct zzb_aps_hdr hdr = {
		.type = ZZB_APS_FRAME_CMD,
		.flags = link_key != NULL ? ZZB_APS_SECURITY : 0,
		.counter = parent.aps_counter++,
	};
	const struct zzb_sec_aux_hdr aux = {
		.key_id = key_id,
		.ext_nonce = true,
		.frame_counter = parent.aps_fc++,
		.src_addr = parent.eui64,
	};
	size_t hdr_len = zzb_aps_hdr_write(&hdr, p);
	size_t len = hdr_len;
	uint8_t key[ZZB_SEC_KEY_LEN];
	psa_key_id_t id;

	if (link_key == NULL) {
		return len + zzb_aps_cmd_write(cmd, p + len);
	}

	len += zzb_sec_aux_hdr_write(&aux, p + len);
	len += zzb_aps_cmd_write(cmd, p + len);
	frame_key(link_key, key_id, key);
	zassert_ok(zzb_sec_key_get(key, &id));
	zassert_ok(zzb_sec_frame_encrypt(id, parent.eui64, p, hdr_len, len));
	return len + ZZB_SEC_MIC_LEN;
}

static void reply(const struct zzb_nwk_hdr *hdr, const struct zzb_nwk_cmd *cmd, bool secure)
{
	struct zzb_nwk_cmd rsp;

	switch (cmd->id) {
	case ZZB_NWK_CMD_ED_TIMEOUT_REQ:
		parent_log.ed_timeout_reqs++;
		rsp = (struct zzb_nwk_cmd){
			.id = ZZB_NWK_CMD_ED_TIMEOUT_RSP,
			.ed_timeout_rsp = {.parent_info = parent.parent_info},
		};
		send_nwk_cmd(&rsp, true);
		break;
	case ZZB_NWK_CMD_REJOIN_REQ:
		/* The child keeps its address (R22 3.6.1.4.2); the security of the request is kept
		 */
		parent_log.rejoin_reqs++;
		parent_log.rejoin_hdr = *hdr;
		parent.child_addr = hdr->src;
		parent.child_eui64 = hdr->src_ext;
		rsp = (struct zzb_nwk_cmd){
			.id = ZZB_NWK_CMD_REJOIN_RSP,
			.rejoin_rsp = {.short_addr = hdr->src},
		};
		send_nwk_cmd(&rsp, secure);
		break;
	case ZZB_NWK_CMD_LEAVE:
		parent_log.leaves++;
		break;
	default:
		break;
	}
}

/* Unsecures frame in place and handles the NWK command in it */
static void rx_nwk(uint8_t *frame, size_t len)
{
	struct zzb_sec_aux_hdr aux;
	struct zzb_nwk_hdr hdr;
	struct zzb_nwk_cmd cmd;
	int hdr_len = zzb_nwk_hdr_parse(frame, len, &hdr);
	size_t off = hdr_len;
	psa_key_id_t id;

	zassert_true(hdr_len > 0);
	if (hdr.type != ZZB_NWK_FRAME_CMD) {
		return;
	}

	if (hdr.flags & ZZB_NWK_SECURITY) {
		off += zzb_sec_aux_hdr_parse(frame + hdr_len, len - hdr_len, &aux);
		zassert_ok(zzb_sec_key_get(nwk_key, &id));
		zassert_ok(zzb_sec_frame_decrypt(id, aux.src_addr, frame, hdr_len, len));
		len -= ZZB_SEC_MIC_LEN;
	}

	zassert_true(zzb_nwk_cmd_parse(frame + off, len - off, &cmd) > 0);
	parent_log.hdr = hdr;
	parent_log.cmd = cmd;
	reply(&hdr, &cmd, hdr.flags & ZZB_NWK_SECURITY);
}

/* Runs inside the tx() of the child, so the replies reach it after the confirm */
static bool rx_cb(const uint8_t *data, size_t len)
{
	uint8_t frame[ZZB_BUF_SIZE];
	struct zzb_mac_hdr hdr;
	struct zzb_mac_cmd cmd;
	int hdr_len;

	/* The child sends the same buffer again after a missing ACK */
	memcpy(frame, data, len);
	hdr_len = zzb_mac_hdr_parse(frame, len, &hdr);
	zassert_true(hdr_len > 0);

	if (hdr.type == ZZB_MAC_FRAME_DATA) {
		rx_nwk(frame + hdr_len, len - hdr_len);
		return false;
	}

	zassert_true(zzb_mac_cmd_parse(frame + hdr_len, len - hdr_len, &cmd) > 0);
	switch (cmd.id) {
	case ZZB_MAC_CMD_BEACON_REQ:
		parent_log.beacon_reqs++;
		send_beacon();
		return false;
	case ZZB_MAC_CMD_ASSOC_REQ:
		parent.child_eui64 = hdr.src.ext_addr;
		parent.assoc_pending = true;
		return false;
	case ZZB_MAC_CMD_DATA_REQ:
		if (parent.assoc_pending) {
			parent.assoc_pending = false;
			send_assoc_rsp();
			return true;
		}

		parent_log.polls++;
		return false;
	default:
		return false;
	}
}

static void set_filter(enum ieee802154_filter_type type, struct ieee802154_filter filter)
{
	const struct ieee802154_radio_api *api = fake_radios[0]->api;

	zassert_ok(api->filter(fake_radios[0], true, type, &filter));
}

void parent_start(uint16_t short_addr, uint64_t eui64, uint16_t child_addr, uint8_t parent_info)
{
	const struct ieee802154_radio_api *api = fake_radios[0]->api;
	uint8_t ieee_addr[8];

	parent.short_addr = short_addr;
	parent.eui64 = eui64;
	parent.child_addr = child_addr;
	parent.parent_info = parent_info;
	parent.assoc_pending = false;
	memset(&parent_log, 0, sizeof(parent_log));

	sys_put_le64(eui64, ieee_addr);
	set_filter(IEEE802154_FILTER_TYPE_IEEE_ADDR,
		   (struct ieee802154_filter){.ieee_addr = ieee_addr});
	set_filter(IEEE802154_FILTER_TYPE_SHORT_ADDR,
		   (struct ieee802154_filter){.short_addr = short_addr});
	set_filter(IEEE802154_FILTER_TYPE_PAN_ID, (struct ieee802154_filter){.pan_id = PAN_ID});
	zassert_ok(api->set_channel(fake_radios[0], CHANNEL));
	fake_radio_set_rx_cb(0, rx_cb);
}

struct leave_call {
	struct k_work work;
	bool rejoin;
};

/* The key ID of zzb_sec_key_get() is valid on the stack thread only */
static void leave_handler(struct k_work *work)
{
	struct leave_call *call = CONTAINER_OF(work, struct leave_call, work);
	const struct zzb_nwk_cmd cmd = {
		.id = ZZB_NWK_CMD_LEAVE,
		.leave_options = ZZB_NWK_LEAVE_REQUEST | (call->rejoin ? ZZB_NWK_LEAVE_REJOIN : 0),
	};

	send_nwk_cmd(&cmd, true);
}

void parent_send_leave_request(bool rejoin)
{
	struct leave_call call = {
		.rejoin = rejoin,
	};

	zzb_call_sync(&call.work, leave_handler);
}

/* R22 4.6.3.2.3: the network key under the key-transport key, without NWK security */
static void transport_key_handler(struct k_work *work)
{
	struct zzb_aps_cmd cmd = {
		.id = ZZB_APS_CMD_TRANSPORT_KEY,
		.transport_key.type = ZZB_APS_KEY_NWK,
		.transport_key.dst = parent.child_eui64,
		.transport_key.src = parent.eui64,
	};
	uint8_t payload[ZZB_BUF_SIZE];

	memcpy(cmd.transport_key.key, nwk_key, ZZB_SEC_KEY_LEN);
	send_nwk(ZZB_NWK_FRAME_DATA, 0, payload,
		 write_aps_cmd(payload, &cmd, zzb_aps_default_tc_link_key, ZZB_SEC_KEY_TRANSPORT));
}

void parent_send_transport_key(void)
{
	struct k_work work;

	zzb_call_sync(&work, transport_key_handler);
}
```

## src/parent.h
```c
/* SPDX-License-Identifier: Apache-2.0 */

#ifndef ZZB_TESTS_INTEGRATION_NWK_JOIN_PARENT_H_
#define ZZB_TESTS_INTEGRATION_NWK_JOIN_PARENT_H_

#include <stdbool.h>
#include <stdint.h>

#include "aps/frame.h"
#include "nwk/frame.h"
#include "sec/mmo.h"

#define PAN_ID     0x1a62
#define EXT_PAN_ID 0x00124b0000001a62ULL
#define CHANNEL    15

/* The test keys, also in ci/check-frame-log.sh: network keys 0 and 1, trust center link key B */
extern const uint8_t nwk_key[ZZB_SEC_KEY_LEN];
extern const uint8_t nwk_key_1[ZZB_SEC_KEY_LEN];
extern const uint8_t tc_link_key_b[ZZB_SEC_KEY_LEN];

/* What the parent has received from the child */
struct parent_log {
	int beacon_reqs;
	int polls;
	int ed_timeout_reqs;
	int rejoin_reqs;
	int leaves;
	/* The last NWK command, and the header of the last rejoin request */
	struct zzb_nwk_hdr hdr;
	struct zzb_nwk_cmd cmd;
	struct zzb_nwk_hdr rejoin_hdr;
	/* The key sequence number of the last frame with NWK security */
	uint8_t nwk_key_seq;
	int aps_data;
	int aps_acks;
	/* The last APS header and command, and the frame counter of the last APS security */
	struct zzb_aps_hdr aps_hdr;
	struct zzb_aps_cmd aps_cmd;
	uint32_t aps_fc;
};

extern struct parent_log parent_log;

/*
 * Plays a parent on fake radio 0 with short_addr and eui64. It answers beacon requests,
 * associations with child_addr, End Device Timeout Requests with parent_info, and rejoin
 * requests, and clears parent_log. As the trust center it acknowledges APS data and answers
 * Request Key with key B and Verify Key with Confirm Key.
 */
void parent_start(uint16_t short_addr, uint64_t eui64, uint16_t child_addr, uint8_t parent_info);

/* Sends a leave request to the child, from the stack thread */
void parent_send_leave_request(bool rejoin);

/*
 * Plays the trust center and sends the network key to the child in a Transport Key secured with
 * the key-transport key of the default trust center link key, from the stack thread
 */
void parent_send_transport_key(void);

/* Leaves the next count APS data frames without ACK */
void parent_withhold_aps_acks(int count);

/* Sends an APS data frame with ACK request and counter, from the stack thread */
void parent_send_aps_data(uint8_t counter);

/* Sends network key 1 in a Transport Key, then a broadcast Switch Key, from the stack thread */
void parent_send_nwk_key_update(void);

#endif /* ZZB_TESTS_INTEGRATION_NWK_JOIN_PARENT_H_ */
```
