## CMakeLists.txt
```
# SPDX-License-Identifier: Apache-2.0

cmake_minimum_required(VERSION 3.20.0)

find_package(Zephyr REQUIRED HINTS $ENV{ZEPHYR_BASE})
project(zzb_unit_aps)

target_include_directories(app PRIVATE ${ZEPHYR_ZZB_MODULE_DIR}/subsys/zzb)
target_sources(app PRIVATE
  src/binding.c
  src/cmd.c
  src/data.c
  src/fakes.c
  src/frame.c
  src/group.c
  src/keys.c
  src/security.c
)
```

## prj.conf
```kconfig
# SPDX-License-Identifier: Apache-2.0

CONFIG_ZTEST=y
CONFIG_ZZB=y
# NWK is faked
CONFIG_ZZB_APS=y
# The test defines the APSDE and APSME callbacks
CONFIG_ZZB_ZDO=n
CONFIG_ZZB_NODE_COUNT=3
CONFIG_ZZB_FRAME_COUNTER_JUMP=16
CONFIG_FLASH=y
CONFIG_FLASH_MAP=y
CONFIG_NVS=y
# Every run starts with erased flash
CONFIG_NATIVE_EXTRA_CMDLINE_ARGS="--flash_in_ram"
```

## src/binding.c
```c
/* SPDX-License-Identifier: Apache-2.0 */

#include <errno.h>
#include <zephyr/settings/settings.h>
#include <zephyr/ztest.h>

#include "aps/aps.h"
#include "common/node.h"
#include "fakes.h"

static struct zzb_node *node;

static const struct zzb_aps_binding to_tc = {
	.src_ep = 1,
	.cluster = 0x0006,
	.dst_mode = ZZB_APS_ADDR_EXT,
	.dst_ext = TC_EUI64,
	.dst_ep = 1,
};

static const struct zzb_aps_binding to_group = {
	.src_ep = 1,
	.cluster = 0x0006,
	.dst_mode = ZZB_APS_ADDR_GROUP,
	.dst_addr = 0x1234,
};

static int entries(void)
{
	int count = 0;

	ARRAY_FOR_EACH_PTR(node->aps.aib.bindings, entry) {
		count += entry->in_use;
	}

	return count;
}

static void *setup(void)
{
	node = test_node(0);
	return NULL;
}

static void before(void *fixture)
{
	reset_fakes();
	/* A save scheduled by the previous test runs before the records are deleted */
	run_stack();
	zzb_aps_reset(node);
	zassert_ok(reboot(node));
}

ZTEST(zzb_aps_binding, test_bind_and_unbind)
{
	zassert_ok(zzb_apsme_bind_req(node, &to_tc));
	zassert_ok(zzb_apsme_bind_req(node, &to_group));
	/* The same binding again adds no entry */
	zassert_ok(zzb_apsme_bind_req(node, &to_tc));
	zassert_equal(entries(), 2);

	zassert_ok(zzb_apsme_unbind_req(node, &to_tc));
	zassert_equal(zzb_apsme_unbind_req(node, &to_tc), -ENOENT);
	zassert_equal(entries(), 1);
}

/* The fields of the destination address mode identify an entry */
ZTEST(zzb_aps_binding, test_entry_identity)
{
	struct zzb_aps_binding other = to_tc;

	zassert_ok(zzb_apsme_bind_req(node, &to_tc));
	other.dst_ep = 2;
	zassert_ok(zzb_apsme_bind_req(node, &other));
	zassert_equal(entries(), 2);

	/* A group entry has no destination endpoint */
	zassert_ok(zzb_apsme_bind_req(node, &to_group));
	other = to_group;
	other.dst_ep = 5;
	zassert_ok(zzb_apsme_unbind_req(node, &other));
	zassert_equal(entries(), 2);
}

ZTEST(zzb_aps_binding, test_limits)
{
	struct zzb_aps_binding binding = to_tc;

	binding.dst_mode = ZZB_APS_ADDR_SHORT;
	zassert_equal(zzb_apsme_bind_req(node, &binding), -EINVAL);

	binding.dst_mode = ZZB_APS_ADDR_EXT;
	for (int i = 0; i < CONFIG_ZZB_APS_BINDING_COUNT; i++) {
		binding.cluster = i;
		zassert_ok(zzb_apsme_bind_req(node, &binding));
	}

	binding.cluster = 0xffff;
	zassert_equal(zzb_apsme_bind_req(node, &binding), -ENOMEM);

	/* A full table accepts a binding it holds */
	binding.cluster = 0;
	zassert_ok(zzb_apsme_bind_req(node, &binding));
}

/* Poll Control checks the source of its commands with it (section 16) */
ZTEST(zzb_aps_binding, test_bound)
{
	zassert_ok(zzb_apsme_bind_req(node, &to_tc));
	/* The trust center address is unknown, so the destination does not resolve */
	zassert_false(zzb_aps_bound(node, 1, 0x0006, 0x0000, 1));

	zassert_ok(zzb_apsme_set_tc_addr(node, TC_EUI64));
	zassert_true(zzb_aps_bound(node, 1, 0x0006, 0x0000, 1));
	zassert_false(zzb_aps_bound(node, 2, 0x0006, 0x0000, 1));
	zassert_false(zzb_aps_bound(node, 1, 0x0008, 0x0000, 1));
	zassert_false(zzb_aps_bound(node, 1, 0x0006, 0x0000, 2));
	zassert_false(zzb_aps_bound(node, 1, 0x0006, 0x1234, 1));

	/* to_group has group address 0x1234 */
	zassert_ok(zzb_apsme_bind_req(node, &to_group));
	zassert_false(zzb_aps_bound(node, 1, 0x0006, 0x1234, 0));
}

/* ZHA writes bindings once, during pairing (section 14) */
ZTEST(zzb_aps_binding, test_table_survives_a_reboot)
{
	const struct zzb_aps_binding *entry = &node->aps.aib.bindings[1];

	zassert_ok(zzb_apsme_bind_req(node, &to_group));
	zassert_ok(zzb_apsme_bind_req(node, &to_tc));
	zassert_ok(zzb_apsme_unbind_req(node, &to_group));
	zassert_ok(reboot(node));

	zassert_equal(entries(), 1);
	zassert_true(entry->in_use);
	zassert_equal(entry->src_ep, 1);
	zassert_equal(entry->cluster, 0x0006);
	zassert_equal(entry->dst_mode, ZZB_APS_ADDR_EXT);
	zassert_equal(entry->dst_ext, TC_EUI64);
	zassert_equal(entry->dst_ep, 1);

	zassert_ok(zzb_apsme_bind_req(node, &to_group));
	zassert_ok(reboot(node));
	entry = &node->aps.aib.bindings[0];
	zassert_equal(entry->dst_mode, ZZB_APS_ADDR_GROUP);
	zassert_equal(entry->dst_addr, 0x1234);

	zzb_aps_reset(node);
	zassert_ok(reboot(node));
	zassert_equal(entries(), 0);
}

ZTEST(zzb_aps_binding, test_unknown_record_version)
{
	uint8_t rec[14] = {2};

	zassert_ok(settings_save_one("zzb/0/aps/bind/0", rec, sizeof(rec)));
	zassert_equal(reboot(node), -EINVAL);

	rec[0] = 1;
	zassert_ok(settings_save_one("zzb/0/aps/bind/0", rec, sizeof(rec) - 1));
	zassert_equal(reboot(node), -EINVAL);

	/* The next suite needs a node that booted */
	zassert_ok(settings_delete("zzb/0/aps/bind/0"));
	zassert_ok(reboot(node));
}

ZTEST_SUITE(zzb_aps_binding, NULL, setup, before, NULL, NULL);
```

## src/cmd.c
```c
/* SPDX-License-Identifier: Apache-2.0 */

#include <string.h>
#include <zephyr/net_buf.h>
#include <zephyr/settings/settings.h>
#include <zephyr/ztest.h>

#include "aps/aps.h"
#include "aps/frame.h"
#include "common/buf.h"
#include "common/node.h"
#include "fakes.h"
#include "sec/hmac.h"

#define CHILD_ADDR  0x1234
#define ROUTER_ADDR 0x2222

static const uint8_t nwk_key[ZZB_SEC_KEY_LEN] = {0xc0, 0xc1, 0xc2, 0xc3, 0xc4, 0xc5, 0xc6, 0xc7,
						 0xc8, 0xc9, 0xca, 0xcb, 0xcc, 0xcd, 0xce, 0xcf};

static struct zzb_node *node;
static struct zzb_node *tc;
static uint8_t tc_counter;

/* How the trust center sends a command */
struct tc_frame {
	const uint8_t *link_key;
	enum zzb_sec_key_id key_id;
	uint8_t flags;
	uint16_t nwk_src;
	uint16_t nwk_dst;
	bool nwk_security;
	bool no_ext_nonce;
};

/* The network key Transport Key of a trust center that the parent relays */
static const struct tc_frame transport = {
	.link_key = zzb_aps_default_tc_link_key,
	.key_id = ZZB_SEC_KEY_TRANSPORT,
	.flags = ZZB_APS_SECURITY,
	.nwk_src = ROUTER_ADDR,
	.nwk_dst = CHILD_ADDR,
};

static void receive_cmd_at(struct zzb_node *to, const struct zzb_aps_cmd *cmd,
			   const struct tc_frame *how)
{
	const struct zzb_aps_hdr hdr = {
		.type = ZZB_APS_FRAME_CMD,
		.flags = how->flags,
		.counter = tc_counter++,
	};
	struct net_buf *buf = zzb_buf_alloc(K_NO_WAIT);
	int err;

	zassert_not_null(buf);
	net_buf_reserve(buf, ZZB_APS_AUX_MAX_LEN);
	zzb_aps_hdr_write(&hdr, net_buf_add(buf, 2));
	net_buf_add(buf, zzb_aps_cmd_write(cmd, net_buf_tail(buf)));
	if (how->flags & ZZB_APS_SECURITY) {
		err = zzb_aps_secure(tc, buf, 2, how->link_key, how->key_id, !how->no_ext_nonce);
		zassert_ok(err);
	}

	zzb_nlde_data_ind(to, buf, how->nwk_dst, how->nwk_src, how->nwk_security);
}

static void receive_cmd(const struct zzb_aps_cmd *cmd, const struct tc_frame *how)
{
	receive_cmd_at(node, cmd, how);
}

static struct zzb_aps_cmd nwk_key_cmd(uint64_t dst, uint64_t src)
{
	struct zzb_aps_cmd cmd = {
		.id = ZZB_APS_CMD_TRANSPORT_KEY,
		.transport_key.type = ZZB_APS_KEY_NWK,
		.transport_key.seq = 1,
		.transport_key.dst = dst,
		.transport_key.src = src,
	};

	memcpy(cmd.transport_key.key, nwk_key, ZZB_SEC_KEY_LEN);
	return cmd;
}

static void check_transport_key_ind(int count, uint64_t src)
{
	zassert_equal(zzb_apsme_transport_key_ind_fake.call_count, count);
	zassert_equal_ptr(zzb_apsme_transport_key_ind_fake.arg0_val, node);
	zassert_equal(zzb_apsme_transport_key_ind_fake.arg1_val, src);
	zassert_equal(zzb_apsme_transport_key_ind_fake.arg2_val, ZZB_APS_KEY_NWK);
	zassert_equal(zzb_apsme_transport_key_ind_fake.arg4_val, 1);
	zassert_mem_equal(transported_key, nwk_key, ZZB_SEC_KEY_LEN);
}

static void *setup(void)
{
	node = test_node(0);
	tc = test_node(1);
	return NULL;
}

static void before(void *fixture)
{
	reset_fakes();
	zzb_aps_reset(node);
	zzb_nwk_key_pending_fake.return_val = true;
}

static void after(void *fixture)
{
	check_no_buffer_leak();
}

/* The zigbee-rs frame of tests/unit/sec (see NOTICE), without NWK security */
ZTEST(zzb_aps_cmd, test_captured_transport_key)
{
	static const uint8_t frame[] = {
		0x21, 0x95, 0x30, 0x00, 0x00, 0x00, 0x00, 0xe1, 0x52, 0x38, 0x7d, 0xc1, 0x36, 0xce,
		0xf4, 0xcc, 0x56, 0x50, 0x5e, 0x07, 0x2d, 0xc5, 0xc1, 0xe8, 0x40, 0xf2, 0xd5, 0xce,
		0x0c, 0xa9, 0x2d, 0x64, 0x23, 0xcc, 0x0c, 0x56, 0xcc, 0xc4, 0xcc, 0x0f, 0x18, 0xa2,
		0xe4, 0x82, 0x88, 0x58, 0x4a, 0x90, 0x3e, 0x00, 0x47, 0x60, 0xf2, 0x5d,
	};
	static const uint8_t key[] = {0xab, 0xcd, 0xef, 0x01, 0x23, 0x45, 0x67, 0x89};
	struct net_buf *buf = zzb_buf_alloc(K_NO_WAIT);

	net_buf_add_mem(buf, frame, sizeof(frame));
	zzb_nlde_data_ind(node, buf, CHILD_ADDR, 0x0000, false);

	zassert_equal(zzb_apsme_transport_key_ind_fake.call_count, 1);
	zassert_equal(zzb_apsme_transport_key_ind_fake.arg1_val, TC_EUI64);
	zassert_equal(zzb_apsme_transport_key_ind_fake.arg2_val, ZZB_APS_KEY_NWK);
	zassert_equal(zzb_apsme_transport_key_ind_fake.arg4_val, 0);
	zassert_mem_equal(transported_key, key, sizeof(key));
	zassert_equal(zzb_nlde_data_req_fake.call_count, 0);
	zassert_equal(zzb_nwk_poll_fast_fake.call_count, 0);
}

static int ind_nlde_calls;

static void transport_key_ind_count(struct zzb_node *n, uint64_t src_addr,
				    enum zzb_aps_key_type type, const uint8_t *key, uint8_t seq)
{
	ind_nlde_calls = zzb_nlde_data_req_fake.call_count;
}

/*
 * R23 4.4.11: a trust center that is the parent requests an ACK. It follows the indication, in
 * which ZDO sets the network key that secures it.
 */
ZTEST(zzb_aps_cmd, test_transport_key_with_ack_request)
{
	struct zzb_aps_cmd cmd = nwk_key_cmd(NODE_EUI64, TC_EUI64);
	struct tc_frame how = transport;
	struct zzb_aps_hdr hdr;

	how.flags |= ZZB_APS_ACK_REQ;
	how.nwk_src = 0x0000;
	zzb_apsme_transport_key_ind_fake.custom_fake = transport_key_ind_count;
	receive_cmd(&cmd, &how);

	zassert_equal(zzb_apsme_transport_key_ind_fake.call_count, 1);
	zassert_equal(ind_nlde_calls, 0);
	zassert_equal(zzb_nlde_data_req_fake.call_count, 1);
	zassert_equal(zzb_nlde_data_req_fake.arg2_val, 0x0000);
	zassert_true(zzb_nlde_data_req_fake.arg4_val);
	zassert_true(zzb_aps_hdr_parse(sent[0].data, sent[0].len, &hdr) > 0);
	zassert_equal(hdr.type, ZZB_APS_FRAME_ACK);
	zassert_equal(hdr.flags, ZZB_APS_ACK_FORMAT | ZZB_APS_SECURITY);
}

/*
 * BDB 6.4: a node with an install code takes the network key under the install code key or under
 * the default key. The trust center entry gets the key that decrypted it (R22 4.6.3.1).
 */
ZTEST(zzb_aps_cmd, test_transport_key_with_an_install_code)
{
	struct zzb_node *ic_node = test_node(2);
	struct zzb_aps_cmd cmd = nwk_key_cmd(IC_NODE_EUI64, TC_EUI64);
	struct tc_frame how = transport;
	const struct zzb_aps_key_pair *pair;

	zzb_aps_reset(ic_node);
	how.link_key = install_code_key;
	receive_cmd_at(ic_node, &cmd, &how);
	zassert_equal(zzb_apsme_transport_key_ind_fake.call_count, 1);
	zassert_ok(zzb_apsme_set_tc_addr(ic_node, TC_EUI64));
	pair = zzb_aps_key_pair_find(ic_node, TC_EUI64);
	zassert_mem_equal(pair->key, install_code_key, ZZB_SEC_KEY_LEN);
	zassert_equal(pair->type, ZZB_APS_LINK_KEY_UNIQUE);
	zassert_equal(pair->attr, ZZB_APS_KEY_PROVISIONAL);

	/* A network that does not know the install code */
	zzb_aps_reset(ic_node);
	how.link_key = zzb_aps_default_tc_link_key;
	receive_cmd_at(ic_node, &cmd, &how);
	zassert_equal(zzb_apsme_transport_key_ind_fake.call_count, 2);
	zassert_ok(zzb_apsme_set_tc_addr(ic_node, TC_EUI64));
	pair = zzb_aps_key_pair_find(ic_node, TC_EUI64);
	zassert_mem_equal(pair->key, zzb_aps_default_tc_link_key, ZZB_SEC_KEY_LEN);
	zassert_equal(pair->type, ZZB_APS_LINK_KEY_GLOBAL);

	/* Neither key */
	zzb_aps_reset(ic_node);
	how.link_key = key_b;
	receive_cmd_at(ic_node, &cmd, &how);
	zassert_equal(zzb_apsme_transport_key_ind_fake.call_count, 2);
}

/* The ACK of a frame decrypted with a preconfigured key is secured with the same key */
ZTEST(zzb_aps_cmd, test_ack_under_the_install_code_key)
{
	struct zzb_node *ic_node = test_node(2);
	struct zzb_aps_cmd cmd = nwk_key_cmd(IC_NODE_EUI64, TC_EUI64);
	struct tc_frame how = transport;
	struct zzb_aps_sec sec;
	struct net_buf *buf;

	zzb_aps_reset(ic_node);
	how.link_key = install_code_key;
	how.flags |= ZZB_APS_ACK_REQ;
	how.nwk_src = 0x0000;
	receive_cmd_at(ic_node, &cmd, &how);
	zassert_equal(zzb_nlde_data_req_fake.call_count, 1);

	zassert_ok(zzb_apsme_set_link_key(tc, IC_NODE_EUI64, install_code_key, ZZB_APS_KEY_VERIFIED,
					  ZZB_APS_LINK_KEY_UNIQUE));
	buf = zzb_buf_alloc(K_NO_WAIT);
	net_buf_add_mem(buf, sent[0].data, sent[0].len);
	zassert_ok(zzb_aps_unsecure(tc, buf, 2, CHILD_ADDR, &sec));
	zassert_equal(sec.src_addr, IC_NODE_EUI64);
	net_buf_unref(buf);
	zzb_aps_reset(tc);
}

/* Under a router parent the NWK source is the parent (R22 4.6.3.2.4) */
ZTEST(zzb_aps_cmd, test_transport_key_through_a_router)
{
	struct zzb_aps_cmd cmd = nwk_key_cmd(NODE_EUI64, TC_EUI64);

	receive_cmd(&cmd, &transport);
	check_transport_key_ind(1, TC_EUI64);

	/* A broadcast network key has an all-zero destination address field */
	cmd = nwk_key_cmd(0, TC_EUI64);
	receive_cmd(&cmd, &transport);
	check_transport_key_ind(2, TC_EUI64);
}

/* Z-Stack Home 1.2: the parent sends the key without the extended nonce */
ZTEST(zzb_aps_cmd, test_transport_key_without_extended_nonce)
{
	struct zzb_aps_cmd cmd = nwk_key_cmd(NODE_EUI64, TC_EUI64);
	struct zzb_nwk_neighbor parent = {
		.in_use = true,
		.ext_addr = TC_EUI64,
		.relationship = ZZB_NWK_REL_PARENT,
	};
	struct tc_frame how = transport;

	how.nwk_src = 0x0000;
	how.no_ext_nonce = true;
	zzb_nwk_neighbor_find_short_fake.return_val = &parent;
	receive_cmd(&cmd, &how);
	check_transport_key_ind(1, TC_EUI64);
}

/* BDB 10.2.2: once the trust center is known, other sources are dropped */
ZTEST(zzb_aps_cmd, test_transport_key_from_another_trust_center)
{
	struct zzb_aps_cmd cmd = nwk_key_cmd(NODE_EUI64, TC_EUI64);

	zassert_ok(zzb_apsme_set_tc_addr(node, 0x00124b0000000001ULL));
	receive_cmd(&cmd, &transport);
	zassert_equal(zzb_apsme_transport_key_ind_fake.call_count, 0);
}

ZTEST(zzb_aps_cmd, test_rejected_transport_keys)
{
	struct zzb_aps_cmd cmd = nwk_key_cmd(0x0011223344556677ULL, TC_EUI64);
	struct tc_frame how = transport;

	/* For another device */
	receive_cmd(&cmd, &transport);

	/* Distributed security is excluded */
	cmd = nwk_key_cmd(NODE_EUI64, UINT64_MAX);
	receive_cmd(&cmd, &transport);

	/* The source address field must be the device that secured the command */
	cmd = nwk_key_cmd(NODE_EUI64, 0x00124b0000000001ULL);
	receive_cmd(&cmd, &transport);

	/* A network key comes under the key-transport key (R22 4.4.1.1 step 1) */
	cmd = nwk_key_cmd(NODE_EUI64, TC_EUI64);
	how.key_id = ZZB_SEC_KEY_DATA;
	receive_cmd(&cmd, &how);

	/* R22 4.4.1.5: a device with a preconfigured key needs APS security */
	how = transport;
	how.flags = 0;
	how.nwk_security = true;
	receive_cmd(&cmd, &how);

	zassert_equal(zzb_apsme_transport_key_ind_fake.call_count, 0);
}

/* R22 4.4.1.5: a NWK broadcast from the trust center with NWK security only */
ZTEST(zzb_aps_cmd, test_network_key_update_without_aps_security)
{
	struct zzb_aps_cmd cmd = nwk_key_cmd(0, TC_EUI64);
	struct tc_frame how = {
		.nwk_src = 0x0000,
		.nwk_dst = 0xfffd,
		.nwk_security = true,
	};

	zassert_ok(zzb_apsme_set_tc_addr(node, TC_EUI64));
	receive_cmd(&cmd, &how);
	zassert_equal(zzb_apsme_transport_key_ind_fake.call_count, 0, "network key pending");

	zzb_nwk_key_pending_fake.return_val = false;
	receive_cmd(&cmd, &how);
	check_transport_key_ind(1, TC_EUI64);

	how.nwk_dst = CHILD_ADDR;
	receive_cmd(&cmd, &how);
	zassert_equal(zzb_apsme_transport_key_ind_fake.call_count, 1, "unicast");
}

ZTEST(zzb_aps_cmd, test_repeated_transport_key)
{
	struct zzb_aps_cmd cmd = nwk_key_cmd(NODE_EUI64, TC_EUI64);

	receive_cmd(&cmd, &transport);
	tc_counter--;
	receive_cmd(&cmd, &transport);
	zassert_equal(zzb_apsme_transport_key_ind_fake.call_count, 1);
}

/* The trust center link key of BDB 10.2.5 step 8, under the key-load key of key A */
static const struct tc_frame key_load = {
	.link_key = zzb_aps_default_tc_link_key,
	.key_id = ZZB_SEC_KEY_LOAD,
	.flags = ZZB_APS_SECURITY,
	.nwk_src = 0x0000,
	.nwk_dst = CHILD_ADDR,
	.nwk_security = true,
};

static struct zzb_aps_cmd tc_link_key_cmd(uint64_t dst)
{
	struct zzb_aps_cmd cmd = {
		.id = ZZB_APS_CMD_TRANSPORT_KEY,
		.transport_key.type = ZZB_APS_KEY_TC_LINK,
		.transport_key.dst = dst,
		.transport_key.src = TC_EUI64,
	};

	memcpy(cmd.transport_key.key, key_b, ZZB_SEC_KEY_LEN);
	return cmd;
}

/* The node joined: the trust center is known and the network key is set */
static void authorize(void)
{
	zassert_ok(zzb_apsme_set_tc_addr(node, TC_EUI64));
	zzb_nwk_key_pending_fake.return_val = false;
}

ZTEST(zzb_aps_cmd, test_trust_center_link_key)
{
	struct zzb_aps_cmd cmd = tc_link_key_cmd(NODE_EUI64);

	authorize();
	receive_cmd(&cmd, &key_load);
	zassert_equal(zzb_apsme_transport_key_ind_fake.call_count, 1);
	zassert_equal(zzb_apsme_transport_key_ind_fake.arg1_val, TC_EUI64);
	zassert_equal(zzb_apsme_transport_key_ind_fake.arg2_val, ZZB_APS_KEY_TC_LINK);
	zassert_mem_equal(transported_key, key_b, ZZB_SEC_KEY_LEN);
}

ZTEST(zzb_aps_cmd, test_rejected_trust_center_link_keys)
{
	struct zzb_aps_cmd cmd = tc_link_key_cmd(NODE_EUI64);
	struct tc_frame how = key_load;

	/* Only a joined and authorized node takes it (R22 4.4.2.3) */
	zassert_ok(zzb_apsme_set_tc_addr(node, TC_EUI64));
	receive_cmd(&cmd, &key_load);

	/* A link key comes under the key-load key (R22 4.4.1.1 step 1) */
	zzb_nwk_key_pending_fake.return_val = false;
	how.key_id = ZZB_SEC_KEY_TRANSPORT;
	receive_cmd(&cmd, &how);

	/* The all-zero destination belongs to a network key */
	cmd = tc_link_key_cmd(0);
	receive_cmd(&cmd, &key_load);

	zassert_equal(zzb_apsme_transport_key_ind_fake.call_count, 0);
}

static const struct zzb_aps_cmd switch_key = {
	.id = ZZB_APS_CMD_SWITCH_KEY,
	.switch_key_seq = 1,
};

/* R22 4.4.1.3: without APS security the trust center is NWK address 0x0000 */
ZTEST(zzb_aps_cmd, test_switch_key)
{
	struct tc_frame how = {
		.nwk_src = 0x0000,
		.nwk_dst = 0xfffd,
		.nwk_security = true,
	};

	authorize();
	receive_cmd(&switch_key, &how);
	zassert_equal(zzb_apsme_switch_key_ind_fake.call_count, 1);
	zassert_equal_ptr(zzb_apsme_switch_key_ind_fake.arg0_val, node);
	zassert_equal(zzb_apsme_switch_key_ind_fake.arg1_val, TC_EUI64);
	zassert_equal(zzb_apsme_switch_key_ind_fake.arg2_val, 1);

	how.nwk_src = ROUTER_ADDR;
	receive_cmd(&switch_key, &how);
	zassert_equal(zzb_apsme_switch_key_ind_fake.call_count, 1);

	/* With APS security the key identifies the trust center */
	how.link_key = zzb_aps_default_tc_link_key;
	how.key_id = ZZB_SEC_KEY_DATA;
	how.flags = ZZB_APS_SECURITY;
	receive_cmd(&switch_key, &how);
	zassert_equal(zzb_apsme_switch_key_ind_fake.call_count, 2);
}

ZTEST(zzb_aps_cmd, test_rejected_switch_keys)
{
	struct tc_frame how = {
		.link_key = zzb_aps_default_tc_link_key,
		.key_id = ZZB_SEC_KEY_DATA,
		.flags = ZZB_APS_SECURITY,
		.nwk_src = 0x0000,
		.nwk_dst = 0xfffd,
	};

	/* Without NWK security only a Transport Key is accepted */
	authorize();
	receive_cmd(&switch_key, &how);

	/* While the network key is pending */
	how.nwk_security = true;
	zzb_nwk_key_pending_fake.return_val = true;
	receive_cmd(&switch_key, &how);

	zassert_equal(zzb_apsme_switch_key_ind_fake.call_count, 0);
}

/* Parses the command of sent frame i, removing its APS security at the trust center */
static void parse_sent_cmd(int i, struct zzb_aps_hdr *hdr, struct zzb_aps_cmd *cmd)
{
	struct net_buf *buf = zzb_buf_alloc(K_NO_WAIT);
	struct zzb_aps_sec sec;
	int hdr_len;

	net_buf_add_mem(buf, sent[i].data, sent[i].len);
	hdr_len = zzb_aps_hdr_parse(buf->data, buf->len, hdr);
	zassert_equal(hdr_len, 2);
	if (hdr->flags & ZZB_APS_SECURITY) {
		zassert_ok(zzb_aps_unsecure(tc, buf, hdr_len, CHILD_ADDR, &sec));
		zassert_equal(sec.key_id, ZZB_SEC_KEY_DATA);
		zassert_equal(sec.src_addr, NODE_EUI64);
	}

	zassert_true(zzb_aps_cmd_parse(buf->data + hdr_len, buf->len - hdr_len, cmd) > 0);
	net_buf_unref(buf);
}

/* BDB 10.2.5 step 7: Request Key under key A; R22 4.4.10 sends commands without ACK request */
ZTEST(zzb_aps_cmd, test_request_key)
{
	uint8_t counter = node->aps.counter;
	struct zzb_aps_hdr hdr;
	struct zzb_aps_cmd cmd;

	authorize();
	zzb_aps_reset(tc);
	zassert_ok(zzb_apsme_set_link_key(tc, NODE_EUI64, zzb_aps_default_tc_link_key,
					  ZZB_APS_KEY_PROVISIONAL, ZZB_APS_LINK_KEY_GLOBAL));
	zassert_ok(zzb_apsme_request_key_req(node, TC_EUI64));

	zassert_equal(zzb_nlde_data_req_fake.call_count, 1);
	zassert_equal(zzb_nlde_data_req_fake.arg2_val, 0x0000);
	zassert_true(zzb_nlde_data_req_fake.arg4_val);
	zassert_equal(sent[0].meta.handle, 0xef);
	parse_sent_cmd(0, &hdr, &cmd);
	zassert_equal(hdr.type, ZZB_APS_FRAME_CMD);
	zassert_equal(hdr.flags, ZZB_APS_SECURITY);
	zassert_equal(hdr.counter, counter);
	zassert_equal(node->aps.counter, (uint8_t)(counter + 1));
	zassert_equal(cmd.id, ZZB_APS_CMD_REQUEST_KEY);
	zassert_equal(cmd.request_key.type, ZZB_APS_REQUEST_TC_LINK);
}

ZTEST(zzb_aps_cmd, test_rejected_key_requests)
{
	zassert_equal(zzb_apsme_request_key_req(node, TC_EUI64), -EINVAL, "no trust center");

	authorize();
	zassert_equal(zzb_apsme_request_key_req(node, 0x00124b0000000001ULL), -EINVAL);

	/* R22 4.4.1.1 step 1: an unverified key does not encrypt */
	zassert_ok(zzb_apsme_set_link_key(node, TC_EUI64, key_b, ZZB_APS_KEY_UNVERIFIED,
					  ZZB_APS_LINK_KEY_UNIQUE));
	zassert_equal(zzb_apsme_request_key_req(node, TC_EUI64), -ENOENT);
	zassert_equal(zzb_nlde_data_req_fake.call_count, 0);
}

/* BDB 10.2.5 step 11: the hash of key B, without APS security (R22 4.4.7.1.3) */
ZTEST(zzb_aps_cmd, test_verify_key)
{
	uint8_t hash[ZZB_SEC_KEY_LEN];
	struct zzb_aps_hdr hdr;
	struct zzb_aps_cmd cmd;

	authorize();
	zassert_ok(zzb_apsme_set_link_key(node, TC_EUI64, key_b, ZZB_APS_KEY_UNVERIFIED,
					  ZZB_APS_LINK_KEY_UNIQUE));
	zassert_ok(zzb_apsme_verify_key_req(node, TC_EUI64, ZZB_APS_KEY_TC_LINK));

	zassert_equal(zzb_nlde_data_req_fake.arg2_val, 0x0000);
	parse_sent_cmd(0, &hdr, &cmd);
	zassert_equal(hdr.flags, 0);
	zassert_equal(cmd.id, ZZB_APS_CMD_VERIFY_KEY);
	zassert_equal(cmd.verify_key.type, ZZB_APS_KEY_TC_LINK);
	zassert_equal(cmd.verify_key.src, NODE_EUI64);
	zassert_ok(zzb_sec_hmac(key_b, 0x03, hash));
	zassert_mem_equal(cmd.verify_key.hash, hash, ZZB_SEC_KEY_LEN);
}

ZTEST(zzb_aps_cmd, test_rejected_verify_keys)
{
	zassert_equal(zzb_apsme_verify_key_req(node, TC_EUI64, ZZB_APS_KEY_TC_LINK), -EINVAL,
		      "no trust center");

	authorize();
	zassert_equal(zzb_apsme_verify_key_req(node, TC_EUI64, ZZB_APS_KEY_NWK), -EINVAL);
	zassert_equal(zzb_apsme_verify_key_req(node, 0x00124b0000000001ULL, ZZB_APS_KEY_TC_LINK),
		      -EINVAL);

	zzb_aps_reset(node);
	node->aps.aib.tc_addr = TC_EUI64;
	zassert_equal(zzb_apsme_verify_key_req(node, TC_EUI64, ZZB_APS_KEY_TC_LINK), -ENOENT);
	zassert_equal(zzb_nlde_data_req_fake.call_count, 0);
}

/* The Confirm Key of BDB 10.2.5 step 12, under key B */
static const struct tc_frame confirm = {
	.link_key = key_b,
	.key_id = ZZB_SEC_KEY_DATA,
	.flags = ZZB_APS_SECURITY,
	.nwk_src = 0x0000,
	.nwk_dst = CHILD_ADDR,
	.nwk_security = true,
};

static struct zzb_aps_cmd confirm_key_cmd(uint8_t status, uint64_t dst)
{
	return (struct zzb_aps_cmd){
		.id = ZZB_APS_CMD_CONFIRM_KEY,
		.confirm_key.status = status,
		.confirm_key.type = ZZB_APS_KEY_TC_LINK,
		.confirm_key.dst = dst,
	};
}

/* The node holds key B, not verified yet */
static struct zzb_aps_key_pair *install_key_b(void)
{
	authorize();
	zassert_ok(zzb_apsme_set_link_key(node, TC_EUI64, key_b, ZZB_APS_KEY_UNVERIFIED,
					  ZZB_APS_LINK_KEY_UNIQUE));
	return zzb_aps_key_pair_find(node, TC_EUI64);
}

/* R22 4.4.8.2.3 */
ZTEST(zzb_aps_cmd, test_confirm_key)
{
	struct zzb_aps_key_pair *pair = install_key_b();
	struct zzb_aps_cmd cmd = confirm_key_cmd(0x00, NODE_EUI64);
	uint8_t rec[27];

	receive_cmd(&cmd, &confirm);
	zassert_equal(pair->attr, ZZB_APS_KEY_VERIFIED);
	zassert_equal(pair->in_fc, 0);
	zassert_equal(settings_load_one("zzb/0/aps/key/0", rec, sizeof(rec)), sizeof(rec));
	zassert_equal(rec[9], ZZB_APS_KEY_VERIFIED);

	zassert_equal(zzb_apsme_confirm_key_ind_fake.call_count, 1);
	zassert_equal_ptr(zzb_apsme_confirm_key_ind_fake.arg0_val, node);
	zassert_equal(zzb_apsme_confirm_key_ind_fake.arg1_val, 0x00);
	zassert_equal(zzb_apsme_confirm_key_ind_fake.arg2_val, TC_EUI64);
	zassert_equal(zzb_apsme_confirm_key_ind_fake.arg3_val, ZZB_APS_KEY_TC_LINK);
}

ZTEST(zzb_aps_cmd, test_confirm_key_with_a_failure_status)
{
	struct zzb_aps_key_pair *pair = install_key_b();
	struct zzb_aps_cmd cmd = confirm_key_cmd(0xad, NODE_EUI64);

	receive_cmd(&cmd, &confirm);
	zassert_equal(pair->attr, ZZB_APS_KEY_UNVERIFIED);
	zassert_equal(zzb_apsme_confirm_key_ind_fake.call_count, 1);
	zassert_equal(zzb_apsme_confirm_key_ind_fake.arg1_val, 0xad);
}

ZTEST(zzb_aps_cmd, test_rejected_confirm_keys)
{
	struct zzb_aps_key_pair *pair = install_key_b();
	struct zzb_aps_cmd cmd = confirm_key_cmd(0x00, NODE_EUI64);
	struct tc_frame how = confirm;

	/* R22 4.4.8.2.3 step 1 */
	how.nwk_dst = 0xfffd;
	receive_cmd(&cmd, &how);

	/* R22 Table 4-6: APS security is required */
	how = confirm;
	how.flags = 0;
	receive_cmd(&cmd, &how);

	cmd = confirm_key_cmd(0x00, 0x0011223344556677ULL);
	receive_cmd(&cmd, &confirm);

	zassert_equal(pair->attr, ZZB_APS_KEY_UNVERIFIED);
	zassert_equal(zzb_apsme_confirm_key_ind_fake.call_count, 0);
}

ZTEST_SUITE(zzb_aps_cmd, NULL, setup, before, after, NULL);
```

## src/fakes.c
```c
/* SPDX-License-Identifier: Apache-2.0 */

#include <errno.h>
#include <string.h>
#include <zephyr/fff.h>
#include <zephyr/ztest.h>
#include <zzb/zzb.h>

#include "common/node.h"
#include "common/queue.h"
#include "fakes.h"
#include "storage/settings.h"

DEFINE_FFF_GLOBALS;

DEFINE_FAKE_VALUE_FUNC(bool, zzb_nwk_key_pending, const struct zzb_node *);
DEFINE_FAKE_VALUE_FUNC(int, zzb_nlde_data_req, struct zzb_node *, struct net_buf *, uint16_t,
		       uint8_t, bool);
DEFINE_FAKE_VALUE_FUNC(struct zzb_nwk_neighbor *, zzb_nwk_neighbor_find_short, struct zzb_node *,
		       uint16_t);
DEFINE_FAKE_VALUE_FUNC(struct zzb_nwk_neighbor *, zzb_nwk_neighbor_find_ext, struct zzb_node *,
		       uint64_t);
DEFINE_FAKE_VALUE_FUNC(int, zzb_nwk_addr_map_find, struct zzb_node *, uint64_t, uint16_t *);
DEFINE_FAKE_VALUE_FUNC(uint64_t, zzb_nwk_addr_map_ext, struct zzb_node *, uint16_t);
DEFINE_FAKE_VOID_FUNC(zzb_nwk_poll_hold, struct zzb_node *, enum zzb_nwk_hold, bool);
DEFINE_FAKE_VOID_FUNC(zzb_nwk_poll_fast, struct zzb_node *);
DEFINE_FAKE_VOID_FUNC(zzb_apsde_data_conf, struct zzb_node *, uint8_t, uint8_t);
DEFINE_FAKE_VOID_FUNC(zzb_apsde_data_ind, struct zzb_node *, struct net_buf *,
		      const struct zzb_apsde_ind *);
DEFINE_FAKE_VOID_FUNC(zzb_apsme_transport_key_ind, struct zzb_node *, uint64_t,
		      enum zzb_aps_key_type, const uint8_t *, uint8_t);
DEFINE_FAKE_VOID_FUNC(zzb_apsme_switch_key_ind, struct zzb_node *, uint64_t, uint8_t);
DEFINE_FAKE_VOID_FUNC(zzb_apsme_confirm_key_ind, struct zzb_node *, uint8_t, uint64_t,
		      enum zzb_aps_key_type);

struct frame_copy sent[8];
struct frame_copy data_ind;
struct zzb_apsde_ind ind;
uint8_t transported_key[ZZB_SEC_KEY_LEN];

const uint8_t key_b[ZZB_SEC_KEY_LEN] = {
	0x10, 0x11, 0x12, 0x13, 0x14, 0x15, 0x16, 0x17,
	0x18, 0x19, 0x1a, 0x1b, 0x1c, 0x1d, 0x1e, 0x1f,
};

static void copy_frame(struct frame_copy *copy, struct net_buf *buf)
{
	zassert_true(buf->len <= sizeof(copy->data));
	memcpy(copy->data, buf->data, buf->len);
	copy->len = buf->len;
	copy->meta = *zzb_frame_meta(buf);
}

static int nlde_data_req_take(struct zzb_node *node, struct net_buf *buf, uint16_t dst_addr,
			      uint8_t radius, bool secure)
{
	zassert_true(zzb_nlde_data_req_fake.call_count <= ARRAY_SIZE(sent));
	copy_frame(&sent[zzb_nlde_data_req_fake.call_count - 1], buf);
	net_buf_unref(buf);
	return 0;
}

static void apsde_data_ind_take(struct zzb_node *node, struct net_buf *buf,
				const struct zzb_apsde_ind *params)
{
	copy_frame(&data_ind, buf);
	ind = *params;
	net_buf_unref(buf);
}

static void transport_key_ind_copy(struct zzb_node *node, uint64_t src_addr,
				   enum zzb_aps_key_type type, const uint8_t *key, uint8_t seq)
{
	memcpy(transported_key, key, ZZB_SEC_KEY_LEN);
}

/* BDB 10.1.1: "83FE D340 7A93 9723 A5C6 39B2 6916 D505 C3B5" and the key of BDB 10.1.2 */
static const uint8_t install_code[] = {
	0x83, 0xfe, 0xd3, 0x40, 0x7a, 0x93, 0x97, 0x23, 0xa5,
	0xc6, 0x39, 0xb2, 0x69, 0x16, 0xd5, 0x05, 0xc3, 0xb5,
};

const uint8_t install_code_key[ZZB_SEC_KEY_LEN] = {
	0x66, 0xb6, 0x90, 0x09, 0x81, 0xe1, 0xee, 0x3c,
	0xa4, 0x20, 0x6b, 0x6b, 0x86, 0x1c, 0x02, 0xbb,
};

struct zzb_node *test_node(int index)
{
	static const uint64_t eui64[] = {NODE_EUI64, TC_EUI64, IC_NODE_EUI64};
	static struct zzb_node *nodes[ARRAY_SIZE(eui64)];

	if (nodes[0] == NULL) {
		ARRAY_FOR_EACH(nodes, i) {
			const struct zzb_node_config cfg = {
				.eui64 = eui64[i],
				.install_code = eui64[i] == IC_NODE_EUI64 ? install_code : NULL,
				.install_code_len = sizeof(install_code),
			};

			zassert_ok(zzb_node_init(&cfg, &nodes[i]));
		}
	}

	return nodes[index];
}

void reset_fakes(void)
{
	RESET_FAKE(zzb_nwk_key_pending);
	RESET_FAKE(zzb_nlde_data_req);
	RESET_FAKE(zzb_nwk_neighbor_find_short);
	RESET_FAKE(zzb_nwk_neighbor_find_ext);
	RESET_FAKE(zzb_nwk_addr_map_find);
	RESET_FAKE(zzb_nwk_addr_map_ext);
	RESET_FAKE(zzb_nwk_poll_hold);
	RESET_FAKE(zzb_nwk_poll_fast);
	RESET_FAKE(zzb_apsde_data_conf);
	RESET_FAKE(zzb_apsde_data_ind);
	RESET_FAKE(zzb_apsme_transport_key_ind);
	RESET_FAKE(zzb_apsme_switch_key_ind);
	RESET_FAKE(zzb_apsme_confirm_key_ind);
	FFF_RESET_HISTORY();

	zzb_nlde_data_req_fake.custom_fake = nlde_data_req_take;
	zzb_nwk_addr_map_find_fake.return_val = -ENOENT;
	zzb_apsde_data_ind_fake.custom_fake = apsde_data_ind_take;
	zzb_apsme_transport_key_ind_fake.custom_fake = transport_key_ind_copy;
}

void check_no_buffer_leak(void)
{
	struct net_buf *bufs[CONFIG_ZZB_BUF_COUNT];

	ARRAY_FOR_EACH(bufs, i) {
		bufs[i] = zzb_buf_alloc(K_NO_WAIT);
		zassert_not_null(bufs[i], "buffer leak");
	}

	ARRAY_FOR_EACH(bufs, i) {
		net_buf_unref(bufs[i]);
	}
}

struct reboot_call {
	struct k_work work;
	struct zzb_node *node;
	int err;
};

static void reboot_handler(struct k_work *work)
{
	struct reboot_call *call = CONTAINER_OF(work, struct reboot_call, work);

	zzb_aps_init(call->node);
	call->err = zzb_settings_load(call->node);
	if (call->err == 0) {
		call->err = zzb_fc_start(&call->node->aps.fc);
	}
}

int reboot(struct zzb_node *node)
{
	struct reboot_call call = {.node = node};

	zzb_call_sync(&call.work, reboot_handler);
	return call.err;
}

/* The test thread is cooperative and has a lower priority than the stack thread */
void run_stack(void)
{
	k_yield();
}
```

## src/fakes.h
```c
/* SPDX-License-Identifier: Apache-2.0 */

#ifndef ZZB_TESTS_UNIT_APS_FAKES_H_
#define ZZB_TESTS_UNIT_APS_FAKES_H_

#include <stddef.h>
#include <stdint.h>
#include <zephyr/fff.h>
#include <zephyr/net_buf.h>

#include "aps/aps.h"
#include "common/buf.h"
#include "nwk/nwk.h"
#include "sec/mmo.h"

DECLARE_FAKE_VALUE_FUNC(bool, zzb_nwk_key_pending, const struct zzb_node *);
DECLARE_FAKE_VALUE_FUNC(int, zzb_nlde_data_req, struct zzb_node *, struct net_buf *, uint16_t,
			uint8_t, bool);
DECLARE_FAKE_VALUE_FUNC(struct zzb_nwk_neighbor *, zzb_nwk_neighbor_find_short, struct zzb_node *,
			uint16_t);
DECLARE_FAKE_VALUE_FUNC(struct zzb_nwk_neighbor *, zzb_nwk_neighbor_find_ext, struct zzb_node *,
			uint64_t);
DECLARE_FAKE_VALUE_FUNC(int, zzb_nwk_addr_map_find, struct zzb_node *, uint64_t, uint16_t *);
DECLARE_FAKE_VALUE_FUNC(uint64_t, zzb_nwk_addr_map_ext, struct zzb_node *, uint16_t);
DECLARE_FAKE_VOID_FUNC(zzb_nwk_poll_hold, struct zzb_node *, enum zzb_nwk_hold, bool);
DECLARE_FAKE_VOID_FUNC(zzb_nwk_poll_fast, struct zzb_node *);
DECLARE_FAKE_VOID_FUNC(zzb_apsde_data_conf, struct zzb_node *, uint8_t, uint8_t);
DECLARE_FAKE_VOID_FUNC(zzb_apsde_data_ind, struct zzb_node *, struct net_buf *,
		       const struct zzb_apsde_ind *);
DECLARE_FAKE_VOID_FUNC(zzb_apsme_transport_key_ind, struct zzb_node *, uint64_t,
		       enum zzb_aps_key_type, const uint8_t *, uint8_t);
DECLARE_FAKE_VOID_FUNC(zzb_apsme_switch_key_ind, struct zzb_node *, uint64_t, uint8_t);
DECLARE_FAKE_VOID_FUNC(zzb_apsme_confirm_key_ind, struct zzb_node *, uint8_t, uint64_t,
		       enum zzb_aps_key_type);

/* Copy of a frame passed to NLDE-DATA.request or APSDE-DATA.indication */
struct frame_copy {
	uint8_t data[ZZB_BUF_SIZE];
	size_t len;
	struct zzb_frame_meta meta;
};

/* By default the zzb_nlde_data_req() fake takes the buffer and copies the frame here */
extern struct frame_copy sent[8];

/* The ASDU and the parameters of the last APSDE-DATA.indication */
extern struct frame_copy data_ind;
extern struct zzb_apsde_ind ind;

/* The key of the last APSME-TRANSPORT-KEY.indication */
extern uint8_t transported_key[ZZB_SEC_KEY_LEN];

/* Checks that every frame buffer is free */
void check_no_buffer_leak(void);

/* Destination and source of the zigbee-rs Transport Key in tests/unit/sec (see NOTICE) */
#define NODE_EUI64 0xa4c1389c383001e5ULL
#define TC_EUI64   0xf4ce36c17d3852e1ULL

/* Trust center link key B of BDB 10.2.5 */
extern const uint8_t key_b[ZZB_SEC_KEY_LEN];

/* Node 2 has the install code of BDB 10.1.1, from which this key is derived */
#define IC_NODE_EUI64 0x00124b0000000c0dULL
extern const uint8_t install_code_key[ZZB_SEC_KEY_LEN];

/* Node 0 has NODE_EUI64, node 1 plays the trust center with TC_EUI64 */
struct zzb_node *test_node(int index);

/* Resets every fake */
void reset_fakes(void);

/* Runs the stack thread until it waits, without advancing the time */
void run_stack(void);

/* What zzb_node_init() does for APS on boot */
int reboot(struct zzb_node *node);

#endif /* ZZB_TESTS_UNIT_APS_FAKES_H_ */
```

## src/frame.c
```c
/* SPDX-License-Identifier: Apache-2.0 */

#include <errno.h>
#include <zephyr/ztest.h>

#include "aps/frame.h"
#include "common/buf.h"

static void check_hdr_round_trip(const uint8_t *bytes, size_t len,
				 const struct zzb_aps_hdr *expected)
{
	struct zzb_aps_hdr hdr;
	uint8_t buf[ZZB_BUF_SIZE];

	zassert_equal(zzb_aps_hdr_parse(bytes, len, &hdr), len);
	zassert_equal(hdr.type, expected->type);
	zassert_equal(hdr.delivery, expected->delivery);
	zassert_equal(hdr.flags, expected->flags);
	zassert_equal(hdr.dst_ep, expected->dst_ep);
	zassert_equal(hdr.group, expected->group);
	zassert_equal(hdr.cluster, expected->cluster);
	zassert_equal(hdr.profile, expected->profile);
	zassert_equal(hdr.src_ep, expected->src_ep);
	zassert_equal(hdr.counter, expected->counter);

	zassert_equal(zzb_aps_hdr_len(&hdr), len);
	zassert_equal(zzb_aps_hdr_write(&hdr, buf), len);
	zassert_mem_equal(buf, bytes, len);
}

/* APS header in the payload of the Ziggurat frame in tests/unit/sec (see NOTICE) */
ZTEST(zzb_aps_frame, test_data_header)
{
	static const uint8_t bytes[] = {0x00, 0x01, 0x06, 0x00, 0x04, 0x01, 0x01, 0xa9};
	const struct zzb_aps_hdr expected = {
		.type = ZZB_APS_FRAME_DATA,
		.delivery = ZZB_APS_DELIVERY_UNICAST,
		.dst_ep = 0x01,
		.cluster = 0x0006,
		.profile = 0x0104,
		.src_ep = 0x01,
		.counter = 0xa9,
	};

	check_hdr_round_trip(bytes, sizeof(bytes), &expected);
}

ZTEST(zzb_aps_frame, test_secured_broadcast)
{
	static const uint8_t bytes[] = {0x28, 0xff, 0x06, 0x00, 0x04, 0x01, 0x01, 0x10};
	const struct zzb_aps_hdr expected = {
		.type = ZZB_APS_FRAME_DATA,
		.delivery = ZZB_APS_DELIVERY_BROADCAST,
		.flags = ZZB_APS_SECURITY,
		.dst_ep = 0xff,
		.cluster = 0x0006,
		.profile = 0x0104,
		.src_ep = 0x01,
		.counter = 0x10,
	};

	check_hdr_round_trip(bytes, sizeof(bytes), &expected);
}

ZTEST(zzb_aps_frame, test_group_header)
{
	static const uint8_t bytes[] = {0x0c, 0x02, 0x00, 0x06, 0x00, 0x04, 0x01, 0x01, 0x11};
	const struct zzb_aps_hdr expected = {
		.type = ZZB_APS_FRAME_DATA,
		.delivery = ZZB_APS_DELIVERY_GROUP,
		.group = 0x0002,
		.cluster = 0x0006,
		.profile = 0x0104,
		.src_ep = 0x01,
		.counter = 0x11,
	};

	check_hdr_round_trip(bytes, sizeof(bytes), &expected);
	zassert_equal(sizeof(bytes), ZZB_APS_HDR_MAX_LEN);
}

/* APS header of the zigbee-rs Transport Key in tests/unit/sec (see NOTICE) */
ZTEST(zzb_aps_frame, test_command_header)
{
	static const uint8_t bytes[] = {0x21, 0x95};
	const struct zzb_aps_hdr expected = {
		.type = ZZB_APS_FRAME_CMD,
		.flags = ZZB_APS_SECURITY,
		.counter = 0x95,
	};

	check_hdr_round_trip(bytes, sizeof(bytes), &expected);
}

/* R22 2.2.5.2.3: the endpoints are swapped, cluster, profile and counter copied */
ZTEST(zzb_aps_frame, test_data_ack)
{
	static const uint8_t bytes[] = {0x02, 0x01, 0x06, 0x00, 0x04, 0x01, 0x01, 0xa9};
	const struct zzb_aps_hdr expected = {
		.type = ZZB_APS_FRAME_ACK,
		.dst_ep = 0x01,
		.cluster = 0x0006,
		.profile = 0x0104,
		.src_ep = 0x01,
		.counter = 0xa9,
	};

	check_hdr_round_trip(bytes, sizeof(bytes), &expected);
}

ZTEST(zzb_aps_frame, test_command_ack)
{
	static const uint8_t bytes[] = {0x12, 0x95};
	const struct zzb_aps_hdr expected = {
		.type = ZZB_APS_FRAME_ACK,
		.flags = ZZB_APS_ACK_FORMAT,
		.counter = 0x95,
	};

	check_hdr_round_trip(bytes, sizeof(bytes), &expected);
}

ZTEST(zzb_aps_frame, test_ack_request_and_extended_header)
{
	static const uint8_t bytes[] = {0xc0, 0x01, 0x06, 0x00, 0x04, 0x01, 0x01, 0xa9, 0x00};
	const struct zzb_aps_hdr expected = {
		.type = ZZB_APS_FRAME_DATA,
		.flags = ZZB_APS_ACK_REQ | ZZB_APS_EXT_HDR,
		.dst_ep = 0x01,
		.cluster = 0x0006,
		.profile = 0x0104,
		.src_ep = 0x01,
		.counter = 0xa9,
	};

	check_hdr_round_trip(bytes, sizeof(bytes), &expected);
}

ZTEST(zzb_aps_frame, test_rejected_headers)
{
	static const uint8_t inter_pan[] = {0x03, 0x06, 0x00, 0x04, 0x01, 0x01};
	static const uint8_t reserved_delivery[] = {0x04, 0x01, 0x06, 0x00, 0x04, 0x01, 0x01, 0xa9};
	/* First fragment of two blocks */
	static const uint8_t fragment[] = {0xc0, 0x01, 0x06, 0x00, 0x04,
					   0x01, 0x01, 0xa9, 0x01, 0x02};
	static const uint8_t reserved_ext[] = {0x80, 0x01, 0x06, 0x00, 0x04,
					       0x01, 0x01, 0xa9, 0x04};
	static const uint8_t data[] = {0x00, 0x01, 0x06, 0x00, 0x04, 0x01, 0x01, 0xa9};
	struct zzb_aps_hdr hdr;

	zassert_equal(zzb_aps_hdr_parse(inter_pan, sizeof(inter_pan), &hdr), -ENOTSUP);
	zassert_equal(zzb_aps_hdr_parse(reserved_delivery, sizeof(reserved_delivery), &hdr),
		      -EINVAL);
	zassert_equal(zzb_aps_hdr_parse(fragment, sizeof(fragment), &hdr), -ENOTSUP);
	zassert_equal(zzb_aps_hdr_parse(reserved_ext, sizeof(reserved_ext), &hdr), -EINVAL);
	zassert_equal(zzb_aps_hdr_parse(data, sizeof(data) - 1, &hdr), -EINVAL);
	zassert_equal(zzb_aps_hdr_parse(data, 0, &hdr), -EINVAL);
}

/* Every field of the command type is written, so equal bytes mean equal fields */
static void check_cmd_round_trip(const uint8_t *bytes, size_t len,
				 const struct zzb_aps_cmd *expected)
{
	struct zzb_aps_cmd cmd;
	uint8_t buf[ZZB_BUF_SIZE];

	zassert_equal(zzb_aps_cmd_write(expected, buf), len);
	zassert_mem_equal(buf, bytes, len);

	zassert_equal(zzb_aps_cmd_parse(bytes, len, &cmd), len);
	zassert_equal(cmd.id, expected->id);
	zassert_equal(zzb_aps_cmd_write(&cmd, buf), len);
	zassert_mem_equal(buf, bytes, len);
}

/* Payload of the zigbee-rs Transport Key in tests/unit/sec (see NOTICE) */
ZTEST(zzb_aps_frame, test_transport_key_with_network_key)
{
	static const uint8_t bytes[] = {
		0x05, 0x01, 0xab, 0xcd, 0xef, 0x01, 0x23, 0x45, 0x67, 0x89, 0x00, 0x00,
		0x00, 0x00, 0x00, 0x00, 0x00, 0x00, 0x00, 0xe5, 0x01, 0x30, 0x38, 0x9c,
		0x38, 0xc1, 0xa4, 0xe1, 0x52, 0x38, 0x7d, 0xc1, 0x36, 0xce, 0xf4,
	};
	const struct zzb_aps_cmd expected = {
		.id = ZZB_APS_CMD_TRANSPORT_KEY,
		.transport_key.type = ZZB_APS_KEY_NWK,
		.transport_key.key = {0xab, 0xcd, 0xef, 0x01, 0x23, 0x45, 0x67, 0x89},
		.transport_key.seq = 0,
		.transport_key.dst = 0xa4c1389c383001e5ULL,
		.transport_key.src = 0xf4ce36c17d3852e1ULL,
	};

	check_cmd_round_trip(bytes, sizeof(bytes), &expected);
}

ZTEST(zzb_aps_frame, test_transport_key_with_trust_center_link_key)
{
	static const uint8_t bytes[] = {
		0x05, 0x04, 0x10, 0x11, 0x12, 0x13, 0x14, 0x15, 0x16, 0x17, 0x18, 0x19,
		0x1a, 0x1b, 0x1c, 0x1d, 0x1e, 0x1f, 0xe5, 0x01, 0x30, 0x38, 0x9c, 0x38,
		0xc1, 0xa4, 0xe1, 0x52, 0x38, 0x7d, 0xc1, 0x36, 0xce, 0xf4,
	};
	const struct zzb_aps_cmd expected = {
		.id = ZZB_APS_CMD_TRANSPORT_KEY,
		.transport_key.type = ZZB_APS_KEY_TC_LINK,
		.transport_key.key = {0x10, 0x11, 0x12, 0x13, 0x14, 0x15, 0x16, 0x17, 0x18, 0x19,
				      0x1a, 0x1b, 0x1c, 0x1d, 0x1e, 0x1f},
		.transport_key.dst = 0xa4c1389c383001e5ULL,
		.transport_key.src = 0xf4ce36c17d3852e1ULL,
	};

	check_cmd_round_trip(bytes, sizeof(bytes), &expected);
}

ZTEST(zzb_aps_frame, test_transport_key_with_application_link_key)
{
	static const uint8_t bytes[] = {
		0x05, 0x03, 0x10, 0x11, 0x12, 0x13, 0x14, 0x15, 0x16, 0x17, 0x18, 0x19, 0x1a, 0x1b,
		0x1c, 0x1d, 0x1e, 0x1f, 0x77, 0x66, 0x55, 0x44, 0x33, 0x22, 0x11, 0x00, 0x01,
	};
	const struct zzb_aps_cmd expected = {
		.id = ZZB_APS_CMD_TRANSPORT_KEY,
		.transport_key.type = ZZB_APS_KEY_APP_LINK,
		.transport_key.key = {0x10, 0x11, 0x12, 0x13, 0x14, 0x15, 0x16, 0x17, 0x18, 0x19,
				      0x1a, 0x1b, 0x1c, 0x1d, 0x1e, 0x1f},
		.transport_key.partner = 0x0011223344556677ULL,
		.transport_key.initiator = true,
	};

	check_cmd_round_trip(bytes, sizeof(bytes), &expected);
}

ZTEST(zzb_aps_frame, test_request_key)
{
	static const uint8_t tc_link[] = {0x08, 0x04};
	static const uint8_t app_link[] = {0x08, 0x02, 0x77, 0x66, 0x55,
					   0x44, 0x33, 0x22, 0x11, 0x00};
	const struct zzb_aps_cmd tc_link_cmd = {
		.id = ZZB_APS_CMD_REQUEST_KEY,
		.request_key = {.type = ZZB_APS_REQUEST_TC_LINK},
	};
	const struct zzb_aps_cmd app_link_cmd = {
		.id = ZZB_APS_CMD_REQUEST_KEY,
		.request_key.type = ZZB_APS_REQUEST_APP_LINK,
		.request_key.partner = 0x0011223344556677ULL,
	};

	check_cmd_round_trip(tc_link, sizeof(tc_link), &tc_link_cmd);
	check_cmd_round_trip(app_link, sizeof(app_link), &app_link_cmd);
}

ZTEST(zzb_aps_frame, test_switch_key)
{
	static const uint8_t bytes[] = {0x09, 0x01};
	const struct zzb_aps_cmd expected = {
		.id = ZZB_APS_CMD_SWITCH_KEY,
		.switch_key_seq = 1,
	};

	check_cmd_round_trip(bytes, sizeof(bytes), &expected);
}

ZTEST(zzb_aps_frame, test_verify_key)
{
	static const uint8_t bytes[] = {
		0x0f, 0x04, 0xe5, 0x01, 0x30, 0x38, 0x9c, 0x38, 0xc1, 0xa4, 0x20, 0x21, 0x22,
		0x23, 0x24, 0x25, 0x26, 0x27, 0x28, 0x29, 0x2a, 0x2b, 0x2c, 0x2d, 0x2e, 0x2f,
	};
	const struct zzb_aps_cmd expected = {
		.id = ZZB_APS_CMD_VERIFY_KEY,
		.verify_key.type = ZZB_APS_KEY_TC_LINK,
		.verify_key.src = 0xa4c1389c383001e5ULL,
		.verify_key.hash = {0x20, 0x21, 0x22, 0x23, 0x24, 0x25, 0x26, 0x27, 0x28, 0x29,
				    0x2a, 0x2b, 0x2c, 0x2d, 0x2e, 0x2f},
	};

	check_cmd_round_trip(bytes, sizeof(bytes), &expected);
}

ZTEST(zzb_aps_frame, test_confirm_key)
{
	static const uint8_t bytes[] = {0x10, 0x00, 0x04, 0xe5, 0x01, 0x30,
					0x38, 0x9c, 0x38, 0xc1, 0xa4};
	const struct zzb_aps_cmd expected = {
		.id = ZZB_APS_CMD_CONFIRM_KEY,
		.confirm_key.status = 0x00,
		.confirm_key.type = ZZB_APS_KEY_TC_LINK,
		.confirm_key.dst = 0xa4c1389c383001e5ULL,
	};

	check_cmd_round_trip(bytes, sizeof(bytes), &expected);
}

ZTEST(zzb_aps_frame, test_rejected_commands)
{
	/* Update Device belongs to the router */
	static const uint8_t update_device[] = {0x06, 0x77, 0x66, 0x55, 0x44, 0x33,
						0x22, 0x11, 0x00, 0x34, 0x12, 0x00};
	static const uint8_t reserved_key_type[] = {0x05, 0x02};
	static const uint8_t reserved_request_type[] = {0x08, 0x01};
	static const uint8_t confirm_key[] = {0x10, 0x00, 0x04, 0xe5, 0x01, 0x30,
					      0x38, 0x9c, 0x38, 0xc1, 0xa4};
	struct zzb_aps_cmd cmd;

	zassert_equal(zzb_aps_cmd_parse(update_device, sizeof(update_device), &cmd), -ENOTSUP);
	zassert_equal(zzb_aps_cmd_parse(reserved_key_type, sizeof(reserved_key_type), &cmd),
		      -ENOTSUP);
	zassert_equal(zzb_aps_cmd_parse(reserved_request_type, sizeof(reserved_request_type), &cmd),
		      -ENOTSUP);
	zassert_equal(zzb_aps_cmd_parse(confirm_key, sizeof(confirm_key) - 1, &cmd), -EINVAL);
	zassert_equal(zzb_aps_cmd_parse(confirm_key, 0, &cmd), -EINVAL);
}

ZTEST_SUITE(zzb_aps_frame, NULL, NULL, NULL, NULL, NULL);
```

## src/group.c
```c
/* SPDX-License-Identifier: Apache-2.0 */

#include <errno.h>
#include <zephyr/settings/settings.h>
#include <zephyr/ztest.h>

#include "aps/aps.h"
#include "common/node.h"
#include "fakes.h"

static struct zzb_node *node;

static void *setup(void)
{
	node = test_node(0);
	return NULL;
}

static void before(void *fixture)
{
	reset_fakes();
	/* A save scheduled by the previous test runs before the records are deleted */
	run_stack();
	zzb_aps_reset(node);
	zassert_ok(reboot(node));
}

/* R22 2.2.4.5.1, 2.2.4.5.3 */
ZTEST(zzb_aps_group, test_add_and_remove)
{
	zassert_ok(zzb_apsme_add_group(node, 0x0001, 1));
	zassert_ok(zzb_apsme_add_group(node, 0x0001, 2));
	/* The same membership again takes no entry */
	zassert_ok(zzb_apsme_add_group(node, 0x0001, 1));
	zassert_equal(zzb_aps_group_capacity(node), CONFIG_ZZB_APS_GROUP_COUNT - 2);
	zassert_true(zzb_aps_group_member(node, 0x0001, 1));
	zassert_true(zzb_aps_group_member(node, 0x0001, 2));
	zassert_false(zzb_aps_group_member(node, 0x0002, 1));

	zassert_ok(zzb_apsme_remove_group(node, 0x0001, 1));
	zassert_false(zzb_aps_group_member(node, 0x0001, 1));
	zassert_true(zzb_aps_group_member(node, 0x0001, 2));
	zassert_equal(zzb_apsme_remove_group(node, 0x0001, 1), -ENOENT);
}

/* R22 2.2.4.5.5: only the memberships of the endpoint go */
ZTEST(zzb_aps_group, test_remove_all_groups)
{
	zassert_ok(zzb_apsme_add_group(node, 0x0001, 1));
	zassert_ok(zzb_apsme_add_group(node, 0x0002, 1));
	zassert_ok(zzb_apsme_add_group(node, 0x0001, 2));

	zzb_apsme_remove_all_groups(node, 1);
	zassert_false(zzb_aps_group_member(node, 0x0001, 1));
	zassert_false(zzb_aps_group_member(node, 0x0002, 1));
	zassert_true(zzb_aps_group_member(node, 0x0001, 2));
}

ZTEST(zzb_aps_group, test_full_table)
{
	for (int i = 0; i < CONFIG_ZZB_APS_GROUP_COUNT; i++) {
		zassert_ok(zzb_apsme_add_group(node, 0x0100 + i, 1));
	}

	zassert_equal(zzb_aps_group_capacity(node), 0);
	zassert_equal(zzb_apsme_add_group(node, 0x0001, 1), -ENOMEM);
	/* A full table accepts a membership it holds */
	zassert_ok(zzb_apsme_add_group(node, 0x0100, 1));
}

ZTEST(zzb_aps_group, test_groups_of_an_endpoint)
{
	uint16_t groups[3];

	zassert_ok(zzb_apsme_add_group(node, 0x0001, 1));
	zassert_ok(zzb_apsme_add_group(node, 0x0002, 2));
	zassert_ok(zzb_apsme_add_group(node, 0x0003, 1));
	zassert_ok(zzb_apsme_add_group(node, 0x0004, 1));

	zassert_equal(zzb_aps_groups_of(node, 1, groups, ARRAY_SIZE(groups)), 3);
	zassert_equal(groups[0], 0x0001);
	zassert_equal(groups[1], 0x0003);
	zassert_equal(groups[2], 0x0004);
	zassert_equal(zzb_aps_groups_of(node, 1, groups, 2), 2);
	zassert_equal(zzb_aps_groups_of(node, 3, groups, ARRAY_SIZE(groups)), 0);
}

/* R22 2.2.8.1: the group table is persistent */
ZTEST(zzb_aps_group, test_table_survives_a_reboot)
{
	zassert_ok(zzb_apsme_add_group(node, 0x0001, 1));
	zassert_ok(zzb_apsme_add_group(node, 0x1234, 2));
	zassert_ok(zzb_apsme_remove_group(node, 0x0001, 1));
	zassert_ok(reboot(node));

	zassert_false(zzb_aps_group_member(node, 0x0001, 1));
	zassert_true(zzb_aps_group_member(node, 0x1234, 2));
	zassert_equal(zzb_aps_group_capacity(node), CONFIG_ZZB_APS_GROUP_COUNT - 1);

	zzb_apsme_remove_all_groups(node, 2);
	zassert_ok(reboot(node));
	zassert_equal(zzb_aps_group_capacity(node), CONFIG_ZZB_APS_GROUP_COUNT);

	zassert_ok(zzb_apsme_add_group(node, 0x0005, 1));
	zzb_aps_reset(node);
	zassert_false(zzb_aps_group_member(node, 0x0005, 1));
	zassert_ok(reboot(node));
	zassert_false(zzb_aps_group_member(node, 0x0005, 1));
}

ZTEST(zzb_aps_group, test_unknown_record_version)
{
	uint8_t rec[4] = {2};

	zassert_ok(settings_save_one("zzb/0/aps/group/0", rec, sizeof(rec)));
	zassert_equal(reboot(node), -EINVAL);

	rec[0] = 1;
	zassert_ok(settings_save_one("zzb/0/aps/group/0", rec, sizeof(rec) - 1));
	zassert_equal(reboot(node), -EINVAL);

	/* The next suite needs a node that booted */
	zassert_ok(settings_delete("zzb/0/aps/group/0"));
	zassert_ok(reboot(node));
}

ZTEST_SUITE(zzb_aps_group, NULL, setup, before, NULL, NULL);
```
