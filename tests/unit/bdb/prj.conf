## CMakeLists.txt
```
# SPDX-License-Identifier: Apache-2.0

cmake_minimum_required(VERSION 3.20.0)

find_package(Zephyr REQUIRED HINTS $ENV{ZEPHYR_BASE})
project(zzb_unit_bdb)

target_include_directories(app PRIVATE ${ZEPHYR_ZZB_MODULE_DIR}/subsys/zzb)
target_sources(app PRIVATE
  src/fakes.c
  src/fb.c
  src/init.c
  src/reset.c
  src/steering.c
  src/tclk.c
)
```

## prj.conf
```kconfig
# SPDX-License-Identifier: Apache-2.0

CONFIG_ZTEST=y
CONFIG_ZZB=y
# ZDO, APS and NWK are faked
CONFIG_ZZB_BDB=y
# ZCL is faked
CONFIG_ZZB_ZCL=n
```

## src/fakes.c
```c
/* SPDX-License-Identifier: Apache-2.0 */

#include <string.h>
#include <zephyr/fff.h>
#include <zephyr/kernel.h>
#include <zephyr/ztest.h>
#include <zzb/zzb.h>

#include "bdb/bdb.h"
#include "common/node.h"
#include "common/queue.h"
#include "fakes.h"

DEFINE_FFF_GLOBALS;

DEFINE_FAKE_VALUE_FUNC(int, zzb_nlme_join_req, struct zzb_node *, uint64_t,
		       enum zzb_nwk_join_method, uint32_t, uint8_t, uint8_t, bool);
DEFINE_FAKE_VALUE_FUNC(uint64_t, zzb_nlme_get_ext_pan_id, const struct zzb_node *);
DEFINE_FAKE_VALUE_FUNC(uint16_t, zzb_nlme_get_short_addr, const struct zzb_node *);
DEFINE_FAKE_VALUE_FUNC(int, zzb_nlme_network_discovery_req, struct zzb_node *, uint32_t, uint8_t);
DEFINE_FAKE_VALUE_FUNC(int, zzb_nlme_reset_req, struct zzb_node *);
DEFINE_FAKE_VALUE_FUNC(int, zzb_nlme_leave_req, struct zzb_node *, bool);
DEFINE_FAKE_VOID_FUNC(zzb_nwk_poll_hold, struct zzb_node *, enum zzb_nwk_hold, bool);
DEFINE_FAKE_VOID_FUNC(zzb_aps_reset, struct zzb_node *);
DEFINE_FAKE_VALUE_FUNC(uint64_t, zzb_apsme_get_tc_addr, const struct zzb_node *);
DEFINE_FAKE_VALUE_FUNC(struct zzb_aps_key_pair *, zzb_aps_key_pair_find, struct zzb_node *,
		       uint64_t);
DEFINE_FAKE_VALUE_FUNC(int, zzb_apsme_request_key_req, struct zzb_node *, uint64_t);
DEFINE_FAKE_VALUE_FUNC(int, zzb_apsme_verify_key_req, struct zzb_node *, uint64_t,
		       enum zzb_aps_key_type);
DEFINE_FAKE_VOID_FUNC(zzb_zdo_init, struct zzb_node *);
DEFINE_FAKE_VOID_FUNC(zzb_zcl_reset, struct zzb_node *);
DEFINE_FAKE_VALUE_FUNC(int, zzb_zcl_identify, struct zzb_node *, uint8_t, uint16_t);
DEFINE_FAKE_VALUE_FUNC(int, zzb_zcl_send_cmd, struct zzb_node *, uint8_t, uint16_t, uint8_t,
		       uint16_t, uint8_t, const uint8_t *, size_t);
DEFINE_FAKE_VALUE_FUNC(int, zzb_zdo_simple_desc_req, struct zzb_node *, uint16_t, uint8_t);
DEFINE_FAKE_VALUE_FUNC(int, zzb_zdo_ieee_addr_req, struct zzb_node *, uint16_t);
DEFINE_FAKE_VALUE_FUNC(int, zzb_apsme_bind_req, struct zzb_node *, const struct zzb_aps_binding *);

struct zzb_aps_binding bindings[8];
uint8_t sent_cmd[8];

static int bind_copy(struct zzb_node *node, const struct zzb_aps_binding *binding)
{
	zassert_true(zzb_apsme_bind_req_fake.call_count <= ARRAY_SIZE(bindings));
	bindings[zzb_apsme_bind_req_fake.call_count - 1] = *binding;
	return 0;
}

static int send_cmd_copy(struct zzb_node *node, uint8_t src_ep, uint16_t dst_addr, uint8_t dst_ep,
			 uint16_t cluster, uint8_t cmd, const uint8_t *payload, size_t len)
{
	zassert_true(len <= sizeof(sent_cmd));
	memcpy(sent_cmd, payload, len);
	return 0;
}
DEFINE_FAKE_VALUE_FUNC(int, zzb_zdo_device_annce_req, struct zzb_node *);
DEFINE_FAKE_VALUE_FUNC(int, zzb_zdo_node_desc_req, struct zzb_node *, uint16_t);
DEFINE_FAKE_VALUE_FUNC(int, zzb_zdo_mgmt_permit_joining_req, struct zzb_node *, uint8_t, bool);

struct event_log events;
struct zzb_aps_key_pair tc_pair;
struct set_link_key_calls set_link_key;

int zzb_apsme_set_link_key(struct zzb_node *node, uint64_t addr, const uint8_t key[ZZB_SEC_KEY_LEN],
			   enum zzb_aps_key_attr attr, enum zzb_aps_link_key_type type)
{
	set_link_key.count++;
	set_link_key.addr = addr;
	memcpy(set_link_key.key, key, ZZB_SEC_KEY_LEN);
	set_link_key.attr = attr;
	set_link_key.type = type;
	return 0;
}

static void record_event(struct zzb_node *node, enum zzb_bdb_event event,
			 enum zzb_bdb_status status)
{
	events.count++;
	events.event = event;
	events.status = status;
}

/* Cluster instances without definitions, since ZCL is faked */
static const struct zzb_zcl_cluster identify_server[] = {
	{.id = 0x0003, .server = true},
};

static const struct zzb_zcl_cluster initiator[] = {
	{.id = 0x0003},
	{.id = 0x0006},
	{.id = 0x0402, .server = true},
	{.id = 0x0500},
	{.id = 0x0501, .server = true},
	{.id = 0x0502},
};

static const struct zzb_endpoint endpoints[] = {
	{
		.id = IDENTIFY_EP,
		.profile = 0x0104,
		.clusters = identify_server,
		.cluster_count = ARRAY_SIZE(identify_server),
	},
	{
		.id = OTHER_EP,
		.profile = 0x0104,
		.clusters = initiator,
		.cluster_count = ARRAY_SIZE(initiator),
	},
};

/* The power source gives the mains power bit of the capability */
static const struct zzb_device device = {
	.power_source = ZZB_POWER_MAINS,
	.endpoints = endpoints,
	.endpoint_count = ARRAY_SIZE(endpoints),
};

struct zzb_node *test_node(void)
{
	static struct zzb_node *node;
	const struct zzb_node_config cfg = {
		.eui64 = 0x00124b0001020304ULL,
		.device = &device,
		.bdb_cb = record_event,
	};

	if (node == NULL) {
		zassert_ok(zzb_node_init(&cfg, &node));
	}

	return node;
}

void reset_fakes(void)
{
	RESET_FAKE(zzb_nlme_join_req);
	RESET_FAKE(zzb_nlme_get_ext_pan_id);
	RESET_FAKE(zzb_nlme_get_short_addr);
	RESET_FAKE(zzb_nlme_network_discovery_req);
	RESET_FAKE(zzb_nlme_reset_req);
	RESET_FAKE(zzb_nlme_leave_req);
	RESET_FAKE(zzb_nwk_poll_hold);
	RESET_FAKE(zzb_aps_reset);
	RESET_FAKE(zzb_apsme_get_tc_addr);
	RESET_FAKE(zzb_aps_key_pair_find);
	RESET_FAKE(zzb_apsme_request_key_req);
	RESET_FAKE(zzb_apsme_verify_key_req);
	RESET_FAKE(zzb_zdo_init);
	RESET_FAKE(zzb_zcl_reset);
	RESET_FAKE(zzb_zcl_identify);
	RESET_FAKE(zzb_zcl_send_cmd);
	RESET_FAKE(zzb_zdo_simple_desc_req);
	RESET_FAKE(zzb_zdo_ieee_addr_req);
	RESET_FAKE(zzb_apsme_bind_req);
	RESET_FAKE(zzb_zdo_device_annce_req);
	RESET_FAKE(zzb_zdo_node_desc_req);
	RESET_FAKE(zzb_zdo_mgmt_permit_joining_req);
	FFF_RESET_HISTORY();
	events = (struct event_log){0};
	set_link_key = (struct set_link_key_calls){0};
	tc_pair = (struct zzb_aps_key_pair){
		.in_use = true,
		.addr = TC_EUI64,
		.attr = ZZB_APS_KEY_PROVISIONAL,
		.type = ZZB_APS_LINK_KEY_GLOBAL,
	};
	memcpy(tc_pair.key, "ZigBeeAlliance09", ZZB_SEC_KEY_LEN);

	zzb_nlme_get_short_addr_fake.return_val = NODE_ADDR;
	zzb_apsme_get_tc_addr_fake.return_val = TC_EUI64;
	zzb_aps_key_pair_find_fake.return_val = &tc_pair;
	zzb_apsme_bind_req_fake.custom_fake = bind_copy;
	zzb_zcl_send_cmd_fake.custom_fake = send_cmd_copy;
	memset(bindings, 0, sizeof(bindings));
}

bool held(void)
{
	return zzb_nwk_poll_hold_fake.arg1_val == ZZB_NWK_HOLD_BDB &&
	       zzb_nwk_poll_hold_fake.arg2_val;
}

static void reboot_handler(struct k_work *work)
{
	zzb_bdb_init(test_node());
}

void reboot(bool on_network)
{
	struct k_work work;

	zzb_nlme_get_ext_pan_id_fake.return_val = on_network ? EXT_PAN_ID : 0;
	zzb_call_sync(&work, reboot_handler);
}

/* The test thread is cooperative and has a lower priority than the stack thread */
void run_stack(void)
{
	k_yield();
}
```

## src/fakes.h
```c
/* SPDX-License-Identifier: Apache-2.0 */

#ifndef ZZB_TESTS_UNIT_BDB_FAKES_H_
#define ZZB_TESTS_UNIT_BDB_FAKES_H_

#include <stdbool.h>
#include <stdint.h>
#include <zephyr/fff.h>
#include <zzb/bdb.h>

#include "aps/aps.h"
#include "nwk/nwk.h"

DECLARE_FAKE_VALUE_FUNC(int, zzb_nlme_join_req, struct zzb_node *, uint64_t,
			enum zzb_nwk_join_method, uint32_t, uint8_t, uint8_t, bool);
DECLARE_FAKE_VALUE_FUNC(uint64_t, zzb_nlme_get_ext_pan_id, const struct zzb_node *);
DECLARE_FAKE_VALUE_FUNC(uint16_t, zzb_nlme_get_short_addr, const struct zzb_node *);
DECLARE_FAKE_VALUE_FUNC(int, zzb_nlme_network_discovery_req, struct zzb_node *, uint32_t, uint8_t);
DECLARE_FAKE_VALUE_FUNC(int, zzb_nlme_reset_req, struct zzb_node *);
DECLARE_FAKE_VALUE_FUNC(int, zzb_nlme_leave_req, struct zzb_node *, bool);
DECLARE_FAKE_VOID_FUNC(zzb_nwk_poll_hold, struct zzb_node *, enum zzb_nwk_hold, bool);
DECLARE_FAKE_VOID_FUNC(zzb_aps_reset, struct zzb_node *);
DECLARE_FAKE_VALUE_FUNC(uint64_t, zzb_apsme_get_tc_addr, const struct zzb_node *);
DECLARE_FAKE_VALUE_FUNC(struct zzb_aps_key_pair *, zzb_aps_key_pair_find, struct zzb_node *,
			uint64_t);
DECLARE_FAKE_VALUE_FUNC(int, zzb_apsme_request_key_req, struct zzb_node *, uint64_t);
DECLARE_FAKE_VALUE_FUNC(int, zzb_apsme_verify_key_req, struct zzb_node *, uint64_t,
			enum zzb_aps_key_type);
DECLARE_FAKE_VOID_FUNC(zzb_zdo_init, struct zzb_node *);
DECLARE_FAKE_VOID_FUNC(zzb_zcl_reset, struct zzb_node *);
DECLARE_FAKE_VALUE_FUNC(int, zzb_zcl_identify, struct zzb_node *, uint8_t, uint16_t);
DECLARE_FAKE_VALUE_FUNC(int, zzb_zcl_send_cmd, struct zzb_node *, uint8_t, uint16_t, uint8_t,
			uint16_t, uint8_t, const uint8_t *, size_t);
DECLARE_FAKE_VALUE_FUNC(int, zzb_zdo_simple_desc_req, struct zzb_node *, uint16_t, uint8_t);
DECLARE_FAKE_VALUE_FUNC(int, zzb_zdo_ieee_addr_req, struct zzb_node *, uint16_t);
DECLARE_FAKE_VALUE_FUNC(int, zzb_apsme_bind_req, struct zzb_node *, const struct zzb_aps_binding *);
DECLARE_FAKE_VALUE_FUNC(int, zzb_zdo_device_annce_req, struct zzb_node *);
DECLARE_FAKE_VALUE_FUNC(int, zzb_zdo_node_desc_req, struct zzb_node *, uint16_t);
DECLARE_FAKE_VALUE_FUNC(int, zzb_zdo_mgmt_permit_joining_req, struct zzb_node *, uint8_t, bool);

#define EXT_PAN_ID 0x00124b0000001a62ULL
#define NODE_ADDR  0x5678

/* nwkCapabilityInformation: allocate address, receiver on when idle, mains power */
#define CAPABILITY 0x8c

/* The capability of a sleepy node: allocate address, mains power */
#define SLEEPY_CAPABILITY 0x84

#define TC_EUI64 0x00124b0000000001ULL

/*
 * Endpoint 1 has an Identify server. Endpoint 2 is an initiator with an Identify client, an On/Off
 * client and a Temperature Measurement server.
 */
#define IDENTIFY_EP 1
#define OTHER_EP    2

/* The bindings of the zzb_apsme_bind_req() fake */
extern struct zzb_aps_binding bindings[8];

/* The payload of the last zzb_zcl_send_cmd() */
extern uint8_t sent_cmd[8];

/* The trust center entry that zzb_aps_key_pair_find() returns, with the default key */
extern struct zzb_aps_key_pair tc_pair;

/*
 * Calls of the zzb_apsme_set_link_key() fake. FFF declares the array parameter as a pointer, which
 * -Werror=array-parameter rejects.
 */
struct set_link_key_calls {
	int count;
	uint64_t addr;
	uint8_t key[ZZB_SEC_KEY_LEN];
	enum zzb_aps_key_attr attr;
	enum zzb_aps_link_key_type type;
};

extern struct set_link_key_calls set_link_key;

/* The events of the BDB callback */
struct event_log {
	int count;
	enum zzb_bdb_event event;
	enum zzb_bdb_status status;
};

extern struct event_log events;

struct zzb_node *test_node(void);

/* Resets every fake and the event log */
void reset_fakes(void);

/* Whether the last call of the zzb_nwk_poll_hold() fake set the hold of BDB */
bool held(void);

/* Initializes BDB again, on the network EXT_PAN_ID when on_network is set */
void reboot(bool on_network);

/* Runs the stack thread until it waits, without advancing the time */
void run_stack(void);

#endif /* ZZB_TESTS_UNIT_BDB_FAKES_H_ */
```

## src/fb.c
```c
/* SPDX-License-Identifier: Apache-2.0 */

#include <errno.h>
#include <zephyr/kernel.h>
#include <zephyr/ztest.h>
#include <zzb/bdb.h>

#include "bdb/bdb.h"
#include "fakes.h"
#include "zdo/zdo.h"

static struct zzb_node *node;

static void *setup(void)
{
	node = test_node();
	return NULL;
}

static void before(void *fixture)
{
	reset_fakes();
	reboot(true);
}

static void check_event(enum zzb_bdb_event event, enum zzb_bdb_status status)
{
	zassert_equal(events.count, 1);
	zassert_equal(events.event, event);
	zassert_equal(events.status, status);
}

/* BDB 8.4 step 1 */
ZTEST(zzb_bdb_fb, test_target_off_a_network)
{
	reboot(false);
	zassert_ok(zzb_bdb_finding_binding_target(node, IDENTIFY_EP));
	check_event(ZZB_BDB_EVENT_FINDING_BINDING_TARGET, ZZB_BDB_NOT_ON_A_NETWORK);
	zassert_equal(zzb_zcl_identify_fake.call_count, 0);
}

/* BDB 8.4 steps 3 to 5: the endpoint identifies for bdbcMinCommissioningTime */
ZTEST(zzb_bdb_fb, test_target)
{
	zassert_ok(zzb_bdb_finding_binding_target(node, IDENTIFY_EP));
	zassert_equal(zzb_zcl_identify_fake.call_count, 1);
	zassert_equal(zzb_zcl_identify_fake.arg1_val, IDENTIFY_EP);
	zassert_equal(zzb_zcl_identify_fake.arg2_val, 180);
	zassert_equal(zzb_bdb_finding_binding_target(node, IDENTIFY_EP), -EBUSY);

	/* Steering and the other procedures stay available */
	zassert_ok(zzb_bdb_steering(node));
	events.count = 0;
	zassert_true(held());

	zzb_bdb_identify_end(node, OTHER_EP);
	zassert_equal(events.count, 0);
	zzb_bdb_identify_end(node, IDENTIFY_EP);
	check_event(ZZB_BDB_EVENT_FINDING_BINDING_TARGET, ZZB_BDB_SUCCESS);
	zassert_false(held());

	zassert_ok(zzb_bdb_finding_binding_target(node, IDENTIFY_EP));
	reboot(true);
	zassert_false(held());
}

ZTEST(zzb_bdb_fb, test_target_without_an_identify_server)
{
	zassert_equal(zzb_bdb_finding_binding_target(node, OTHER_EP), -ENOENT);
	zassert_equal(zzb_bdb_finding_binding_target(node, 9), -ENOENT);
	zassert_equal(zzb_zcl_identify_fake.call_count, 0);
}

static void identify_ends(struct zzb_node *n)
{
	zzb_bdb_identify_end(n, IDENTIFY_EP);
}

/* The reset of the node, whose reset of IdentifyTime reaches BDB, ends the target without event */
ZTEST(zzb_bdb_fb, test_target_and_reset)
{
	zzb_zcl_reset_fake.custom_fake = identify_ends;
	zassert_ok(zzb_bdb_finding_binding_target(node, IDENTIFY_EP));
	zzb_nlme_leave_ind(node, 0, false);
	check_event(ZZB_BDB_EVENT_LEFT, ZZB_BDB_SUCCESS);
}

#define RESPONDENT       0x1234
#define RESPONDENT_EUI64 0x00124b0000001234ULL

/* Simple_Desc_rsp of an On/Off Light with a Temperature Measurement client */
static const uint8_t light_in[] = {0x03, 0x00, 0x06, 0x00};
static const uint8_t light_out[] = {0x02, 0x04};

static void simple_desc(uint8_t ep, uint16_t profile)
{
	const struct zzb_zdo_simple_desc desc = {
		.ep = ep,
		.profile = profile,
		.in_count = 2,
		.in = light_in,
		.out_count = 1,
		.out = light_out,
	};

	zzb_zdo_simple_desc_conf(node, ZZB_ZDP_SUCCESS, RESPONDENT, &desc);
}

/* BDB 8.5 steps 3 and 4: the query, then the responses for 5 s */
static void query(uint16_t group)
{
	zassert_ok(zzb_bdb_finding_binding_initiator(node, OTHER_EP, group));
	zassert_equal(zzb_zcl_send_cmd_fake.call_count, 1);
	zassert_equal(zzb_zcl_send_cmd_fake.arg1_val, OTHER_EP);
	zassert_equal(zzb_zcl_send_cmd_fake.arg2_val, 0xffff);
	zassert_equal(zzb_zcl_send_cmd_fake.arg3_val, 0xff);
	zassert_equal(zzb_zcl_send_cmd_fake.arg4_val, 0x0003);
	zassert_equal(zzb_zcl_send_cmd_fake.arg5_val, 0x01);
}

static void check_binding(int i, uint16_t cluster, uint8_t dst_ep)
{
	zassert_equal(bindings[i].src_ep, OTHER_EP);
	zassert_equal(bindings[i].cluster, cluster);
	zassert_equal(bindings[i].dst_mode, ZZB_APS_ADDR_EXT);
	zassert_equal(bindings[i].dst_ext, RESPONDENT_EUI64);
	zassert_equal(bindings[i].dst_ep, dst_ep);
}

/* BDB 8.5 step 1 */
ZTEST(zzb_bdb_fb, test_initiator_off_a_network)
{
	reboot(false);
	zassert_ok(zzb_bdb_finding_binding_initiator(node, OTHER_EP, 0xffff));
	check_event(ZZB_BDB_EVENT_FINDING_BINDING_INITIATOR, ZZB_BDB_NOT_ON_A_NETWORK);
	zassert_equal(zzb_zcl_send_cmd_fake.call_count, 0);
}

ZTEST(zzb_bdb_fb, test_initiator_rejected)
{
	zassert_equal(zzb_bdb_finding_binding_initiator(node, OTHER_EP, 0x0000), -EINVAL);
	zassert_equal(zzb_bdb_finding_binding_initiator(node, OTHER_EP, 0xfff8), -EINVAL);
	zassert_equal(zzb_bdb_finding_binding_initiator(node, IDENTIFY_EP, 0xffff), -ENOENT);
	query(0xffff);
	zassert_equal(zzb_bdb_finding_binding_initiator(node, OTHER_EP, 0xffff), -EBUSY);
}

ZTEST(zzb_bdb_fb, test_initiator_without_respondents)
{
	query(0xffff);
	k_sleep(K_MSEC(4900));
	zassert_equal(events.count, 0);
	k_sleep(K_MSEC(200));
	check_event(ZZB_BDB_EVENT_FINDING_BINDING_INITIATOR, ZZB_BDB_NO_IDENTIFY_QUERY_RESPONSE);
}

/*
 * BDB 8.5 steps 5 to 11: the On/Off client binds to the input cluster of the respondent and the
 * Temperature Measurement server to its output cluster; Identify is not bound. The IEEE address of
 * a respondent is requested once.
 */
ZTEST(zzb_bdb_fb, test_initiator)
{
	query(0xffff);
	zassert_true(held());
	zzb_bdb_identify_query_rsp(node, OTHER_EP, RESPONDENT, 1);
	zzb_bdb_identify_query_rsp(node, OTHER_EP, RESPONDENT, 1);
	zzb_bdb_identify_query_rsp(node, OTHER_EP, RESPONDENT, 2);
	/* To another endpoint */
	zzb_bdb_identify_query_rsp(node, IDENTIFY_EP, 0x5555, 1);
	k_sleep(K_MSEC(5100));

	zassert_equal(zzb_zdo_simple_desc_req_fake.call_count, 1);
	zassert_equal(zzb_zdo_simple_desc_req_fake.arg1_val, RESPONDENT);
	zassert_equal(zzb_zdo_simple_desc_req_fake.arg2_val, 1);
	simple_desc(1, 0x0104);
	zassert_equal(zzb_zdo_ieee_addr_req_fake.call_count, 1);
	zassert_equal(zzb_zdo_ieee_addr_req_fake.arg1_val, RESPONDENT);
	zassert_equal(zzb_apsme_bind_req_fake.call_count, 0);

	zzb_zdo_ieee_addr_conf(node, ZZB_ZDP_SUCCESS, RESPONDENT, RESPONDENT_EUI64);
	zassert_equal(zzb_apsme_bind_req_fake.call_count, 2);
	check_binding(0, 0x0006, 1);
	check_binding(1, 0x0402, 1);

	zassert_equal(zzb_zdo_simple_desc_req_fake.call_count, 2);
	zassert_equal(zzb_zdo_simple_desc_req_fake.arg2_val, 2);
	simple_desc(2, 0x0104);
	zassert_equal(zzb_zdo_ieee_addr_req_fake.call_count, 1);
	zassert_equal(zzb_apsme_bind_req_fake.call_count, 4);
	check_binding(2, 0x0006, 2);
	check_event(ZZB_BDB_EVENT_FINDING_BINDING_INITIATOR, ZZB_BDB_SUCCESS);
	zassert_equal(zzb_zcl_send_cmd_fake.call_count, 1);
	zassert_false(held());
}

/* BDB 8.5 step 6, and respondents whose IEEE address or profile does not fit */
ZTEST(zzb_bdb_fb, test_initiator_skips_respondents)
{
	query(0xffff);
	for (int i = 1; i <= 4; i++) {
		zzb_bdb_identify_query_rsp(node, OTHER_EP, RESPONDENT, i);
	}

	zzb_zdo_simple_desc_req_fake.return_val = -ENOBUFS;
	k_sleep(K_MSEC(5100));
	zassert_equal(zzb_zdo_simple_desc_req_fake.call_count, 4);
	check_event(ZZB_BDB_EVENT_FINDING_BINDING_INITIATOR, ZZB_BDB_SUCCESS);

	events.count = 0;
	zzb_zdo_simple_desc_req_fake.return_val = 0;
	zzb_zcl_send_cmd_fake.call_count = 0;
	query(0xffff);
	for (int i = 1; i <= 3; i++) {
		zzb_bdb_identify_query_rsp(node, OTHER_EP, RESPONDENT, i);
	}

	k_sleep(K_MSEC(5100));
	zzb_zdo_simple_desc_conf(node, ZZB_ZDP_TIMEOUT, RESPONDENT, NULL);
	simple_desc(2, 0xc05e);
	simple_desc(3, 0x0104);
	zzb_zdo_ieee_addr_conf(node, ZZB_ZDP_TIMEOUT, RESPONDENT, 0);
	zassert_equal(zzb_zdo_simple_desc_req_fake.call_count, 7);
	zassert_equal(zzb_apsme_bind_req_fake.call_count, 0);
	check_event(ZZB_BDB_EVENT_FINDING_BINDING_INITIATOR, ZZB_BDB_SUCCESS);
}

/* DTL 43.3.1, 44.3.1, 45.3.1, 46.3.1: IAS Zone, IAS ACE and IAS WD are not bound */
ZTEST(zzb_bdb_fb, test_initiator_skips_ias_clusters)
{
	static const uint8_t ias_in[] = {0x00, 0x05, 0x02, 0x05};
	static const uint8_t ias_out[] = {0x01, 0x05};
	const struct zzb_zdo_simple_desc desc = {
		.ep = 1,
		.profile = 0x0104,
		.in_count = 2,
		.in = ias_in,
		.out_count = 1,
		.out = ias_out,
	};

	query(0xffff);
	zzb_bdb_identify_query_rsp(node, OTHER_EP, RESPONDENT, 1);
	k_sleep(K_MSEC(5100));
	zzb_zdo_simple_desc_conf(node, ZZB_ZDP_SUCCESS, RESPONDENT, &desc);
	zassert_equal(zzb_zdo_ieee_addr_req_fake.call_count, 0);
	zassert_equal(zzb_apsme_bind_req_fake.call_count, 0);
	check_event(ZZB_BDB_EVENT_FINDING_BINDING_INITIATOR, ZZB_BDB_SUCCESS);
}

/* BDB 8.5 step 8 */
ZTEST(zzb_bdb_fb, test_initiator_binding_table_full)
{
	zzb_apsme_bind_req_fake.custom_fake = NULL;
	zzb_apsme_bind_req_fake.return_val = -ENOMEM;
	query(0xffff);
	zzb_bdb_identify_query_rsp(node, OTHER_EP, RESPONDENT, 1);
	k_sleep(K_MSEC(5100));
	simple_desc(1, 0x0104);
	zzb_zdo_ieee_addr_conf(node, ZZB_ZDP_SUCCESS, RESPONDENT, RESPONDENT_EUI64);
	zassert_equal(zzb_apsme_bind_req_fake.call_count, 1);
	check_event(ZZB_BDB_EVENT_FINDING_BINDING_INITIATOR, ZZB_BDB_BINDING_TABLE_FULL);
}

/* BDB 8.5 steps 8 and 10: group bindings, then Add Group If Identifying as broadcast */
ZTEST(zzb_bdb_fb, test_initiator_group)
{
	query(0x0042);
	zzb_bdb_identify_query_rsp(node, OTHER_EP, RESPONDENT, 1);
	k_sleep(K_MSEC(5100));
	simple_desc(1, 0x0104);
	zassert_equal(zzb_zdo_ieee_addr_req_fake.call_count, 0);
	zassert_equal(zzb_apsme_bind_req_fake.call_count, 2);
	zassert_equal(bindings[0].dst_mode, ZZB_APS_ADDR_GROUP);
	zassert_equal(bindings[0].dst_addr, 0x0042);
	zassert_equal(bindings[0].cluster, 0x0006);

	zassert_equal(zzb_zcl_send_cmd_fake.call_count, 2);
	zassert_equal(zzb_zcl_send_cmd_fake.arg2_val, 0xffff);
	zassert_equal(zzb_zcl_send_cmd_fake.arg3_val, 0xff);
	zassert_equal(zzb_zcl_send_cmd_fake.arg4_val, 0x0004);
	zassert_equal(zzb_zcl_send_cmd_fake.arg5_val, 0x05);
	zassert_equal(zzb_zcl_send_cmd_fake.arg7_val, 3);
	zassert_mem_equal(sent_cmd, ((uint8_t[]){0x42, 0x00, 0x00}), 3);
	check_event(ZZB_BDB_EVENT_FINDING_BINDING_INITIATOR, ZZB_BDB_SUCCESS);
}

/* A parent link failure during the procedure starts the rejoin series */
ZTEST(zzb_bdb_fb, test_initiator_does_not_block_a_rejoin)
{
	query(0xffff);
	zzb_nlme_nwk_status_ind(node, ZZB_NWK_CODE_PARENT_LINK_FAILURE, 0x0000);
	k_sleep(K_MSEC(10));
	zassert_equal(zzb_nlme_join_req_fake.call_count, 1);
}

/* The reset of the node ends the procedure without an event */
ZTEST(zzb_bdb_fb, test_initiator_and_reset)
{
	query(0xffff);
	zzb_nlme_leave_ind(node, 0, false);
	k_sleep(K_MSEC(5100));
	check_event(ZZB_BDB_EVENT_LEFT, ZZB_BDB_SUCCESS);
}

ZTEST_SUITE(zzb_bdb_fb, NULL, setup, before, NULL, NULL);
```

## src/init.c
```c
/* SPDX-License-Identifier: Apache-2.0 */

#include <errno.h>
#include <zephyr/kernel.h>
#include <zephyr/ztest.h>
#include <zzb/bdb.h>

#include "bdb/bdb.h"
#include "common/node.h"
#include "fakes.h"
#include "nwk/nwk.h"

#define ALL_CHANNELS 0x07fff800

static struct zzb_node *node;

static void *setup(void)
{
	node = test_node();
	return NULL;
}

static void before(void *fixture)
{
	reset_fakes();
	reboot(true);
}

static void check_event(enum zzb_bdb_event event, enum zzb_bdb_status status)
{
	zassert_equal(events.count, 1);
	zassert_equal(events.event, event);
	zassert_equal(events.status, status);
}

/* Checks NLME-JOIN.request i of the rejoin series */
static void check_rejoin(int i, uint32_t channels, uint8_t duration, bool secure)
{
	zassert_true(zzb_nlme_join_req_fake.call_count > i);
	zassert_equal(zzb_nlme_join_req_fake.arg1_history[i], EXT_PAN_ID);
	zassert_equal(zzb_nlme_join_req_fake.arg2_history[i], ZZB_NWK_JOIN_REJOIN);
	zassert_equal(zzb_nlme_join_req_fake.arg3_history[i], channels);
	zassert_equal(zzb_nlme_join_req_fake.arg4_history[i], duration);
	zassert_equal(zzb_nlme_join_req_fake.arg5_history[i], CAPABILITY);
	zassert_equal(zzb_nlme_join_req_fake.arg6_history[i], secure);
}

/* BDB 7.1 step 2 */
ZTEST(zzb_bdb_init, test_start_off_a_network)
{
	reboot(false);
	zassert_ok(zzb_bdb_start(node));
	check_event(ZZB_BDB_EVENT_INIT, ZZB_BDB_NOT_ON_A_NETWORK);

	run_stack();
	zassert_equal(zzb_nlme_join_req_fake.call_count, 0);
}

/* BDB 7.1 steps 4 and 5 */
ZTEST(zzb_bdb_init, test_start_rejoins)
{
	zassert_ok(zzb_bdb_start(node));
	run_stack();
	zassert_equal(zzb_nlme_join_req_fake.call_count, 1);
	check_rejoin(0, 0, 0, true);
	zassert_equal(zzb_bdb_start(node), -EBUSY);
	zassert_equal(events.count, 0);

	zzb_nlme_join_conf(node, ZZB_NWK_STATUS_SUCCESS);
	zassert_equal(zzb_zdo_device_annce_req_fake.call_count, 1);
	check_event(ZZB_BDB_EVENT_INIT, ZZB_BDB_SUCCESS);
}

/* A changed sleepy flag applies at the next rejoin */
ZTEST(zzb_bdb_init, test_sleepy_node_rejoins_with_the_receiver_off)
{
	node->sleepy = true;
	zassert_ok(zzb_bdb_start(node));
	run_stack();
	node->sleepy = false;
	zassert_equal(zzb_nlme_join_req_fake.call_count, 1);
	zassert_equal(zzb_nlme_join_req_fake.arg5_val, SLEEPY_CAPABILITY);
}

/* The MAC refuses a scan while its TX FIFO holds frames */
ZTEST(zzb_bdb_init, test_busy_rejoin_is_repeated)
{
	zzb_nlme_join_req_fake.return_val = -EBUSY;
	zassert_ok(zzb_bdb_start(node));
	run_stack();
	zassert_equal(zzb_nlme_join_req_fake.call_count, 1);

	k_sleep(K_MSEC(900));
	zassert_equal(zzb_nlme_join_req_fake.call_count, 1);
	zzb_nlme_join_req_fake.return_val = 0;
	k_sleep(K_MSEC(200));
	zassert_equal(zzb_nlme_join_req_fake.call_count, 2);
	check_rejoin(1, 0, 0, true);
	zassert_equal(events.count, 0);
}

/* Secure on the channel of the network, secure on all channels, then a trust center rejoin */
static void fail_two_steps(void)
{
	run_stack();
	zzb_nlme_join_conf(node, ZZB_NWK_STATUS_NO_NETWORKS);
	run_stack();
	check_rejoin(1, ALL_CHANNELS, 3, true);
	zzb_nlme_join_conf(node, ZZB_NWK_STATUS_NOT_PERMITTED);
	run_stack();
	check_rejoin(2, ALL_CHANNELS, 3, false);
}

ZTEST(zzb_bdb_init, test_trust_center_rejoin_after_failed_secure_rejoins)
{
	zassert_ok(zzb_bdb_start(node));
	fail_two_steps();

	/* The network key arrives from the trust center */
	zzb_nlme_join_conf(node, ZZB_NWK_STATUS_SUCCESS);
	zassert_equal(zzb_zdo_device_annce_req_fake.call_count, 0);
	zzb_bdb_nwk_key_ind(node);
	zassert_equal(zzb_zdo_device_annce_req_fake.call_count, 1);
	check_event(ZZB_BDB_EVENT_INIT, ZZB_BDB_SUCCESS);
}

/* apsSecurityTimeOutPeriod, then the pause before the next series, which holds nothing */
ZTEST(zzb_bdb_init, test_network_key_does_not_arrive)
{
	zassert_ok(zzb_bdb_start(node));
	fail_two_steps();
	zassert_false(held());
	zzb_nlme_join_conf(node, ZZB_NWK_STATUS_SUCCESS);
	zassert_true(held());

	k_sleep(K_MSEC(1600));
	zassert_equal(events.count, 0);
	k_sleep(K_MSEC(200));
	check_event(ZZB_BDB_EVENT_INIT, ZZB_BDB_NO_NETWORK);
	zassert_false(held());

	k_sleep(K_MSEC(29800));
	zassert_equal(zzb_nlme_join_req_fake.call_count, 3);
	k_sleep(K_MSEC(400));
	zassert_equal(zzb_nlme_join_req_fake.call_count, 4);
	check_rejoin(3, 0, 0, true);
}

/* NWK stayed with the parent of the trust center rejoin, and the key comes late */
ZTEST(zzb_bdb_init, test_late_network_key_ends_the_pause)
{
	zassert_ok(zzb_bdb_start(node));
	fail_two_steps();
	zzb_nlme_join_conf(node, ZZB_NWK_STATUS_SUCCESS);
	k_sleep(K_MSEC(1800));
	check_event(ZZB_BDB_EVENT_INIT, ZZB_BDB_NO_NETWORK);

	zzb_bdb_nwk_key_ind(node);
	zassert_equal(zzb_zdo_device_annce_req_fake.call_count, 1);
	zassert_equal(events.count, 2);
	zassert_equal(events.status, ZZB_BDB_SUCCESS);
	k_sleep(K_SECONDS(30));
	zassert_equal(zzb_nlme_join_req_fake.call_count, 3);
}

static int64_t series_starts[8];
static int series_count;

/* Records the time of the first step of every series and fails every step */
static int fail_and_record(struct zzb_node *n, uint64_t ext_pan_id, enum zzb_nwk_join_method method,
			   uint32_t channels, uint8_t duration, uint8_t capability, bool secure)
{
	if (channels == 0 && series_count < ARRAY_SIZE(series_starts)) {
		series_starts[series_count++] = k_uptime_get();
	}

	return -ENETUNREACH;
}

/* 30 s, doubled after every failed series up to 15 min; NO_NETWORK is reported once */
ZTEST(zzb_bdb_init, test_pause_between_series)
{
	static const int pauses_s[] = {30, 60, 120, 240, 480, 900, 900};

	series_count = 0;
	zzb_nlme_join_req_fake.custom_fake = fail_and_record;
	zassert_ok(zzb_bdb_start(node));
	k_sleep(K_SECONDS(30 + 60 + 120 + 240 + 480 + 900 + 900 + 1));

	zassert_equal(series_count, ARRAY_SIZE(pauses_s) + 1);
	zassert_equal(zzb_nlme_join_req_fake.call_count, 3 * series_count);
	ARRAY_FOR_EACH(pauses_s, i) {
		zassert_within(series_starts[i + 1] - series_starts[i], pauses_s[i] * 1000, 20);
	}

	check_event(ZZB_BDB_EVENT_INIT, ZZB_BDB_NO_NETWORK);
	zassert_equal(zzb_bdb_start(node), -EBUSY);
}

ZTEST(zzb_bdb_init, test_parent_link_failure_starts_a_rejoin)
{
	zzb_nlme_nwk_status_ind(node, ZZB_NWK_CODE_PARENT_LINK_FAILURE, 0x0000);
	zassert_equal(zzb_nlme_join_req_fake.call_count, 0);
	run_stack();
	check_rejoin(0, 0, 0, true);

	/* A second failure during the series changes nothing */
	zzb_nlme_nwk_status_ind(node, ZZB_NWK_CODE_PARENT_LINK_FAILURE, 0x0000);
	run_stack();
	zassert_equal(zzb_nlme_join_req_fake.call_count, 1);

	zzb_nlme_join_conf(node, ZZB_NWK_STATUS_SUCCESS);
	zassert_equal(zzb_zdo_device_annce_req_fake.call_count, 1);
	check_event(ZZB_BDB_EVENT_REJOIN, ZZB_BDB_SUCCESS);
}

/* R22 3.6.1.9.3: an end device rejoins to get a new address */
ZTEST(zzb_bdb_init, test_address_conflict_starts_a_rejoin)
{
	zzb_nlme_nwk_status_ind(node, ZZB_NWK_CODE_ADDR_CONFLICT, NODE_ADDR + 1);
	run_stack();
	zassert_equal(zzb_nlme_join_req_fake.call_count, 0);

	zzb_nlme_nwk_status_ind(node, ZZB_NWK_CODE_ADDR_CONFLICT, NODE_ADDR);
	run_stack();
	check_rejoin(0, 0, 0, true);
}

/* R22 3.6.1.9.2: NWK has set the address from an unsolicited rejoin response */
ZTEST(zzb_bdb_init, test_address_update_announces_the_device)
{
	zzb_nlme_nwk_status_ind(node, ZZB_NWK_CODE_ADDR_UPDATE, NODE_ADDR + 1);
	zassert_equal(zzb_zdo_device_annce_req_fake.call_count, 0);

	zzb_nlme_nwk_status_ind(node, ZZB_NWK_CODE_ADDR_UPDATE, NODE_ADDR);
	zassert_equal(zzb_zdo_device_annce_req_fake.call_count, 1);
	run_stack();
	zassert_equal(zzb_nlme_join_req_fake.call_count, 0);
	zassert_equal(events.count, 0);
}

ZTEST(zzb_bdb_init, test_parent_link_failure_off_a_network)
{
	reboot(false);
	zzb_nlme_nwk_status_ind(node, ZZB_NWK_CODE_PARENT_LINK_FAILURE, 0x0000);
	run_stack();
	zassert_equal(zzb_nlme_join_req_fake.call_count, 0);
}

ZTEST_SUITE(zzb_bdb_init, NULL, setup, before, NULL, NULL);
```

## src/reset.c
```c
/* SPDX-License-Identifier: Apache-2.0 */

#include <errno.h>
#include <zephyr/kernel.h>
#include <zephyr/ztest.h>
#include <zzb/bdb.h>

#include "bdb/bdb.h"
#include "fakes.h"
#include "mac/mac.h"
#include "nwk/nwk.h"

static struct zzb_node *node;

static void *setup(void)
{
	node = test_node();
	return NULL;
}

static void before(void *fixture)
{
	reset_fakes();
	reboot(true);
}

/* NLME-RESET, the APS, ZDO and ZCL state, and bdbNodeIsOnANetwork FALSE */
static void check_reset(enum zzb_bdb_event event, enum zzb_bdb_status status)
{
	zassert_equal(zzb_nlme_reset_req_fake.call_count, 1);
	zassert_equal(zzb_aps_reset_fake.call_count, 1);
	zassert_equal(zzb_zdo_init_fake.call_count, 1);
	zassert_equal(zzb_zcl_reset_fake.call_count, 1);
	zassert_equal(events.count, 1);
	zassert_equal(events.event, event);
	zassert_equal(events.status, status);

	zassert_ok(zzb_bdb_start(node));
	zassert_equal(events.status, ZZB_BDB_NOT_ON_A_NETWORK);
}

/* BDB 9.5 */
ZTEST(zzb_bdb_reset, test_reset_leaves_the_network)
{
	zassert_ok(zzb_bdb_reset(node));
	zassert_equal(zzb_nlme_leave_req_fake.call_count, 1);
	zassert_false(zzb_nlme_leave_req_fake.arg1_val);
	zassert_equal(zzb_nlme_reset_req_fake.call_count, 0);
	zassert_equal(zzb_bdb_steering(node), -EBUSY);

	zzb_nlme_leave_conf(node, ZZB_MAC_STATUS_SUCCESS);
	check_reset(ZZB_BDB_EVENT_LEFT, ZZB_BDB_SUCCESS);
}

/* A node that has lost its parent cannot send the leave command */
ZTEST(zzb_bdb_reset, test_reset_without_a_parent)
{
	zzb_nlme_leave_req_fake.return_val = -ENOTCONN;
	zassert_ok(zzb_bdb_reset(node));
	check_reset(ZZB_BDB_EVENT_LEFT, ZZB_BDB_SUCCESS);
}

ZTEST(zzb_bdb_reset, test_reset_off_a_network)
{
	reboot(false);
	zassert_ok(zzb_bdb_reset(node));
	zassert_equal(zzb_nlme_leave_req_fake.call_count, 0);
	check_reset(ZZB_BDB_EVENT_LEFT, ZZB_BDB_SUCCESS);
}

/* NWK runs a procedure, such as a leave requested by the parent */
ZTEST(zzb_bdb_reset, test_reset_while_nwk_is_busy)
{
	zzb_nlme_leave_req_fake.return_val = -EBUSY;
	zassert_equal(zzb_bdb_reset(node), -EBUSY);

	reboot(false);
	zzb_nlme_reset_req_fake.return_val = -EBUSY;
	zassert_equal(zzb_bdb_reset(node), -EBUSY);
	zassert_equal(zzb_aps_reset_fake.call_count, 0);
	zassert_equal(events.count, 0);
}

ZTEST(zzb_bdb_reset, test_reset_cancels_the_pause_between_rejoins)
{
	zzb_nlme_join_req_fake.return_val = -ENETUNREACH;
	zassert_ok(zzb_bdb_start(node));
	run_stack();
	zassert_equal(events.status, ZZB_BDB_NO_NETWORK);

	zzb_nlme_leave_req_fake.return_val = -ENOTCONN;
	zassert_ok(zzb_bdb_reset(node));
	zassert_equal(events.count, 2);
	zassert_equal(events.event, ZZB_BDB_EVENT_LEFT);
	k_sleep(K_SECONDS(31));
	zassert_equal(zzb_nlme_join_req_fake.call_count, 3);
}

/* BDB 9.3 */
ZTEST(zzb_bdb_reset, test_leave_request_resets_the_node)
{
	zzb_nlme_leave_ind(node, 0, false);
	check_reset(ZZB_BDB_EVENT_LEFT, ZZB_BDB_SUCCESS);
}

/* R22 3.6.1.10.4: the node keeps its network and rejoins */
ZTEST(zzb_bdb_reset, test_leave_request_with_rejoin)
{
	zzb_nlme_leave_ind(node, 0, true);
	run_stack();
	zassert_equal(zzb_nlme_join_req_fake.call_count, 1);
	zassert_equal(zzb_nlme_join_req_fake.arg2_val, ZZB_NWK_JOIN_REJOIN);

	zzb_nlme_join_conf(node, ZZB_NWK_STATUS_SUCCESS);
	zassert_equal(events.count, 1);
	zassert_equal(events.event, ZZB_BDB_EVENT_REJOIN);
	zassert_equal(events.status, ZZB_BDB_SUCCESS);
	zassert_equal(zzb_nlme_reset_req_fake.call_count, 0);
}

/* BDB 9.4: ZDO has answered Mgmt_Leave_req */
ZTEST(zzb_bdb_reset, test_mgmt_leave_resets_the_node)
{
	zzb_bdb_leave(node, false);
	zassert_equal(zzb_nlme_leave_req_fake.call_count, 1);
	zassert_false(zzb_nlme_leave_req_fake.arg1_val);
	zassert_equal(events.count, 0);

	zzb_nlme_leave_conf(node, ZZB_MAC_STATUS_NO_ACK);
	check_reset(ZZB_BDB_EVENT_LEFT, ZZB_BDB_SUCCESS);
}

ZTEST(zzb_bdb_reset, test_mgmt_leave_with_rejoin)
{
	zzb_bdb_leave(node, true);
	zassert_true(zzb_nlme_leave_req_fake.arg1_val);
	zzb_nlme_leave_conf(node, ZZB_MAC_STATUS_SUCCESS);
	run_stack();
	zassert_equal(zzb_nlme_join_req_fake.call_count, 1);

	zzb_nlme_join_conf(node, ZZB_NWK_STATUS_SUCCESS);
	zassert_equal(events.event, ZZB_BDB_EVENT_REJOIN);
	zassert_equal(zzb_nlme_reset_req_fake.call_count, 0);
}

/* A rejoin started by the failed transmissions of Mgmt_Leave_rsp holds NWK */
ZTEST(zzb_bdb_reset, test_mgmt_leave_while_nwk_is_busy)
{
	zzb_nlme_leave_req_fake.return_val = -EBUSY;
	zzb_bdb_leave(node, false);
	k_sleep(K_MSEC(900));
	zassert_equal(zzb_nlme_leave_req_fake.call_count, 1);
	zzb_nlme_leave_req_fake.return_val = 0;
	k_sleep(K_MSEC(200));
	zassert_equal(zzb_nlme_leave_req_fake.call_count, 2);

	zzb_nlme_leave_conf(node, ZZB_MAC_STATUS_SUCCESS);
	check_reset(ZZB_BDB_EVENT_LEFT, ZZB_BDB_SUCCESS);
}

/* Without a key or a parent NLME-LEAVE gives no confirm */
ZTEST(zzb_bdb_reset, test_mgmt_leave_without_a_parent)
{
	zzb_nlme_leave_req_fake.return_val = -ENOTCONN;
	zzb_bdb_leave(node, false);
	check_reset(ZZB_BDB_EVENT_LEFT, ZZB_BDB_SUCCESS);
}

/* NWK reports a lost parent with parent link failure */
ZTEST(zzb_bdb_reset, test_leave_of_a_neighbor_is_ignored)
{
	zzb_nlme_leave_ind(node, 0x00124b0000000001ULL, false);
	run_stack();
	zassert_equal(zzb_nlme_reset_req_fake.call_count, 0);
	zassert_equal(zzb_nlme_join_req_fake.call_count, 0);
	zassert_equal(events.count, 0);
}

ZTEST_SUITE(zzb_bdb_reset, NULL, setup, before, NULL, NULL);
```

## src/steering.c
```c
/* SPDX-License-Identifier: Apache-2.0 */

#include <errno.h>
#include <zephyr/kernel.h>
#include <zephyr/ztest.h>
#include <zzb/bdb.h>

#include "bdb/bdb.h"
#include "common/node.h"
#include "fakes.h"
#include "mac/mac.h"
#include "nwk/nwk.h"
#include "zdo/zdo.h"

/* bdbPrimaryChannelSet and bdbSecondaryChannelSet */
#define PRIMARY   0x02108800
#define SECONDARY 0x05ef7000

#define OTHER_EXT_PAN_ID (EXT_PAN_ID + 1)

static struct zzb_node *node;

/* Descriptors of the last discovery, valid until the next one */
static struct zzb_nwk_network networks[2];

static void *setup(void)
{
	node = test_node();
	return NULL;
}

static void before(void *fixture)
{
	reset_fakes();
	reboot(false);
	networks[0] = (struct zzb_nwk_network){.ext_pan_id = OTHER_EXT_PAN_ID, .permit_join = true};
	networks[1] = (struct zzb_nwk_network){.ext_pan_id = EXT_PAN_ID, .permit_join = true};
}

static void check_event(int count, enum zzb_bdb_status status)
{
	zassert_equal(events.count, count);
	zassert_equal(events.event, ZZB_BDB_EVENT_STEERING);
	zassert_equal(events.status, status);
}

static void check_discovery(int i, uint32_t channels)
{
	zassert_equal(zzb_nlme_network_discovery_req_fake.call_count, i + 1);
	zassert_equal(zzb_nlme_network_discovery_req_fake.arg1_history[i], channels);
	zassert_equal(zzb_nlme_network_discovery_req_fake.arg2_history[i], 3);
}

/* Checks NLME-JOIN.request i: MAC association without security (BDB 8.2 step 7) */
static void check_join(int i, uint64_t ext_pan_id)
{
	zassert_equal(zzb_nlme_join_req_fake.call_count, i + 1);
	zassert_equal(zzb_nlme_join_req_fake.arg1_history[i], ext_pan_id);
	zassert_equal(zzb_nlme_join_req_fake.arg2_history[i], ZZB_NWK_JOIN_ASSOC);
	zassert_equal(zzb_nlme_join_req_fake.arg3_history[i], 0);
	zassert_equal(zzb_nlme_join_req_fake.arg4_history[i], 0);
	zassert_equal(zzb_nlme_join_req_fake.arg5_history[i], CAPABILITY);
	zassert_false(zzb_nlme_join_req_fake.arg6_history[i]);
}

/* bdbcMinCommissioningTime with TC significance (BDB 8.1 step 3, 8.2 step 14) */
static void check_permit_joining(int count)
{
	zassert_equal(zzb_zdo_mgmt_permit_joining_req_fake.call_count, count);
	zassert_equal(zzb_zdo_mgmt_permit_joining_req_fake.arg1_val, 180);
	zassert_true(zzb_zdo_mgmt_permit_joining_req_fake.arg2_val);
}

static void discovered(size_t count)
{
	zzb_nlme_network_discovery_conf(node, ZZB_MAC_STATUS_SUCCESS, networks, count);
}

/* The network key, then Node_Desc_rsp of a trust center of revision 20, which ends step 12 */
static void receive_key(void)
{
	zzb_bdb_nwk_key_ind(node);
	zassert_equal(zzb_zdo_node_desc_req_fake.call_count, 1);
	zzb_zdo_node_desc_conf(node, ZZB_ZDP_SUCCESS, 0x0000, 0x0000);
}

/* BDB 8.2 steps 2 to 16 */
ZTEST(zzb_bdb_steering, test_steering_joins_an_open_network)
{
	networks[0].permit_join = false;
	zassert_ok(zzb_bdb_steering(node));
	check_discovery(0, PRIMARY);
	zassert_equal(zzb_bdb_steering(node), -EBUSY);

	discovered(2);
	check_join(0, EXT_PAN_ID);
	zzb_nlme_join_conf(node, ZZB_MAC_STATUS_SUCCESS);
	zassert_equal(events.count, 0);

	receive_key();
	zassert_equal(zzb_zdo_device_annce_req_fake.call_count, 1);
	check_permit_joining(1);
	check_event(1, ZZB_BDB_SUCCESS);
}

/* Section 3: the power source is set independently of the sleepy flag */
ZTEST(zzb_bdb_steering, test_sleepy_node_joins_with_the_receiver_off)
{
	node->sleepy = true;
	zassert_ok(zzb_bdb_steering(node));
	discovered(1);
	node->sleepy = false;
	zassert_equal(zzb_nlme_join_req_fake.arg5_val, SLEEPY_CAPABILITY);
}

/* BDB 8.1: an end device only extends the permit joining of the routers */
ZTEST(zzb_bdb_steering, test_steering_on_a_network)
{
	reboot(true);
	zzb_zdo_mgmt_permit_joining_req_fake.return_val = -ENOBUFS;
	zassert_ok(zzb_bdb_steering(node));
	check_permit_joining(1);
	check_event(1, ZZB_BDB_SUCCESS);
	zassert_equal(zzb_nlme_network_discovery_req_fake.call_count, 0);
}

ZTEST(zzb_bdb_steering, test_failed_join_tries_the_next_network)
{
	zassert_ok(zzb_bdb_steering(node));
	discovered(2);
	check_join(0, OTHER_EXT_PAN_ID);
	zzb_nlme_join_conf(node, ZZB_MAC_STATUS_NO_ACK);
	check_join(1, EXT_PAN_ID);
	zzb_nlme_join_conf(node, ZZB_MAC_STATUS_SUCCESS);
	receive_key();
	check_event(1, ZZB_BDB_SUCCESS);
}

/* NWK finds no parent of the first network among the beacons */
ZTEST(zzb_bdb_steering, test_refused_join_request_tries_the_next_network)
{
	static int results[] = {-ENETUNREACH, 0};

	SET_RETURN_SEQ(zzb_nlme_join_req, results, ARRAY_SIZE(results));
	zassert_ok(zzb_bdb_steering(node));
	discovered(2);
	check_join(1, EXT_PAN_ID);
}

/* BDB 8.2 steps 13 and 17 */
ZTEST(zzb_bdb_steering, test_no_network_on_either_channel_set)
{
	zassert_ok(zzb_bdb_steering(node));
	zzb_nlme_network_discovery_conf(node, ZZB_MAC_STATUS_NO_BEACON, NULL, 0);
	check_discovery(1, SECONDARY);

	networks[0].permit_join = false;
	discovered(1);
	zassert_equal(zzb_nlme_join_req_fake.call_count, 0);
	check_event(1, ZZB_BDB_NO_NETWORK);
}

/*
 * BDB 8.2 step 10: the next suitable network of the same channels. A sleepy node fetches the key by
 * polls (BDB 6.8).
 */
ZTEST(zzb_bdb_steering, test_network_key_does_not_arrive)
{
	zassert_ok(zzb_bdb_steering(node));
	discovered(2);
	check_join(0, OTHER_EXT_PAN_ID);
	zassert_false(held());
	zzb_nlme_join_conf(node, ZZB_MAC_STATUS_SUCCESS);
	zassert_true(held());

	k_sleep(K_MSEC(1600));
	zassert_equal(zzb_nlme_reset_req_fake.call_count, 0);
	k_sleep(K_MSEC(200));
	zassert_equal(zzb_nlme_reset_req_fake.call_count, 1);
	zassert_equal(zzb_aps_reset_fake.call_count, 1);
	check_discovery(1, PRIMARY);
	zassert_false(held());

	/* The network that failed is skipped */
	discovered(2);
	check_join(1, EXT_PAN_ID);
	zzb_nlme_join_conf(node, ZZB_MAC_STATUS_SUCCESS);
	receive_key();
	check_event(1, ZZB_BDB_SUCCESS);
	zassert_false(held());
}

/* The MAC refuses a scan while its TX FIFO holds frames */
ZTEST(zzb_bdb_steering, test_busy_discovery_is_repeated)
{
	zzb_nlme_network_discovery_req_fake.return_val = -EBUSY;
	zassert_ok(zzb_bdb_steering(node));
	k_sleep(K_MSEC(900));
	zassert_equal(zzb_nlme_network_discovery_req_fake.call_count, 1);
	zzb_nlme_network_discovery_req_fake.return_val = 0;
	k_sleep(K_MSEC(200));
	check_discovery(1, PRIMARY);
	zassert_equal(events.count, 0);
}

/* A network key update on the network does not end a procedure */
ZTEST(zzb_bdb_steering, test_network_key_outside_steering_is_ignored)
{
	zzb_bdb_nwk_key_ind(node);
	zassert_equal(zzb_zdo_device_annce_req_fake.call_count, 0);
	zassert_equal(events.count, 0);
}

ZTEST_SUITE(zzb_bdb_steering, NULL, setup, before, NULL, NULL);
```

## src/tclk.c
```c
/* SPDX-License-Identifier: Apache-2.0 */

#include <errno.h>
#include <zephyr/kernel.h>
#include <zephyr/ztest.h>
#include <zzb/bdb.h>

#include "aps/aps.h"
#include "bdb/bdb.h"
#include "fakes.h"
#include "mac/mac.h"
#include "nwk/nwk.h"
#include "zdo/zdo.h"

/* Server mask with stack compliance revision 22 and 0 (Z-Stack Home 1.2) */
#define SERVER_MASK_R22 0x2c00
#define SERVER_MASK_R0  0x0001

static const uint8_t key_b[ZZB_SEC_KEY_LEN] = {
	0x20, 0x21, 0x22, 0x23, 0x24, 0x25, 0x26, 0x27,
	0x28, 0x29, 0x2a, 0x2b, 0x2c, 0x2d, 0x2e, 0x2f,
};

static struct zzb_node *node;

static void *setup(void)
{
	node = test_node();
	return NULL;
}

/* Steering up to BDB 8.2 step 11: the network key has arrived */
static void before(void *fixture)
{
	static struct zzb_nwk_network network = {.ext_pan_id = EXT_PAN_ID, .permit_join = true};

	reset_fakes();
	reboot(false);
	zassert_ok(zzb_bdb_steering(node));
	zzb_nlme_network_discovery_conf(node, ZZB_MAC_STATUS_SUCCESS, &network, 1);
	zzb_nlme_join_conf(node, ZZB_MAC_STATUS_SUCCESS);
	zzb_bdb_nwk_key_ind(node);
}

static void check_steering(enum zzb_bdb_status status)
{
	zassert_equal(events.count, 1);
	zassert_equal(events.event, ZZB_BDB_EVENT_STEERING);
	zassert_equal(events.status, status);
}

/* BDB 8.2 step 12: a leave without rejoin, then the reset */
static void check_failure(void)
{
	zassert_equal(events.count, 0);
	zassert_equal(zzb_nlme_leave_req_fake.call_count, 1);
	zassert_false(zzb_nlme_leave_req_fake.arg1_val);
	zassert_equal(zzb_zdo_mgmt_permit_joining_req_fake.call_count, 0);

	zzb_nlme_leave_conf(node, ZZB_MAC_STATUS_SUCCESS);
	zassert_equal(zzb_nlme_reset_req_fake.call_count, 1);
	zassert_equal(zzb_aps_reset_fake.call_count, 1);
	check_steering(ZZB_BDB_TCLK_EX_FAILURE);
}

static void receive_node_desc(uint16_t server_mask)
{
	zzb_zdo_node_desc_conf(node, ZZB_ZDP_SUCCESS, 0x0000, server_mask);
}

/* Steps 2 to 13 */
ZTEST(zzb_bdb_tclk, test_trust_center_link_key_exchange)
{
	zassert_equal(zzb_zdo_node_desc_req_fake.call_count, 1);
	zassert_equal(zzb_zdo_node_desc_req_fake.arg1_val, 0x0000);
	zassert_true(held());
	receive_node_desc(SERVER_MASK_R22);

	zassert_true(held());
	zassert_equal(zzb_apsme_request_key_req_fake.call_count, 1);
	zassert_equal(zzb_apsme_request_key_req_fake.arg1_val, TC_EUI64);
	zzb_bdb_tc_link_key_ind(node, TC_EUI64, key_b);
	zassert_equal(set_link_key.count, 1);
	zassert_equal(set_link_key.addr, TC_EUI64);
	zassert_mem_equal(set_link_key.key, key_b, ZZB_SEC_KEY_LEN);
	zassert_equal(set_link_key.attr, ZZB_APS_KEY_UNVERIFIED);
	zassert_equal(set_link_key.type, ZZB_APS_LINK_KEY_UNIQUE);

	zassert_equal(zzb_apsme_verify_key_req_fake.call_count, 1);
	zassert_equal(zzb_apsme_verify_key_req_fake.arg1_val, TC_EUI64);
	zassert_equal(zzb_apsme_verify_key_req_fake.arg2_val, ZZB_APS_KEY_TC_LINK);
	zassert_equal(events.count, 0);
	zassert_true(held());
	zzb_apsme_confirm_key_ind(node, ZZB_APS_STATUS_SUCCESS, TC_EUI64, ZZB_APS_KEY_TC_LINK);
	zassert_equal(zzb_zdo_mgmt_permit_joining_req_fake.call_count, 1);
	check_steering(ZZB_BDB_SUCCESS);
	zassert_false(held());

	/* A repeated Confirm Key belongs to no procedure */
	zzb_apsme_confirm_key_ind(node, ZZB_APS_STATUS_SUCCESS, TC_EUI64, ZZB_APS_KEY_TC_LINK);
	zassert_equal(events.count, 1);
}

/* Step 5 */
ZTEST(zzb_bdb_tclk, test_trust_center_before_r21)
{
	receive_node_desc(SERVER_MASK_R0);
	zassert_equal(zzb_apsme_request_key_req_fake.call_count, 0);
	check_steering(ZZB_BDB_SUCCESS);
}

/* Step 4: the confirm of the ZDO client is the timer */
ZTEST(zzb_bdb_tclk, test_node_desc_attempts)
{
	zzb_zdo_node_desc_conf(node, ZZB_ZDP_TIMEOUT, 0x0000, 0);
	zzb_zdo_node_desc_conf(node, ZZB_ZDP_NOT_SUPPORTED, 0x0000, 0);
	zassert_equal(zzb_zdo_node_desc_req_fake.call_count, 3);
	zzb_zdo_node_desc_conf(node, ZZB_ZDP_TIMEOUT, 0x0000, 0);
	check_failure();
}

/* A request that is not sent counts as an attempt and gets the BDB timer */
ZTEST(zzb_bdb_tclk, test_node_desc_request_not_sent)
{
	zzb_zdo_node_desc_req_fake.return_val = -ENOBUFS;
	zzb_zdo_node_desc_conf(node, ZZB_ZDP_TIMEOUT, 0x0000, 0);
	zassert_equal(zzb_zdo_node_desc_req_fake.call_count, 2);

	k_sleep(K_MSEC(4900));
	zassert_equal(zzb_zdo_node_desc_req_fake.call_count, 2);
	k_sleep(K_MSEC(200));
	zassert_equal(zzb_zdo_node_desc_req_fake.call_count, 3);
	k_sleep(K_SECONDS(5));
	check_failure();
}

/* Steps 7 and 8: bdbcTCLinkKeyExchangeTimeout per attempt */
ZTEST(zzb_bdb_tclk, test_request_key_attempts)
{
	receive_node_desc(SERVER_MASK_R22);
	k_sleep(K_MSEC(4900));
	zassert_equal(zzb_apsme_request_key_req_fake.call_count, 1);
	k_sleep(K_MSEC(200));
	zassert_equal(zzb_apsme_request_key_req_fake.call_count, 2);
	k_sleep(K_SECONDS(5));
	zassert_equal(zzb_apsme_request_key_req_fake.call_count, 3);
	zassert_equal(zzb_nlme_leave_req_fake.call_count, 0);
	k_sleep(K_SECONDS(5));
	check_failure();
}

/* Step 9 */
ZTEST(zzb_bdb_tclk, test_same_key_fails)
{
	receive_node_desc(SERVER_MASK_R22);
	zzb_bdb_tc_link_key_ind(node, TC_EUI64, tc_pair.key);
	zassert_equal(set_link_key.count, 0);
	check_failure();
}

/* Steps 11 and 12 */
ZTEST(zzb_bdb_tclk, test_verify_key_attempts)
{
	receive_node_desc(SERVER_MASK_R22);
	zzb_bdb_tc_link_key_ind(node, TC_EUI64, key_b);
	k_sleep(K_MSEC(5100));
	zassert_equal(zzb_apsme_verify_key_req_fake.call_count, 2);
	k_sleep(K_SECONDS(5));
	zassert_equal(zzb_apsme_verify_key_req_fake.call_count, 3);
	k_sleep(K_SECONDS(5));
	check_failure();
}

/* BDB 10.2.6: acceptNewUnsolicitedTrustCenterLinkKey is FALSE */
ZTEST(zzb_bdb_tclk, test_unsolicited_trust_center_link_key)
{
	receive_node_desc(SERVER_MASK_R0);
	zzb_bdb_tc_link_key_ind(node, TC_EUI64, key_b);
	zassert_equal(set_link_key.count, 0);
}

ZTEST_SUITE(zzb_bdb_tclk, NULL, setup, before, NULL, NULL);
```
