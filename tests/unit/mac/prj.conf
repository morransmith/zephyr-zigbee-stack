## CMakeLists.txt
```
# SPDX-License-Identifier: Apache-2.0

cmake_minimum_required(VERSION 3.20.0)

find_package(Zephyr REQUIRED HINTS $ENV{ZEPHYR_BASE})
project(zzb_unit_mac)

target_include_directories(app PRIVATE ${ZEPHYR_ZZB_MODULE_DIR}/subsys/zzb)
target_sources(app PRIVATE
  src/assoc.c
  src/fakes.c
  src/frame.c
  src/mac.c
  src/poll.c
  src/scan.c
  src/tx.c
)
target_sources_ifdef(CONFIG_PM app PRIVATE src/pm.c)
```

## Kconfig
```
# SPDX-License-Identifier: Apache-2.0

mainmenu "zzb MAC unit test"

config TEST_PM_HOOKS
	bool "The test defines the PM hooks of the SoC"
	default y
	select HAS_PM

source "Kconfig.zephyr"
```

## prj.conf
```kconfig
# SPDX-License-Identifier: Apache-2.0

CONFIG_ZTEST=y
CONFIG_ZZB=y
# The test fakes the NWK functions the MAC calls
CONFIG_ZZB_NWK=n
CONFIG_NETWORKING=y
CONFIG_IEEE802154=y
CONFIG_IEEE802154_RAW_MODE=y
# Injected frames have no trailing FCS or LQI bytes
CONFIG_IEEE802154_L2_PKT_INCL_FCS=n
# native_sim enables Ethernet, which needs the net_if code that raw mode leaves out
CONFIG_NET_L2_ETHERNET=n
```

## pm.overlay
```dts
/* SPDX-License-Identifier: Apache-2.0 */

/* No CPU lists the state, so the PM policy never enters it */
/ {
	power-states {
		standby: standby {
			compatible = "zephyr,power-state";
			power-state-name = "standby";
			min-residency-us = <1000>;
		};
	};
};
```

## src/assoc.c
```c
/* SPDX-License-Identifier: Apache-2.0 */

#include <errno.h>
#include <zephyr/ztest.h>

#include "common/node.h"
#include "fakes.h"
#include "mac/frame.h"
#include "mac/mac.h"

#define PARENT_EUI64 0x0102030405060708ULL

static const struct zzb_mac_addr coord = {
	.mode = ZZB_MAC_ADDR_SHORT,
	.pan_id = PAN_ID,
	.short_addr = PARENT_SHORT,
};

/* R22 Table D-1, first form; capability: allocate address */
static const uint8_t assoc_req[] = {0x23, 0xc8, 0x00, 0x62, 0x1a, 0x00, 0x00, 0xff, 0xff, 0x77,
				    0x66, 0x55, 0x44, 0x33, 0x22, 0x11, 0x00, 0x01, 0x80};

/* R22 Table D-2, first form */
static const uint8_t data_req[] = {0x23, 0xc8, 0x00, 0x62, 0x1a, 0x00, 0x00, 0xff, 0xff,
				   0x77, 0x66, 0x55, 0x44, 0x33, 0x22, 0x11, 0x00, 0x04};

/* R22 Table D-3, first form: short address 0x5678, association successful */
static const uint8_t assoc_rsp[] = {0x63, 0xcc, 0x10, 0x62, 0x1a, 0x77, 0x66, 0x55, 0x44,
				    0x33, 0x22, 0x11, 0x00, 0x08, 0x07, 0x06, 0x05, 0x04,
				    0x03, 0x02, 0x01, 0x02, 0x78, 0x56, 0x00};

/* The same response with status PAN at capacity */
static const uint8_t assoc_rsp_full[] = {0x63, 0xcc, 0x10, 0x62, 0x1a, 0x77, 0x66, 0x55, 0x44,
					 0x33, 0x22, 0x11, 0x00, 0x08, 0x07, 0x06, 0x05, 0x04,
					 0x03, 0x02, 0x01, 0x02, 0xff, 0xff, 0x01};

static void set_reply(const uint8_t *frame, size_t len)
{
	parent.pending = true;
	parent.reply = frame;
	parent.reply_len = len;
	parent.reply_to = ZZB_MAC_CMD_DATA_REQ;
}

ZTEST(zzb_mac_assoc, test_association_succeeds)
{
	/* Data frame with the short source address after association */
	static const uint8_t data[] = {0x61, 0x88, 0x00, 0x62, 0x1a, 0x00, 0x00, 0x78, 0x56, 0x42};
	static const uint8_t msdu[] = {0x42};

	set_reply(assoc_rsp, sizeof(assoc_rsp));

	zassert_ok(zzb_mlme_assoc_req(node, 15, &coord, 0x80));
	zassert_equal(zzb_mlme_scan_req(node, BIT(11), 0), -EBUSY);
	zassert_equal(zzb_mlme_poll_req(node, &coord), -EBUSY);
	zassert_equal(zzb_mlme_assoc_req(node, 15, &coord, 0x80), -EBUSY);

	/* The data request follows macResponseWaitTime, 491.52 ms */
	k_sleep(K_MSEC(480));
	zassert_equal(sent_count, 1);
	k_sleep(K_MSEC(40));

	check_sent(0, assoc_req, sizeof(assoc_req));
	zassert_equal(sent[0].radio.channel, 15);
	zassert_equal(sent[0].radio.pan_id, PAN_ID);
	check_sent(1, data_req, sizeof(data_req));
	zassert_equal(zzb_mlme_assoc_conf_fake.call_count, 1);
	zassert_equal(zzb_mlme_assoc_conf_fake.arg1_val, 0x5678);
	zassert_equal(zzb_mlme_assoc_conf_fake.arg2_val, ZZB_MAC_STATUS_SUCCESS);
	zassert_equal(radio.short_addr, 0x5678);
	zassert_equal(node->mac.coord_short_addr, PARENT_SHORT);
	zassert_equal(zzb_mlme_get_coord_ext_addr(node), PARENT_EUI64);

	zassert_ok(zzb_mcps_data_req(node, msdu_buf(1, msdu, sizeof(msdu))));
	run_stack();
	check_sent(2, data, sizeof(data));
}

ZTEST(zzb_mac_assoc, test_association_failures_reset_pan_id)
{
	/* lost = 4: the association request and its 3 retries (macMaxFrameRetries) get no ACK */
	static const struct {
		int lost;
		bool pending;
		const uint8_t *reply;
		enum zzb_mac_status status;
		int sent;
	} cases[] = {
		{.lost = 4, .status = ZZB_MAC_STATUS_NO_ACK, .sent = 4},
		{.status = ZZB_MAC_STATUS_NO_DATA, .sent = 2},
		{.pending = true, .status = ZZB_MAC_STATUS_NO_DATA, .sent = 2},
		{.pending = true,
		 .reply = assoc_rsp_full,
		 .status = ZZB_MAC_STATUS_PAN_AT_CAPACITY,
		 .sent = 2},
	};

	ARRAY_FOR_EACH_PTR(cases, c) {
		mac_before(NULL);
		set_reply(c->reply, sizeof(assoc_rsp_full));
		parent.pending = c->pending;
		parent.lost = c->lost;

		zassert_ok(zzb_mlme_assoc_req(node, 15, &coord, 0x80));
		k_sleep(K_MSEC(700));

		zassert_equal(zzb_mlme_assoc_conf_fake.call_count, 1, "case %d", c - cases);
		zassert_equal(zzb_mlme_assoc_conf_fake.arg1_val, 0xffff);
		zassert_equal(zzb_mlme_assoc_conf_fake.arg2_val, c->status, "case %d", c - cases);
		zassert_equal(node->mac.pan_id, 0xffff);
		zassert_equal(radio.pan_id, 0xffff);
		zassert_equal(radio.short_addr, 0xffff);
		zassert_equal(sent_count, c->sent, "case %d", c - cases);
		mac_after(NULL);
	}
}

/* The receiver is also on for macResponseWaitTime between the requests */
ZTEST(zzb_mac_assoc, test_sleepy_node_receives_during_the_association)
{
	static const struct {
		const uint8_t *reply;
		enum zzb_mac_status status;
	} cases[] = {
		{.reply = assoc_rsp, .status = ZZB_MAC_STATUS_SUCCESS},
		{.reply = assoc_rsp_full, .status = ZZB_MAC_STATUS_PAN_AT_CAPACITY},
	};

	ARRAY_FOR_EACH_PTR(cases, c) {
		mac_before(NULL);
		mac_init_sleepy();
		set_reply(c->reply, sizeof(assoc_rsp));

		/* Capability: allocate address, receiver off when idle */
		zassert_ok(zzb_mlme_assoc_req(node, 15, &coord, 0x80));
		k_sleep(K_MSEC(600));

		zassert_equal(zzb_mlme_assoc_conf_fake.arg2_val, c->status, "case %d", c - cases);
		zassert_equal(sent_count, 2);
		zassert_true(sent[0].radio.rx_on_when_idle);
		zassert_true(sent[1].radio.rx_on_when_idle);
		zassert_false(radio.rx_on_when_idle, "case %d", c - cases);
		zassert_false(radio.started, "case %d", c - cases);
		mac_after(NULL);
	}
}

ZTEST_SUITE(zzb_mac_assoc, NULL, mac_setup, mac_before, mac_after, NULL);
```

## src/fakes.c
```c
/* SPDX-License-Identifier: Apache-2.0 */

#include <errno.h>
#include <string.h>
#include <zephyr/fff.h>
#include <zephyr/net/ieee802154_radio.h>
#include <zephyr/net/net_pkt.h>
#include <zephyr/pm/policy.h>
#include <zephyr/sys/byteorder.h>
#include <zephyr/ztest.h>
#include <zzb/zzb.h>

#include "common/node.h"
#include "fakes.h"
#include "mac/frame.h"
#include "mac/mac.h"

DEFINE_FFF_GLOBALS;

FAKE_VALUE_FUNC(enum ieee802154_hw_caps, radio_get_caps, const struct device *);
DEFINE_FAKE_VALUE_FUNC(int, radio_start, const struct device *);
FAKE_VALUE_FUNC(int, radio_stop, const struct device *);
FAKE_VALUE_FUNC(int, radio_set_channel, const struct device *, uint16_t);
FAKE_VALUE_FUNC(int, radio_filter, const struct device *, bool, enum ieee802154_filter_type,
		const struct ieee802154_filter *);
FAKE_VALUE_FUNC(int, radio_tx, const struct device *, enum ieee802154_tx_mode, struct net_pkt *,
		struct net_buf *);
FAKE_VALUE_FUNC(int, radio_configure, const struct device *, enum ieee802154_config_type,
		const struct ieee802154_config *);
DEFINE_FAKE_VOID_FUNC(zzb_mcps_data_conf, struct zzb_node *, uint8_t, enum zzb_mac_status);
DEFINE_FAKE_VOID_FUNC(zzb_mcps_data_ind, struct zzb_node *, struct net_buf *);
DEFINE_FAKE_VOID_FUNC(zzb_mlme_scan_conf, struct zzb_node *, enum zzb_mac_status);
DEFINE_FAKE_VOID_FUNC(zzb_mlme_poll_conf, struct zzb_node *, enum zzb_mac_status);
DEFINE_FAKE_VOID_FUNC(zzb_mlme_assoc_conf, struct zzb_node *, uint16_t, enum zzb_mac_status);
DEFINE_FAKE_VOID_FUNC(zzb_mlme_beacon_notify_ind, struct zzb_node *, struct net_buf *, uint8_t,
		      uint16_t);

static const struct ieee802154_radio_api radio_api = {
	.get_capabilities = radio_get_caps,
	.start = radio_start,
	.stop = radio_stop,
	.set_channel = radio_set_channel,
	.filter = radio_filter,
	.tx = radio_tx,
	.configure = radio_configure,
};

DEVICE_DEFINE(test_radio, "test_radio", NULL, NULL, NULL, NULL, POST_KERNEL,
	      CONFIG_KERNEL_INIT_PRIORITY_DEFAULT, &radio_api);

const struct device *const radio_dev = DEVICE_GET(test_radio);
struct radio_state radio;
struct sent_frame sent[8];
int sent_count;
struct parent parent;
struct zzb_node *node;
struct rx_copy data_ind;
struct rx_copy beacon;

static void copy_rx(struct rx_copy *copy, struct net_buf *buf)
{
	memcpy(copy->data, buf->data, buf->len);
	copy->len = buf->len;
	copy->meta = *zzb_frame_meta(buf);
	net_buf_unref(buf);
}

static void data_ind_fake(struct zzb_node *n, struct net_buf *buf)
{
	copy_rx(&data_ind, buf);
}

static void beacon_notify_ind_fake(struct zzb_node *n, struct net_buf *buf, uint8_t channel,
				   uint16_t superframe)
{
	copy_rx(&beacon, buf);
}

static int start_fake(const struct device *dev)
{
	radio.started = true;
	return 0;
}

static int stop_fake(const struct device *dev)
{
	radio.started = false;
	return 0;
}

static int configure_fake(const struct device *dev, enum ieee802154_config_type type,
			  const struct ieee802154_config *config)
{
	if (type != IEEE802154_CONFIG_RX_ON_WHEN_IDLE) {
		return -ENOTSUP;
	}

	radio.rx_on_when_idle = config->rx_on_when_idle;
	return 0;
}

static int set_channel_fake(const struct device *dev, uint16_t channel)
{
	radio.channel = channel;
	return 0;
}

static int filter_fake(const struct device *dev, bool set, enum ieee802154_filter_type type,
		       const struct ieee802154_filter *filter)
{
	switch (type) {
	case IEEE802154_FILTER_TYPE_IEEE_ADDR:
		radio.ext_addr = sys_get_le64(filter->ieee_addr);
		break;
	case IEEE802154_FILTER_TYPE_SHORT_ADDR:
		radio.short_addr = filter->short_addr;
		break;
	case IEEE802154_FILTER_TYPE_PAN_ID:
		radio.pan_id = filter->pan_id;
		break;
	default:
		break;
	}

	return 0;
}

static void send_ack(uint8_t seq)
{
	const uint8_t ack[] = {parent.pending ? 0x12 : 0x02, 0x00, seq};
	struct net_pkt *pkt =
		net_pkt_rx_alloc_with_buffer(NULL, sizeof(ack), NET_AF_UNSPEC, 0, K_NO_WAIT);

	zassert_not_null(pkt);
	zassert_ok(net_pkt_write(pkt, ack, sizeof(ack)));
	ieee802154_handle_ack(NULL, pkt);
	net_pkt_unref(pkt);
}

static bool reply_due(struct net_buf *frag)
{
	struct zzb_mac_hdr hdr;
	int len = zzb_mac_hdr_parse(frag->data, frag->len, &hdr);

	return parent.reply != NULL && len > 0 && hdr.type == ZZB_MAC_FRAME_CMD &&
	       frag->data[len] == parent.reply_to &&
	       (parent.reply_channel == 0 || parent.reply_channel == radio.channel);
}

static int tx_fake(const struct device *dev, enum ieee802154_tx_mode mode, struct net_pkt *pkt,
		   struct net_buf *frag)
{
	struct sent_frame *s;

	zassert_true(sent_count < ARRAY_SIZE(sent));
	s = &sent[sent_count++];
	memcpy(s->data, frag->data, frag->len);
	s->len = frag->len;
	s->radio = radio;
	s->pm_locked = pm_locked();

	if (radio.channel == parent.busy_channel) {
		return -EBUSY;
	}

	if (ieee802154_is_ar_flag_set(frag)) {
		if (parent.lost > 0) {
			parent.lost--;
			return -ENOMSG;
		}

		send_ack(frag->data[2]);
	}

	if (reply_due(frag)) {
		inject(parent.reply, parent.reply_len);
	}

	return 0;
}

static void reset_fakes(void)
{
	RESET_FAKE(radio_get_caps);
	RESET_FAKE(radio_start);
	RESET_FAKE(radio_stop);
	RESET_FAKE(radio_set_channel);
	RESET_FAKE(radio_filter);
	RESET_FAKE(radio_tx);
	RESET_FAKE(radio_configure);
	RESET_FAKE(zzb_mcps_data_conf);
	RESET_FAKE(zzb_mcps_data_ind);
	RESET_FAKE(zzb_mlme_scan_conf);
	RESET_FAKE(zzb_mlme_poll_conf);
	RESET_FAKE(zzb_mlme_assoc_conf);
	RESET_FAKE(zzb_mlme_beacon_notify_ind);
	FFF_RESET_HISTORY();
	radio_get_caps_fake.return_val = IEEE802154_HW_TX_RX_ACK | IEEE802154_HW_CSMA;
	radio_start_fake.custom_fake = start_fake;
	radio_stop_fake.custom_fake = stop_fake;
	radio_set_channel_fake.custom_fake = set_channel_fake;
	radio_filter_fake.custom_fake = filter_fake;
	radio_tx_fake.custom_fake = tx_fake;
	radio_configure_fake.custom_fake = configure_fake;
	zzb_mcps_data_ind_fake.custom_fake = data_ind_fake;
	zzb_mlme_beacon_notify_ind_fake.custom_fake = beacon_notify_ind_fake;
	/* nrf5 and esp32 start with RxOnWhenIdle TRUE */
	radio = (struct radio_state){.rx_on_when_idle = true};
	sent_count = 0;
	parent = (struct parent){0};
}

void *mac_setup(void)
{
	const struct zzb_node_config cfg = {
		.eui64 = NODE_EUI64,
		.radio = radio_dev,
	};

	/* CONFIG_ZZB_NODE_COUNT is 1, so the suites share one node */
	if (node == NULL) {
		reset_fakes();
		zassert_ok(zzb_node_init(&cfg, &node));
	}

	return NULL;
}

void mac_before(void *fixture)
{
	reset_fakes();
	node->sleepy = false;
	zassert_ok(zzb_mac_init(node, radio_dev));
}

void mac_init_sleepy(void)
{
	node->sleepy = true;
	radio_get_caps_fake.return_val |= IEEE802154_RX_ON_WHEN_IDLE;
	zassert_ok(zzb_mac_init(node, radio_dev));
}

void mac_after(void *fixture)
{
	struct net_buf *bufs[CONFIG_ZZB_BUF_COUNT];

	zassert_equal(node->mac.op, ZZB_MAC_OP_NONE);
	zassert_false(k_work_delayable_is_pending(&node->mac.timer));
	zassert_true(k_fifo_is_empty(&node->mac.tx_fifo));
	if (!node->sleepy) {
		zassert_equal(radio_configure_fake.call_count, 0);
		zassert_equal(radio_stop_fake.call_count, 0);
	}

	zassert_equal(pm_locked(), IS_ENABLED(CONFIG_PM) && !node->sleepy);

	ARRAY_FOR_EACH(bufs, i) {
		bufs[i] = zzb_buf_alloc(K_NO_WAIT);
		zassert_not_null(bufs[i], "buffer leak");
	}

	ARRAY_FOR_EACH(bufs, i) {
		net_buf_unref(bufs[i]);
	}
}

bool pm_locked(void)
{
	return pm_policy_state_lock_is_active(PM_STATE_STANDBY, PM_ALL_SUBSTATES);
}

void run_stack(void)
{
	/* The test thread is cooperative and has a lower priority than the stack thread */
	k_yield();
}

void inject(const uint8_t *frame, size_t len)
{
	struct net_pkt *pkt = net_pkt_rx_alloc_with_buffer(NULL, len, NET_AF_UNSPEC, 0, K_NO_WAIT);

	zassert_not_null(pkt);
	zassert_ok(net_pkt_write(pkt, frame, len));
	zassert_ok(net_recv_data(NULL, pkt));
}

struct net_buf *msdu_buf(uint8_t handle, const uint8_t *msdu, size_t len)
{
	struct net_buf *buf = zzb_buf_alloc(K_NO_WAIT);
	struct zzb_frame_meta *meta;

	zassert_not_null(buf);
	net_buf_reserve(buf, ZZB_MAC_HDR_MAX_LEN);
	net_buf_add_mem(buf, msdu, len);

	meta = zzb_frame_meta(buf);
	meta->dst = (struct zzb_mac_addr){
		.mode = ZZB_MAC_ADDR_SHORT,
		.pan_id = PAN_ID,
		.short_addr = PARENT_SHORT,
	};
	meta->flags = ZZB_FRAME_ACK_REQ;
	meta->handle = handle;
	return buf;
}

void check_sent(int i, const uint8_t *frame, size_t len)
{
	zassert_true(i < sent_count, "frame %d not sent", i);
	zassert_equal(sent[i].len, len, "frame %d", i);
	zassert_mem_equal(sent[i].data, frame, 2, "frame %d", i);
	zassert_mem_equal(sent[i].data + 3, frame + 3, len - 3, "frame %d", i);
}
```

## src/fakes.h
```c
/* SPDX-License-Identifier: Apache-2.0 */

#ifndef ZZB_TESTS_UNIT_MAC_FAKES_H_
#define ZZB_TESTS_UNIT_MAC_FAKES_H_

#include <stdbool.h>
#include <stddef.h>
#include <stdint.h>
#include <zephyr/device.h>
#include <zephyr/fff.h>
#include <zephyr/net_buf.h>

#include "common/buf.h"
#include "mac/mac.h"

#define NODE_EUI64 0x0011223344556677ULL

/* The parent played by the tx() fake */
#define PAN_ID       0x1a62
#define PARENT_SHORT 0x0000

/* What the MAC has programmed into the test radio */
struct radio_state {
	uint64_t ext_addr;
	uint16_t pan_id;
	uint16_t short_addr;
	uint16_t channel;
	/* Set by start(), cleared by stop() */
	bool started;
	bool rx_on_when_idle;
};

struct sent_frame {
	uint8_t data[ZZB_BUF_SIZE];
	size_t len;
	/* The radio when the frame was sent */
	struct radio_state radio;
	bool pm_locked;
};

/* Behavior of the parent, reset before each test */
struct parent {
	/* Number of frames with the ACK request bit that get no ACK */
	int lost;
	/* ACKs have the frame pending bit set */
	bool pending;
	/* tx() on this channel returns -EBUSY, as after a CSMA-CA failure */
	uint16_t busy_channel;
	/* Frame received after the command reply_to, on reply_channel or on any channel if 0 */
	const uint8_t *reply;
	size_t reply_len;
	uint8_t reply_to;
	uint16_t reply_channel;
};

/* Frame passed up by an indication */
struct rx_copy {
	uint8_t data[ZZB_BUF_SIZE];
	size_t len;
	struct zzb_frame_meta meta;
};

extern const struct device *const radio_dev;
extern struct radio_state radio;
extern struct sent_frame sent[8];
extern int sent_count;
extern struct parent parent;
extern struct zzb_node *node;
extern struct rx_copy data_ind;
extern struct rx_copy beacon;

DECLARE_FAKE_VALUE_FUNC(int, radio_start, const struct device *);
DECLARE_FAKE_VOID_FUNC(zzb_mcps_data_conf, struct zzb_node *, uint8_t, enum zzb_mac_status);
DECLARE_FAKE_VOID_FUNC(zzb_mcps_data_ind, struct zzb_node *, struct net_buf *);
DECLARE_FAKE_VOID_FUNC(zzb_mlme_scan_conf, struct zzb_node *, enum zzb_mac_status);
DECLARE_FAKE_VOID_FUNC(zzb_mlme_poll_conf, struct zzb_node *, enum zzb_mac_status);
DECLARE_FAKE_VOID_FUNC(zzb_mlme_assoc_conf, struct zzb_node *, uint16_t, enum zzb_mac_status);
DECLARE_FAKE_VOID_FUNC(zzb_mlme_beacon_notify_ind, struct zzb_node *, struct net_buf *, uint8_t,
		       uint16_t);

/* Suite hooks shared by the MAC suites: one node, its MAC initialized again before each test */
void *mac_setup(void);
void mac_before(void *fixture);
/* Initializes the MAC again as the MAC of a sleepy node, on a radio with RxOnWhenIdle */
void mac_init_sleepy(void);
/*
 * Checks that the MAC is idle and has released every buffer, that a node that is not sleepy has
 * not called configure() or stop(), and that only such a node holds the PM lock
 */
void mac_after(void *fixture);

/* Returns whether the PM policy may not enter the standby state of pm.overlay */
bool pm_locked(void);

/* Runs the stack thread until it waits, without advancing the time */
void run_stack(void);

/* Passes frame to the radio port as a received frame */
void inject(const uint8_t *frame, size_t len);

/* Returns a buffer with the MSDU for MCPS-DATA.request to the parent, with ACK request */
struct net_buf *msdu_buf(uint8_t handle, const uint8_t *msdu, size_t len);

/* Compares sent frame i with frame, except its sequence number */
void check_sent(int i, const uint8_t *frame, size_t len);

#endif /* ZZB_TESTS_UNIT_MAC_FAKES_H_ */
```

## src/frame.c
```c
/* SPDX-License-Identifier: Apache-2.0 */

#include <errno.h>
#include <string.h>
#include <zephyr/ztest.h>

#include "mac/frame.h"

static void check_addr(const struct zzb_mac_addr *addr, const struct zzb_mac_addr *expected)
{
	zassert_equal(addr->mode, expected->mode);
	zassert_equal(addr->pan_id, expected->pan_id);
	zassert_equal(addr->short_addr, expected->short_addr);
	zassert_equal(addr->ext_addr, expected->ext_addr);
}

static void check_hdr_round_trip(const uint8_t *bytes, size_t len,
				 const struct zzb_mac_hdr *expected)
{
	struct zzb_mac_hdr hdr;
	uint8_t buf[ZZB_MAC_HDR_MAX_LEN];

	zassert_equal(zzb_mac_hdr_parse(bytes, len, &hdr), len);
	zassert_equal(hdr.type, expected->type);
	zassert_equal(hdr.flags, expected->flags);
	zassert_equal(hdr.seq, expected->seq);
	check_addr(&hdr.dst, &expected->dst);
	check_addr(&hdr.src, &expected->src);

	zassert_equal(zzb_mac_hdr_len(&hdr), len);
	zassert_equal(zzb_mac_hdr_write(&hdr, buf), len);
	zassert_mem_equal(buf, bytes, len);
}

/* MAC header of test_frame_data in Ziggurat (see NOTICE) */
static const uint8_t data_hdr[] = {0x61, 0x88, 0xa3, 0xf5, 0x3e, 0x34, 0x52, 0x63, 0xf6};

ZTEST(zzb_mac_frame, test_data_header)
{
	const struct zzb_mac_hdr expected = {
		.type = ZZB_MAC_FRAME_DATA,
		.flags = ZZB_FRAME_ACK_REQ,
		.seq = 163,
		.dst = {.mode = ZZB_MAC_ADDR_SHORT, .pan_id = 0x3ef5, .short_addr = 0x5234},
		.src = {.mode = ZZB_MAC_ADDR_SHORT, .pan_id = 0x3ef5, .short_addr = 0xf663},
	};

	check_hdr_round_trip(data_hdr, sizeof(data_hdr), &expected);
}

/* test_frame_ack in Ziggurat (see NOTICE), then the same ACK with frame pending set */
ZTEST(zzb_mac_frame, test_ack_header)
{
	static const uint8_t ack[] = {0x02, 0x00, 0xd1};
	static const uint8_t ack_pending[] = {0x12, 0x00, 0xd1};
	struct zzb_mac_hdr expected = {
		.type = ZZB_MAC_FRAME_ACK,
		.seq = 209,
	};

	check_hdr_round_trip(ack, sizeof(ack), &expected);

	expected.flags = ZZB_FRAME_PENDING;
	check_hdr_round_trip(ack_pending, sizeof(ack_pending), &expected);
}

/* MAC header of test_beacon_request in Ziggurat (see NOTICE) */
ZTEST(zzb_mac_frame, test_beacon_request_header)
{
	static const uint8_t bytes[] = {0x03, 0x08, 0x6d, 0xff, 0xff, 0xff, 0xff};
	const struct zzb_mac_hdr expected = {
		.type = ZZB_MAC_FRAME_CMD,
		.seq = 109,
		.dst = {.mode = ZZB_MAC_ADDR_SHORT, .pan_id = 0xffff, .short_addr = 0xffff},
	};

	check_hdr_round_trip(bytes, sizeof(bytes), &expected);
}

/* Source address of the Ziggurat association request */
static const uint64_t joiner_addr = 0xbc026efffe494a31ULL;

/* MAC header of test_association_request in Ziggurat (see NOTICE), R22 Table D-1 first option */
static const uint8_t assoc_req_hdr[] = {
	0x23, 0xc8, 0x13, 0x26, 0x1c, 0x00, 0x00, 0xff, 0xff,
	0x31, 0x4a, 0x49, 0xfe, 0xff, 0x6e, 0x02, 0xbc,
};

ZTEST(zzb_mac_frame, test_association_request_header)
{
	const struct zzb_mac_hdr expected = {
		.type = ZZB_MAC_FRAME_CMD,
		.flags = ZZB_FRAME_ACK_REQ,
		.seq = 19,
		.dst = {.mode = ZZB_MAC_ADDR_SHORT, .pan_id = 0x1c26, .short_addr = 0x0000},
		.src = {.mode = ZZB_MAC_ADDR_EXT, .pan_id = 0xffff, .ext_addr = joiner_addr},
	};

	check_hdr_round_trip(assoc_req_hdr, sizeof(assoc_req_hdr), &expected);
}

/* R22 Table D-1 other options: PAN ID compression, then no destination (to the PAN coordinator) */
ZTEST(zzb_mac_frame, test_association_request_header_options)
{
	static const uint8_t pan_id_comp[] = {
		0x63, 0xc8, 0x13, 0x26, 0x1c, 0x00, 0x00, 0x31,
		0x4a, 0x49, 0xfe, 0xff, 0x6e, 0x02, 0xbc,
	};
	static const uint8_t no_dst[] = {
		0x23, 0xc0, 0x13, 0x26, 0x1c, 0x31, 0x4a, 0x49, 0xfe, 0xff, 0x6e, 0x02, 0xbc,
	};
	struct zzb_mac_hdr expected = {
		.type = ZZB_MAC_FRAME_CMD,
		.flags = ZZB_FRAME_ACK_REQ,
		.seq = 19,
		.dst = {.mode = ZZB_MAC_ADDR_SHORT, .pan_id = 0x1c26, .short_addr = 0x0000},
		.src = {.mode = ZZB_MAC_ADDR_EXT, .pan_id = 0x1c26, .ext_addr = joiner_addr},
	};

	check_hdr_round_trip(pan_id_comp, sizeof(pan_id_comp), &expected);

	expected.dst = (struct zzb_mac_addr){.mode = ZZB_MAC_ADDR_NONE};
	check_hdr_round_trip(no_dst, sizeof(no_dst), &expected);
}

ZTEST(zzb_mac_frame, test_truncated_header_is_rejected)
{
	struct zzb_mac_hdr hdr;

	zassert_equal(zzb_mac_hdr_parse(assoc_req_hdr, sizeof(assoc_req_hdr) - 1, &hdr), -EINVAL);
	zassert_equal(zzb_mac_hdr_parse(assoc_req_hdr, 2, &hdr), -EINVAL);
}

ZTEST(zzb_mac_frame, test_reserved_values_are_rejected)
{
	/* Frame type 4, then destination addressing mode 1 */
	static const uint8_t type[] = {0x04, 0x00, 0x00};
	static const uint8_t mode[] = {0x01, 0x04, 0x00, 0xff, 0xff, 0xff, 0xff};
	struct zzb_mac_hdr hdr;

	zassert_equal(zzb_mac_hdr_parse(type, sizeof(type), &hdr), -EINVAL);
	zassert_equal(zzb_mac_hdr_parse(mode, sizeof(mode), &hdr), -EINVAL);
}

/* The data header with frame version 1, frame version 2, then with Security Enabled set */
ZTEST(zzb_mac_frame, test_frame_version_and_security)
{
	uint8_t bytes[sizeof(data_hdr)];
	struct zzb_mac_hdr hdr;

	memcpy(bytes, data_hdr, sizeof(bytes));
	bytes[1] = 0x98;
	zassert_equal(zzb_mac_hdr_parse(bytes, sizeof(bytes), &hdr), sizeof(bytes));

	bytes[1] = 0xa8;
	zassert_equal(zzb_mac_hdr_parse(bytes, sizeof(bytes), &hdr), -ENOTSUP);

	bytes[0] = 0x69;
	bytes[1] = 0x88;
	zassert_equal(zzb_mac_hdr_parse(bytes, sizeof(bytes), &hdr), -ENOTSUP);
}

/*
 * Beacon of a coordinator that permits association: MAC header, Superframe Specification, empty
 * GTS and pending address fields, and the beacon payload of test_zigbee_beacon_round_trip in
 * Ziggurat (see NOTICE).
 */
static const uint8_t beacon[] = {
	0x00, 0x80, 0x42, 0x26, 0x1c, 0x00, 0x00, 0xff, 0xcf, 0x00, 0x00, 0x00, 0x22,
	0x84, 0x93, 0xcb, 0x3c, 0x0b, 0x01, 0x44, 0x9f, 0x3a, 0xff, 0xff, 0xff, 0x00,
};

ZTEST(zzb_mac_frame, test_coordinator_beacon)
{
	const struct zzb_mac_hdr expected = {
		.type = ZZB_MAC_FRAME_BEACON,
		.seq = 0x42,
		.src = {.mode = ZZB_MAC_ADDR_SHORT, .pan_id = 0x1c26, .short_addr = 0x0000},
	};
	uint16_t superframe;
	uint8_t buf[4];

	check_hdr_round_trip(beacon, 7, &expected);

	zassert_equal(zzb_mac_beacon_parse(beacon + 7, sizeof(beacon) - 7, &superframe), 4);
	zassert_equal(superframe, 0x0fff | ZZB_MAC_SF_PAN_COORD | ZZB_MAC_SF_ASSOC_PERMIT);

	zassert_equal(zzb_mac_beacon_write(superframe, buf), 4);
	zassert_mem_equal(buf, beacon + 7, 4);
}

/* MAC payload with one GTS descriptor, one short and one extended pending address */
static const uint8_t gts_beacon[] = {
	0xff, 0xcf, 0x81, 0x01, 0x34, 0x12, 0x1e, 0x11, 0x78, 0x56,
	0x31, 0x4a, 0x49, 0xfe, 0xff, 0x6e, 0x02, 0xbc, 0x00, 0x22,
};

ZTEST(zzb_mac_frame, test_beacon_gts_and_pending_fields_are_skipped)
{
	uint16_t superframe;

	zassert_equal(zzb_mac_beacon_parse(gts_beacon, sizeof(gts_beacon), &superframe), 18);
	zassert_equal(superframe, 0xcfff);
	zassert_equal(zzb_mac_beacon_parse(gts_beacon, 18, &superframe), 18);
}

ZTEST(zzb_mac_frame, test_truncated_beacon_is_rejected)
{
	uint16_t superframe;

	zassert_equal(zzb_mac_beacon_parse(beacon + 7, 3, &superframe), -EINVAL);
	zassert_equal(zzb_mac_beacon_parse(gts_beacon, 6, &superframe), -EINVAL);
	zassert_equal(zzb_mac_beacon_parse(gts_beacon, 17, &superframe), -EINVAL);
}

static struct zzb_mac_cmd cmd_round_trip(const uint8_t *bytes, size_t len)
{
	struct zzb_mac_cmd cmd;
	uint8_t buf[8];

	zassert_equal(zzb_mac_cmd_parse(bytes, len, &cmd), len);
	zassert_equal(zzb_mac_cmd_write(&cmd, buf), len);
	zassert_mem_equal(buf, bytes, len);

	return cmd;
}

/* Command of test_association_request in Ziggurat (see NOTICE) */
ZTEST(zzb_mac_frame, test_association_request_command)
{
	static const uint8_t bytes[] = {0x01, 0x8e};
	struct zzb_mac_cmd cmd = cmd_round_trip(bytes, sizeof(bytes));

	zassert_equal(cmd.id, ZZB_MAC_CMD_ASSOC_REQ);
	zassert_equal(cmd.capability, 0x8e);
}

static const uint64_t coord_addr = 0x00124b00012e5a7fULL;

/* R22 Table D-3 first option */
ZTEST(zzb_mac_frame, test_association_response)
{
	static const uint8_t frame[] = {
		0x63, 0xcc, 0x14, 0x26, 0x1c, 0x31, 0x4a, 0x49, 0xfe, 0xff, 0x6e, 0x02, 0xbc,
		0x7f, 0x5a, 0x2e, 0x01, 0x00, 0x4b, 0x12, 0x00, 0x02, 0x3a, 0x5f, 0x00,
	};
	const struct zzb_mac_hdr expected = {
		.type = ZZB_MAC_FRAME_CMD,
		.flags = ZZB_FRAME_ACK_REQ,
		.seq = 0x14,
		.dst = {.mode = ZZB_MAC_ADDR_EXT, .pan_id = 0x1c26, .ext_addr = joiner_addr},
		.src = {.mode = ZZB_MAC_ADDR_EXT, .pan_id = 0x1c26, .ext_addr = coord_addr},
	};
	struct zzb_mac_cmd cmd;

	check_hdr_round_trip(frame, 21, &expected);

	cmd = cmd_round_trip(frame + 21, sizeof(frame) - 21);
	zassert_equal(cmd.id, ZZB_MAC_CMD_ASSOC_RSP);
	zassert_equal(cmd.assoc_rsp.short_addr, 0x5f3a);
	zassert_equal(cmd.assoc_rsp.status, 0x00);
}

ZTEST(zzb_mac_frame, test_commands_without_payload)
{
	static const uint8_t data_req[] = {0x04};
	static const uint8_t orphan[] = {0x06};
	/* From test_beacon_request in Ziggurat (see NOTICE) */
	static const uint8_t beacon_req[] = {0x07};

	zassert_equal(cmd_round_trip(data_req, 1).id, ZZB_MAC_CMD_DATA_REQ);
	zassert_equal(cmd_round_trip(orphan, 1).id, ZZB_MAC_CMD_ORPHAN);
	zassert_equal(cmd_round_trip(beacon_req, 1).id, ZZB_MAC_CMD_BEACON_REQ);
}

/* 802.15.4 5.3.6: broadcast PAN ID and short address, PAN ID compression, 15-octet MHR */
ZTEST(zzb_mac_frame, test_orphan_notification_header)
{
	static const uint8_t bytes[] = {
		0x43, 0xc8, 0x15, 0xff, 0xff, 0xff, 0xff, 0x31,
		0x4a, 0x49, 0xfe, 0xff, 0x6e, 0x02, 0xbc,
	};
	const struct zzb_mac_hdr expected = {
		.type = ZZB_MAC_FRAME_CMD,
		.seq = 0x15,
		.dst = {.mode = ZZB_MAC_ADDR_SHORT, .pan_id = 0xffff, .short_addr = 0xffff},
		.src = {.mode = ZZB_MAC_ADDR_EXT, .pan_id = 0xffff, .ext_addr = joiner_addr},
	};

	check_hdr_round_trip(bytes, sizeof(bytes), &expected);
}

/* Coordinator realignment sent to an orphaned device (802.15.4 5.3.8) */
static const uint8_t realign[] = {
	0x23, 0xcc, 0x16, 0xff, 0xff, 0x31, 0x4a, 0x49, 0xfe, 0xff, 0x6e,
	0x02, 0xbc, 0x26, 0x1c, 0x7f, 0x5a, 0x2e, 0x01, 0x00, 0x4b, 0x12,
	0x00, 0x08, 0x26, 0x1c, 0x00, 0x00, 0x0f, 0x3a, 0x5f,
};

static void check_realign_cmd(const struct zzb_mac_cmd *cmd)
{
	zassert_equal(cmd->id, ZZB_MAC_CMD_COORD_REALIGN);
	zassert_equal(cmd->realign.pan_id, 0x1c26);
	zassert_equal(cmd->realign.coord_short_addr, 0x0000);
	zassert_equal(cmd->realign.channel, 15);
	zassert_equal(cmd->realign.short_addr, 0x5f3a);
}

ZTEST(zzb_mac_frame, test_coordinator_realignment)
{
	const struct zzb_mac_hdr expected = {
		.type = ZZB_MAC_FRAME_CMD,
		.flags = ZZB_FRAME_ACK_REQ,
		.seq = 0x16,
		.dst = {.mode = ZZB_MAC_ADDR_EXT, .pan_id = 0xffff, .ext_addr = joiner_addr},
		.src = {.mode = ZZB_MAC_ADDR_EXT, .pan_id = 0x1c26, .ext_addr = coord_addr},
	};
	struct zzb_mac_cmd cmd;

	check_hdr_round_trip(realign, ZZB_MAC_HDR_MAX_LEN, &expected);

	cmd = cmd_round_trip(realign + ZZB_MAC_HDR_MAX_LEN, sizeof(realign) - ZZB_MAC_HDR_MAX_LEN);
	check_realign_cmd(&cmd);
}

ZTEST(zzb_mac_frame, test_coordinator_realignment_channel_page_is_ignored)
{
	uint8_t bytes[9];
	struct zzb_mac_cmd cmd;

	memcpy(bytes, realign + ZZB_MAC_HDR_MAX_LEN, 8);
	bytes[8] = 0x00;

	zassert_equal(zzb_mac_cmd_parse(bytes, sizeof(bytes), &cmd), 8);
	check_realign_cmd(&cmd);
}

ZTEST(zzb_mac_frame, test_unsupported_commands_are_rejected)
{
	static const uint8_t disassoc[] = {0x03, 0x02};
	static const uint8_t pan_id_conflict[] = {0x05};
	static const uint8_t gts_req[] = {0x09, 0x00};
	struct zzb_mac_cmd cmd;

	zassert_equal(zzb_mac_cmd_parse(disassoc, sizeof(disassoc), &cmd), -ENOTSUP);
	zassert_equal(zzb_mac_cmd_parse(pan_id_conflict, sizeof(pan_id_conflict), &cmd), -ENOTSUP);
	zassert_equal(zzb_mac_cmd_parse(gts_req, sizeof(gts_req), &cmd), -ENOTSUP);
}

ZTEST(zzb_mac_frame, test_truncated_command_is_rejected)
{
	static const uint8_t assoc_rsp[] = {0x02, 0x3a, 0x5f};
	struct zzb_mac_cmd cmd;

	zassert_equal(zzb_mac_cmd_parse(assoc_rsp, sizeof(assoc_rsp), &cmd), -EINVAL);
	zassert_equal(zzb_mac_cmd_parse(realign + ZZB_MAC_HDR_MAX_LEN, 7, &cmd), -EINVAL);
	zassert_equal(zzb_mac_cmd_parse(assoc_rsp, 0, &cmd), -EINVAL);
}

ZTEST_SUITE(zzb_mac_frame, NULL, NULL, NULL, NULL, NULL);
```

## src/mac.c
```c
/* SPDX-License-Identifier: Apache-2.0 */

#include <errno.h>
#include <zephyr/ztest.h>
#include <zzb/zzb.h>

#include "common/node.h"
#include "fakes.h"
#include "mac/mac.h"

ZTEST(zzb_mac, test_init_binds_radio_and_programs_filters)
{
	zassert_equal_ptr(node->port.dev, radio_dev);
	zassert_equal(radio.ext_addr, NODE_EUI64);
	zassert_equal(radio.pan_id, 0xffff);
	zassert_equal(radio.short_addr, 0xffff);
	zassert_equal(radio.channel, 11);
	zassert_true(radio.started);
}

ZTEST(zzb_mac, test_sleepy_init_turns_the_receiver_off)
{
	mac_init_sleepy();

	zassert_false(radio.rx_on_when_idle);
	zassert_false(radio.started);
}

ZTEST(zzb_mac, test_sleepy_init_needs_rx_on_when_idle)
{
	node->sleepy = true;

	zassert_equal(zzb_mac_init(node, radio_dev), -ENOTSUP);
}

ZTEST(zzb_mac, test_init_without_radio_is_invalid)
{
	const struct zzb_node_config cfg = {
		.eui64 = NODE_EUI64,
	};
	struct zzb_node *other;

	zassert_equal(zzb_node_init(&cfg, &other), -EINVAL);
	zassert_is_null(other);
}

ZTEST(zzb_mac, test_data_frame_is_indicated)
{
	/* From the parent to 0x5678 with ACK request, one payload byte */
	static const uint8_t frame[] = {0x61, 0x88, 0x10, 0x62, 0x1a, 0x78, 0x56, 0x00, 0x00, 0x42};

	inject(frame, sizeof(frame));
	run_stack();

	zassert_equal(zzb_mcps_data_ind_fake.call_count, 1);
	zassert_equal_ptr(zzb_mcps_data_ind_fake.arg0_val, node);
	zassert_equal(data_ind.len, 1);
	zassert_equal(data_ind.data[0], 0x42);
	zassert_equal(data_ind.meta.src.mode, ZZB_MAC_ADDR_SHORT);
	zassert_equal(data_ind.meta.src.pan_id, PAN_ID);
	zassert_equal(data_ind.meta.src.short_addr, PARENT_SHORT);
	zassert_equal(data_ind.meta.dst.mode, ZZB_MAC_ADDR_SHORT);
	zassert_equal(data_ind.meta.dst.pan_id, PAN_ID);
	zassert_equal(data_ind.meta.dst.short_addr, 0x5678);
	zassert_equal(data_ind.meta.flags, ZZB_FRAME_ACK_REQ);
}

ZTEST(zzb_mac, test_unexpected_frames_are_dropped)
{
	static const uint8_t truncated[] = {0x61, 0x88};
	/* Beacon of the parent and association response, outside a scan and an association */
	static const uint8_t beacon[] = {0x00, 0x80, 0x10, 0x62, 0x1a, 0x00,
					 0x00, 0xff, 0xcf, 0x00, 0x00, 0x00};
	static const uint8_t assoc_rsp[] = {0x63, 0xcc, 0x10, 0x62, 0x1a, 0x77, 0x66, 0x55, 0x44,
					    0x33, 0x22, 0x11, 0x00, 0x08, 0x07, 0x06, 0x05, 0x04,
					    0x03, 0x02, 0x01, 0x02, 0x78, 0x56, 0x00};
	static const uint8_t empty_data[] = {0x41, 0x88, 0x10, 0x62, 0x1a, 0x78, 0x56, 0x00, 0x00};

	inject(truncated, sizeof(truncated));
	inject(beacon, sizeof(beacon));
	inject(assoc_rsp, sizeof(assoc_rsp));
	inject(empty_data, sizeof(empty_data));
	run_stack();

	zassert_equal(zzb_mcps_data_ind_fake.call_count, 0);
}

ZTEST(zzb_mac, test_set_pan_id_and_short_address)
{
	static const uint8_t msdu[] = {0x42};
	/* Data frame from 0x5678 to the parent with ACK request */
	static const uint8_t frame[] = {0x61, 0x88, 0x00, 0x62, 0x1a, 0x00, 0x00, 0x78, 0x56, 0x42};

	zzb_mlme_set_pan_id(node, PAN_ID);
	zzb_mlme_set_short_addr(node, 0x5678);
	zassert_equal(radio.pan_id, PAN_ID);
	zassert_equal(radio.short_addr, 0x5678);

	zassert_ok(zzb_mcps_data_req(node, msdu_buf(1, msdu, sizeof(msdu))));
	run_stack();
	check_sent(0, frame, sizeof(frame));
}

ZTEST(zzb_mac, test_set_channel)
{
	radio.started = false;

	zassert_ok(zzb_mlme_set_channel(node, 20));
	zassert_equal(node->mac.channel, 20);
	zassert_equal(radio.channel, 20);
	zassert_true(radio.started);
}

/* esp32 applies the channel only when it starts */
ZTEST(zzb_mac, test_set_channel_leaves_a_sleepy_radio_stopped)
{
	int starts;

	mac_init_sleepy();
	starts = radio_start_fake.call_count;

	zassert_ok(zzb_mlme_set_channel(node, 20));
	zassert_equal(radio.channel, 20);
	zassert_equal(radio_start_fake.call_count, starts + 1);
	zassert_false(radio.started);
}

/* The end of the scan would restore the channel set during it */
ZTEST(zzb_mac, test_set_channel_during_a_scan_is_busy)
{
	zassert_ok(zzb_mlme_scan_req(node, BIT(15), 0));
	zassert_equal(zzb_mlme_set_channel(node, 20), -EBUSY);
	k_sleep(K_MSEC(40));

	zassert_equal(radio.channel, 11);
}

/* A queued frame would go out on the scanned channel or the channel of the coordinator */
ZTEST(zzb_mac, test_scan_and_association_wait_for_queued_frames)
{
	static const uint8_t msdu[] = {0x42};
	const struct zzb_mac_addr coord = {
		.mode = ZZB_MAC_ADDR_SHORT,
		.pan_id = PAN_ID,
		.short_addr = PARENT_SHORT,
	};

	zassert_ok(zzb_mcps_data_req(node, msdu_buf(1, msdu, sizeof(msdu))));
	zassert_equal(zzb_mlme_scan_req(node, BIT(15), 0), -EBUSY);
	zassert_equal(zzb_mlme_assoc_req(node, 15, &coord, 0x80), -EBUSY);

	run_stack();
	zassert_equal(zzb_mcps_data_conf_fake.call_count, 1);
	zassert_ok(zzb_mlme_scan_req(node, BIT(15), 0));
	k_sleep(K_MSEC(40));
}

ZTEST_SUITE(zzb_mac, NULL, mac_setup, mac_before, mac_after, NULL);
```

## src/pm.c
```c
/* SPDX-License-Identifier: Apache-2.0 */

#include <zephyr/irq.h>
#include <zephyr/pm/pm.h>

void pm_state_set(enum pm_state state, uint8_t substate_id)
{
}

void pm_state_exit_post_ops(enum pm_state state, uint8_t substate_id)
{
	irq_unlock(0);
}
```

## src/poll.c
```c
/* SPDX-License-Identifier: Apache-2.0 */

#include <zephyr/ztest.h>

#include "common/node.h"
#include "fakes.h"
#include "mac/frame.h"
#include "mac/mac.h"

static const struct zzb_mac_addr coord = {
	.mode = ZZB_MAC_ADDR_SHORT,
	.pan_id = PAN_ID,
	.short_addr = PARENT_SHORT,
};

static void set_reply(const uint8_t *frame, size_t len)
{
	parent.pending = true;
	parent.reply = frame;
	parent.reply_len = len;
	parent.reply_to = ZZB_MAC_CMD_DATA_REQ;
}

static int call_index(void *fake)
{
	for (int i = 0; i < fff.call_history_idx; i++) {
		if (fff.call_history[i] == fake) {
			return i;
		}
	}

	return -1;
}

ZTEST(zzb_mac_poll, test_ack_without_frame_pending_is_no_data)
{
	/* Short source address of an associated device (802.15.4 5.3.4) */
	static const uint8_t data_req[] = {0x63, 0x88, 0x00, 0x62, 0x1a,
					   0x00, 0x00, 0x78, 0x56, 0x04};

	zassert_ok(zzb_mlme_poll_req(node, &coord));
	run_stack();

	check_sent(0, data_req, sizeof(data_req));
	zassert_equal(zzb_mlme_poll_conf_fake.call_count, 1);
	zassert_equal(zzb_mlme_poll_conf_fake.arg1_val, ZZB_MAC_STATUS_NO_DATA);
}

ZTEST(zzb_mac_poll, test_pending_frame_is_confirmed_then_indicated)
{
	/* Data frame from the parent with frame pending set: more data is waiting */
	static const uint8_t frame[] = {0x71, 0x88, 0x10, 0x62, 0x1a, 0x78, 0x56, 0x00, 0x00, 0x42};

	set_reply(frame, sizeof(frame));

	zassert_ok(zzb_mlme_poll_req(node, &coord));
	run_stack();

	zassert_equal(zzb_mlme_poll_conf_fake.call_count, 1);
	zassert_equal(zzb_mlme_poll_conf_fake.arg1_val, ZZB_MAC_STATUS_SUCCESS);
	zassert_equal(zzb_mcps_data_ind_fake.call_count, 1);
	zassert_true(call_index(zzb_mlme_poll_conf) < call_index(zzb_mcps_data_ind));
	zassert_equal(data_ind.len, 1);
	zassert_equal(data_ind.data[0], 0x42);
	zassert_true(data_ind.meta.flags & ZZB_FRAME_PENDING);
}

ZTEST(zzb_mac_poll, test_empty_frame_is_no_data)
{
	static const uint8_t empty[] = {0x41, 0x88, 0x10, 0x62, 0x1a, 0x78, 0x56, 0x00, 0x00};

	set_reply(empty, sizeof(empty));

	zassert_ok(zzb_mlme_poll_req(node, &coord));
	run_stack();

	zassert_equal(zzb_mlme_poll_conf_fake.call_count, 1);
	zassert_equal(zzb_mlme_poll_conf_fake.arg1_val, ZZB_MAC_STATUS_NO_DATA);
	zassert_equal(zzb_mcps_data_ind_fake.call_count, 0);
}

ZTEST(zzb_mac_poll, test_wait_ends_without_frame_from_coordinator)
{
	/* From 0x1234, not from the polled coordinator */
	static const uint8_t other[] = {0x41, 0x88, 0x10, 0x62, 0x1a, 0x78, 0x56, 0x34, 0x12, 0x42};

	parent.pending = true;

	zassert_ok(zzb_mlme_poll_req(node, &coord));
	run_stack();
	inject(other, sizeof(other));
	run_stack();

	/* macMaxFrameTotalWaitTime, 157.54 ms */
	k_sleep(K_MSEC(140));
	zassert_equal(zzb_mlme_poll_conf_fake.call_count, 0);
	k_sleep(K_MSEC(40));
	zassert_equal(zzb_mlme_poll_conf_fake.call_count, 1);
	zassert_equal(zzb_mlme_poll_conf_fake.arg1_val, ZZB_MAC_STATUS_NO_DATA);
	zassert_equal(zzb_mcps_data_ind_fake.call_count, 1);
}

/* The receiver of a sleepy node is on from the data request to the end of the poll */
ZTEST(zzb_mac_poll, test_sleepy_node_receives_during_the_poll)
{
	static const uint8_t frame[] = {0x61, 0x88, 0x10, 0x62, 0x1a, 0x78, 0x56, 0x00, 0x00, 0x42};
	static const struct {
		bool pending;
		const uint8_t *reply;
		enum zzb_mac_status status;
	} cases[] = {
		{.status = ZZB_MAC_STATUS_NO_DATA},
		{.pending = true, .reply = frame, .status = ZZB_MAC_STATUS_SUCCESS},
		{.pending = true, .status = ZZB_MAC_STATUS_NO_DATA},
	};

	ARRAY_FOR_EACH_PTR(cases, c) {
		mac_before(NULL);
		mac_init_sleepy();
		set_reply(c->reply, sizeof(frame));
		parent.pending = c->pending;

		zassert_ok(zzb_mlme_poll_req(node, &coord));
		/* macMaxFrameTotalWaitTime, 157.54 ms */
		k_sleep(K_MSEC(200));

		zassert_true(sent[0].radio.rx_on_when_idle, "case %d", c - cases);
		zassert_equal(zzb_mlme_poll_conf_fake.arg1_val, c->status, "case %d", c - cases);
		zassert_equal(zzb_mcps_data_ind_fake.call_count, c->reply != NULL, "case %d",
			      c - cases);
		zassert_false(radio.rx_on_when_idle, "case %d", c - cases);
		zassert_false(radio.started, "case %d", c - cases);
		mac_after(NULL);
	}
}

/* After the ACK with frame pending only the poll keeps the PM lock, until the wait ends */
ZTEST(zzb_mac_poll, test_sleepy_node_holds_the_pm_lock_while_it_waits)
{
	if (!IS_ENABLED(CONFIG_PM)) {
		ztest_test_skip();
	}

	mac_init_sleepy();
	parent.pending = true;

	zassert_ok(zzb_mlme_poll_req(node, &coord));
	k_sleep(K_MSEC(100));
	zassert_true(pm_locked());

	/* macMaxFrameTotalWaitTime, 157.54 ms */
	k_sleep(K_MSEC(100));
	zassert_equal(zzb_mlme_poll_conf_fake.arg1_val, ZZB_MAC_STATUS_NO_DATA);
}

static void before(void *fixture)
{
	mac_before(fixture);
	node->mac.pan_id = PAN_ID;
	node->mac.short_addr = 0x5678;
}

ZTEST_SUITE(zzb_mac_poll, NULL, mac_setup, before, mac_after, NULL);
```

## src/scan.c
```c
/* SPDX-License-Identifier: Apache-2.0 */

#include <errno.h>
#include <zephyr/ztest.h>

#include "common/node.h"
#include "fakes.h"
#include "mac/frame.h"
#include "mac/mac.h"

/* Broadcast to PAN 0xffff, no source address (802.15.4 5.3.7) */
static const uint8_t beacon_req[] = {0x03, 0x08, 0x00, 0xff, 0xff, 0xff, 0xff, 0x07};

/* Beacon of the parent with association permit, and the start of a Zigbee beacon payload */
static const uint8_t parent_beacon[] = {0x00, 0x80, 0x20, 0x62, 0x1a, 0x00, 0x00,
					0xff, 0xcf, 0x00, 0x00, 0x00, 0x22, 0x84};

ZTEST(zzb_mac_scan, test_scan_sends_beacon_request_per_channel)
{
	static const uint8_t channels[] = {11, 15, 20};

	node->mac.pan_id = PAN_ID;
	node->mac.channel = 25;

	zassert_ok(zzb_mlme_scan_req(node, BIT(11) | BIT(15) | BIT(20), 3));

	/* Three times aBaseSuperframeDuration * (2^3 + 1), 138.24 ms */
	k_sleep(K_MSEC(400));
	zassert_equal(zzb_mlme_scan_conf_fake.call_count, 0);
	k_sleep(K_MSEC(80));
	zassert_equal(zzb_mlme_scan_conf_fake.call_count, 1);
	zassert_equal(zzb_mlme_scan_conf_fake.arg1_val, ZZB_MAC_STATUS_NO_BEACON);

	zassert_equal(sent_count, ARRAY_SIZE(channels));
	ARRAY_FOR_EACH(channels, i) {
		check_sent(i, beacon_req, sizeof(beacon_req));
		zassert_equal(sent[i].radio.channel, channels[i]);
		zassert_equal(sent[i].radio.pan_id, 0xffff);
	}

	zassert_equal(radio.pan_id, PAN_ID);
	zassert_equal(radio.channel, 25);
}

ZTEST(zzb_mac_scan, test_beacon_is_notified_and_other_frames_dropped)
{
	static const uint8_t data[] = {0x41, 0x88, 0x10, 0xff, 0xff, 0xff, 0xff, 0x00, 0x00, 0x42};

	parent.reply = parent_beacon;
	parent.reply_len = sizeof(parent_beacon);
	parent.reply_to = ZZB_MAC_CMD_BEACON_REQ;
	parent.reply_channel = 15;

	zassert_ok(zzb_mlme_scan_req(node, BIT(11) | BIT(15), 0));
	k_sleep(K_MSEC(10));
	inject(data, sizeof(data));
	k_sleep(K_MSEC(100));

	zassert_equal(zzb_mcps_data_ind_fake.call_count, 0);
	zassert_equal(zzb_mlme_beacon_notify_ind_fake.call_count, 1);
	zassert_equal(zzb_mlme_beacon_notify_ind_fake.arg2_val, 15);
	zassert_equal(zzb_mlme_beacon_notify_ind_fake.arg3_val, 0xcfff);
	zassert_equal(beacon.len, 3);
	zassert_mem_equal(beacon.data, parent_beacon + 11, 3);
	zassert_equal(beacon.meta.src.mode, ZZB_MAC_ADDR_SHORT);
	zassert_equal(beacon.meta.src.pan_id, PAN_ID);
	zassert_equal(beacon.meta.src.short_addr, PARENT_SHORT);
	zassert_equal(zzb_mlme_scan_conf_fake.call_count, 1);
	zassert_equal(zzb_mlme_scan_conf_fake.arg1_val, ZZB_MAC_STATUS_SUCCESS);
}

ZTEST(zzb_mac_scan, test_channel_access_failure_skips_channel)
{
	parent.busy_channel = 11;

	zassert_ok(zzb_mlme_scan_req(node, BIT(11) | BIT(15), 3));

	/* Only channel 15 is listened on, for 138.24 ms */
	k_sleep(K_MSEC(120));
	zassert_equal(zzb_mlme_scan_conf_fake.call_count, 0);
	k_sleep(K_MSEC(50));
	zassert_equal(zzb_mlme_scan_conf_fake.call_count, 1);
	zassert_equal(zzb_mlme_scan_conf_fake.arg1_val, ZZB_MAC_STATUS_NO_BEACON);
	zassert_equal(sent_count, 2);
}

/* The scan starts the radio on every channel */
ZTEST(zzb_mac_scan, test_sleepy_node_receives_during_the_scan)
{
	mac_init_sleepy();

	zassert_ok(zzb_mlme_scan_req(node, BIT(11) | BIT(15), 0));
	k_sleep(K_MSEC(100));

	zassert_equal(zzb_mlme_scan_conf_fake.call_count, 1);
	zassert_equal(sent_count, 2);
	for (int i = 0; i < sent_count; i++) {
		zassert_true(sent[i].radio.started);
		zassert_true(sent[i].radio.rx_on_when_idle);
	}

	zassert_equal(radio.channel, 11);
	zassert_false(radio.rx_on_when_idle);
	zassert_false(radio.started);
}

ZTEST(zzb_mac_scan, test_invalid_or_second_scan_is_rejected)
{
	zassert_equal(zzb_mlme_scan_req(node, BIT(11), 15), -EINVAL);
	zassert_equal(zzb_mlme_scan_req(node, BIT(10), 0), -EINVAL);
	zassert_equal(zzb_mlme_scan_req(node, 0, 0), -EINVAL);

	zassert_ok(zzb_mlme_scan_req(node, BIT(11), 0));
	zassert_equal(zzb_mlme_scan_req(node, BIT(11), 0), -EBUSY);
	k_sleep(K_MSEC(100));

	zassert_equal(zzb_mlme_scan_conf_fake.call_count, 1);
}

ZTEST_SUITE(zzb_mac_scan, NULL, mac_setup, mac_before, mac_after, NULL);
```

## src/tx.c
```c
/* SPDX-License-Identifier: Apache-2.0 */

#include <errno.h>
#include <zephyr/ztest.h>

#include "common/node.h"
#include "fakes.h"
#include "mac/mac.h"

static const uint8_t msdu[] = {0x42};

static void send(uint8_t handle)
{
	zassert_ok(zzb_mcps_data_req(node, msdu_buf(handle, msdu, sizeof(msdu))));
}

ZTEST(zzb_mac_tx, test_data_frame_gets_mac_header)
{
	/* Not associated: extended source address and PAN ID 0xffff (802.15.4 5.1.6.1) */
	static const uint8_t unassociated[] = {0x21, 0xc8, 0x00, 0x62, 0x1a, 0x00,
					       0x00, 0xff, 0xff, 0x77, 0x66, 0x55,
					       0x44, 0x33, 0x22, 0x11, 0x00, 0x42};
	static const uint8_t associated[] = {0x61, 0x88, 0x00, 0x62, 0x1a,
					     0x00, 0x00, 0x78, 0x56, 0x42};

	send(7);
	run_stack();
	node->mac.pan_id = PAN_ID;
	node->mac.short_addr = 0x5678;
	send(8);
	run_stack();

	check_sent(0, unassociated, sizeof(unassociated));
	check_sent(1, associated, sizeof(associated));
	zassert_equal((uint8_t)(sent[0].data[2] + 1), sent[1].data[2]);
	zassert_equal(zzb_mcps_data_conf_fake.call_count, 2);
	zassert_equal_ptr(zzb_mcps_data_conf_fake.arg0_history[0], node);
	zassert_equal(zzb_mcps_data_conf_fake.arg1_history[0], 7);
	zassert_equal(zzb_mcps_data_conf_fake.arg2_history[0], ZZB_MAC_STATUS_SUCCESS);
	zassert_equal(zzb_mcps_data_conf_fake.arg1_history[1], 8);
}

ZTEST(zzb_mac_tx, test_no_ack_is_retried_with_same_sequence_number)
{
	parent.lost = 4;

	send(1);
	run_stack();

	/* macMaxFrameRetries is 3 */
	zassert_equal(sent_count, 4);
	for (int i = 1; i < sent_count; i++) {
		zassert_mem_equal(sent[i].data, sent[0].data, sent[0].len);
	}
	zassert_equal(zzb_mcps_data_conf_fake.call_count, 1);
	zassert_equal(zzb_mcps_data_conf_fake.arg2_val, ZZB_MAC_STATUS_NO_ACK);
}

ZTEST(zzb_mac_tx, test_retries_stop_at_ack)
{
	parent.lost = 1;

	send(1);
	run_stack();

	zassert_equal(sent_count, 2);
	zassert_equal(zzb_mcps_data_conf_fake.call_count, 1);
	zassert_equal(zzb_mcps_data_conf_fake.arg2_val, ZZB_MAC_STATUS_SUCCESS);
}

ZTEST(zzb_mac_tx, test_channel_access_failure_is_not_retried)
{
	parent.busy_channel = radio.channel;

	send(1);
	run_stack();

	zassert_equal(sent_count, 1);
	zassert_equal(zzb_mcps_data_conf_fake.call_count, 1);
	zassert_equal(zzb_mcps_data_conf_fake.arg2_val, ZZB_MAC_STATUS_CHANNEL_ACCESS_FAILURE);
}

ZTEST(zzb_mac_tx, test_frames_are_sent_in_order)
{
	send(1);
	send(2);
	send(3);
	run_stack();

	zassert_equal(sent_count, 3);
	for (int i = 1; i < sent_count; i++) {
		zassert_equal((uint8_t)(sent[i - 1].data[2] + 1), sent[i].data[2]);
	}
	zassert_equal(zzb_mcps_data_conf_fake.call_count, 3);
	for (int i = 0; i < 3; i++) {
		zassert_equal(zzb_mcps_data_conf_fake.arg1_history[i], i + 1);
	}
}

/* The driver transmits from sleep */
ZTEST(zzb_mac_tx, test_sleepy_node_sends_with_the_receiver_off)
{
	mac_init_sleepy();

	send(1);
	run_stack();

	zassert_equal(sent_count, 1);
	zassert_false(sent[0].radio.started);
	zassert_false(sent[0].radio.rx_on_when_idle);
	zassert_equal(sent[0].pm_locked, IS_ENABLED(CONFIG_PM));
	zassert_false(radio.started);
	zassert_equal(zzb_mcps_data_conf_fake.arg2_val, ZZB_MAC_STATUS_SUCCESS);
}

ZTEST(zzb_mac_tx, test_oversized_frame_is_rejected)
{
	static const uint8_t long_msdu[103];
	struct net_buf *no_headroom = msdu_buf(1, msdu, sizeof(msdu));
	struct net_buf *too_long = msdu_buf(2, long_msdu, sizeof(long_msdu));

	net_buf_push(no_headroom, net_buf_headroom(no_headroom));
	/* 23-byte header: extended destination in another PAN, extended source */
	zzb_frame_meta(too_long)->dst = (struct zzb_mac_addr){
		.mode = ZZB_MAC_ADDR_EXT,
		.pan_id = PAN_ID,
		.ext_addr = 0x0102030405060708ULL,
	};

	zassert_equal(zzb_mcps_data_req(node, no_headroom), -EMSGSIZE);
	zassert_equal(zzb_mcps_data_req(node, too_long), -EMSGSIZE);
	run_stack();

	zassert_equal(sent_count, 0);
	net_buf_unref(no_headroom);
	net_buf_unref(too_long);
}

ZTEST_SUITE(zzb_mac_tx, NULL, mac_setup, mac_before, mac_after, NULL);
```
