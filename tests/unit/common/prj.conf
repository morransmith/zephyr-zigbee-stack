## CMakeLists.txt
```
# SPDX-License-Identifier: Apache-2.0

cmake_minimum_required(VERSION 3.20.0)

find_package(Zephyr REQUIRED HINTS $ENV{ZEPHYR_BASE})
project(zzb_unit_common)

target_include_directories(app PRIVATE ${ZEPHYR_ZZB_MODULE_DIR}/subsys/zzb)
target_sources(app PRIVATE
  src/buf.c
  src/eui64.c
  src/node.c
  src/queue.c
  src/timer.c
)
```

## prj.conf
```kconfig
# SPDX-License-Identifier: Apache-2.0

CONFIG_ZTEST=y
CONFIG_ZZB=y
CONFIG_ZZB_NODE_COUNT=1
# The test fakes z_impl_hwinfo_get_device_id()
CONFIG_HWINFO_NATIVE=n
```

## src/buf.c
```c
/* SPDX-License-Identifier: Apache-2.0 */

#include <string.h>
#include <zephyr/ztest.h>

#include "common/buf.h"

ZTEST(zzb_buf, test_alloc_resets_reused_buffer)
{
	static const struct zzb_frame_meta zero;
	struct net_buf *buf = zzb_buf_alloc(K_NO_WAIT);

	zassert_not_null(buf);
	memset(zzb_frame_meta(buf), 0xff, sizeof(struct zzb_frame_meta));
	net_buf_add(buf, 10);
	net_buf_unref(buf);

	buf = zzb_buf_alloc(K_NO_WAIT);
	zassert_not_null(buf);
	zassert_mem_equal(zzb_frame_meta(buf), &zero, sizeof(zero));
	zassert_equal(net_buf_tailroom(buf), ZZB_BUF_SIZE);
	net_buf_unref(buf);
}

ZTEST_SUITE(zzb_buf, NULL, NULL, NULL, NULL, NULL);
```

## src/eui64.c
```c
/* SPDX-License-Identifier: Apache-2.0 */

#include <string.h>
#include <zephyr/drivers/hwinfo.h>
#include <zephyr/fff.h>
#include <zephyr/ztest.h>

#include "common/eui64.h"

DEFINE_FFF_GLOBALS;

FAKE_VALUE_FUNC(ssize_t, z_impl_hwinfo_get_device_id, uint8_t *, size_t);

static uint8_t id[8];
static size_t id_len;

static ssize_t device_id_fake(uint8_t *buffer, size_t length)
{
	size_t len = MIN(length, id_len);

	memcpy(buffer, id, len);
	return len;
}

static void set_id(const uint8_t *bytes, size_t len)
{
	memcpy(id, bytes, len);
	id_len = len;
	z_impl_hwinfo_get_device_id_fake.custom_fake = device_id_fake;
}

static void before(void *fixture)
{
	RESET_FAKE(z_impl_hwinfo_get_device_id);
}

ZTEST(zzb_eui64, test_8_byte_id_is_used_as_is)
{
	uint64_t eui64;

	set_id((const uint8_t[]){0x01, 0x02, 0x03, 0x04, 0x05, 0x06, 0x07, 0x08}, 8);

	zassert_ok(zzb_eui64_get(&eui64));
	zassert_equal(eui64, 0x0102030405060708ULL);
}

ZTEST(zzb_eui64, test_6_byte_id_gets_fffe_after_oui)
{
	uint64_t eui64;

	set_id((const uint8_t[]){0xaa, 0xbb, 0xcc, 0xdd, 0xee, 0xff}, 6);

	zassert_ok(zzb_eui64_get(&eui64));
	zassert_equal(eui64, 0xaabbccfffeddeeffULL);
}

ZTEST(zzb_eui64, test_short_id_is_zero_padded)
{
	uint64_t eui64;

	set_id((const uint8_t[]){0x11, 0x22, 0x33, 0x44}, 4);

	zassert_ok(zzb_eui64_get(&eui64));
	zassert_equal(eui64, 0x11223344ULL);
}

ZTEST(zzb_eui64, test_no_id_gives_enodev)
{
	uint64_t eui64;

	z_impl_hwinfo_get_device_id_fake.return_val = -ENOSYS;

	zassert_equal(zzb_eui64_get(&eui64), -ENODEV);
}

ZTEST_SUITE(zzb_eui64, NULL, NULL, before, NULL, NULL);
```

## src/node.c
```c
/* SPDX-License-Identifier: Apache-2.0 */

#include <errno.h>
#include <zephyr/ztest.h>
#include <zzb/zzb.h>

#include "common/node.h"

/* Relies on CONFIG_ZZB_NODE_COUNT=1 */
ZTEST(zzb_node, test_init_uses_cfg_eui64_until_pool_is_full)
{
	const struct zzb_node_config cfg = {
		.eui64 = 0x0011223344556677ULL,
	};
	struct zzb_node *node;
	struct zzb_node *extra;

	zassert_ok(zzb_node_init(&cfg, &node));
	zassert_equal(node->eui64, cfg.eui64);
	zassert_equal(zzb_node_init(&cfg, &extra), -ENOMEM);
	zassert_is_null(extra);
}

/* BDB 10.1.1: a code of 6, 8, 12 or 16 bytes and its CRC, checked before a node is taken */
ZTEST(zzb_node, test_install_code_is_checked)
{
	/* BDB 10.1.1 example with the last octet of the CRC changed */
	static const uint8_t bad_crc[] = {
		0x83, 0xfe, 0xd3, 0x40, 0x7a, 0x93, 0x97, 0x23, 0xa5,
		0xc6, 0x39, 0xb2, 0x69, 0x16, 0xd5, 0x05, 0xc3, 0xb4,
	};
	/* The CRC of the code 01 02 03 04 05 06 07, but a code of 7 bytes */
	static const uint8_t bad_len[] = {0x01, 0x02, 0x03, 0x04, 0x05, 0x06, 0x07, 0x01, 0x6d};
	struct zzb_node_config cfg = {
		.eui64 = 0x0011223344556677ULL,
		.install_code = bad_crc,
		.install_code_len = sizeof(bad_crc),
	};
	struct zzb_node *node;

	zassert_equal(zzb_node_init(&cfg, &node), -EINVAL);
	zassert_is_null(node);

	cfg.install_code = bad_len;
	cfg.install_code_len = sizeof(bad_len);
	zassert_equal(zzb_node_init(&cfg, &node), -EINVAL);
}

ZTEST_SUITE(zzb_node, NULL, NULL, NULL, NULL, NULL);
```

## src/queue.c
```c
/* SPDX-License-Identifier: Apache-2.0 */

#include <zephyr/kernel.h>
#include <zephyr/ztest.h>

#include "common/queue.h"

struct call {
	struct k_work work;
	k_tid_t thread;
	bool done;
};

static void record_handler(struct k_work *work)
{
	struct call *call = CONTAINER_OF(work, struct call, work);

	call->thread = k_current_get();
	call->done = true;
}

ZTEST(zzb_queue, test_call_sync_runs_on_stack_thread)
{
	struct call call = {0};

	zzb_call_sync(&call.work, record_handler);

	zassert_true(call.done);
	zassert_equal(call.thread, k_work_queue_thread_get(&zzb_workq));
}

struct nested {
	struct k_work work;
	struct call inner;
	bool inner_done_on_return;
};

static void nested_handler(struct k_work *work)
{
	struct nested *nested = CONTAINER_OF(work, struct nested, work);

	zzb_call_sync(&nested->inner.work, record_handler);
	nested->inner_done_on_return = nested->inner.done;
}

ZTEST(zzb_queue, test_call_sync_on_stack_thread_runs_inline)
{
	struct nested nested = {0};

	zzb_call_sync(&nested.work, nested_handler);

	zassert_true(nested.inner_done_on_return);
}

ZTEST_SUITE(zzb_queue, NULL, NULL, NULL, NULL, NULL);
```

## src/timer.c
```c
/* SPDX-License-Identifier: Apache-2.0 */

#include <zephyr/kernel.h>
#include <zephyr/ztest.h>

#include "common/timer.h"

static struct k_work_delayable dwork;
static int runs;
static bool rearm;

static void handler(struct k_work *work)
{
	runs++;
	if (rearm) {
		rearm = false;
		zzb_timer_arm(&dwork, K_MSEC(100));
	}
}

static void before(void *fixture)
{
	k_work_init_delayable(&dwork, handler);
	runs = 0;
	rearm = false;
}

ZTEST(zzb_timer, test_arm_keeps_earliest_deadline)
{
	zzb_timer_arm(&dwork, K_MSEC(100));
	zzb_timer_arm(&dwork, K_MSEC(50));
	zzb_timer_arm(&dwork, K_MSEC(200));

	k_sleep(K_MSEC(40));
	zassert_equal(runs, 0);
	k_sleep(K_MSEC(20));
	zassert_equal(runs, 1);
	k_sleep(K_MSEC(190));
	zassert_equal(runs, 1);
}

ZTEST(zzb_timer, test_handler_rearms_itself)
{
	rearm = true;
	zzb_timer_arm(&dwork, K_MSEC(50));

	k_sleep(K_MSEC(60));
	zassert_equal(runs, 1);
	k_sleep(K_MSEC(100));
	zassert_equal(runs, 2);
}

ZTEST_SUITE(zzb_timer, NULL, NULL, before, NULL, NULL);
```
