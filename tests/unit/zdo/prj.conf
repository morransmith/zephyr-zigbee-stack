## CMakeLists.txt
```
# SPDX-License-Identifier: Apache-2.0

cmake_minimum_required(VERSION 3.20.0)

find_package(Zephyr REQUIRED HINTS $ENV{ZEPHYR_BASE})
project(zzb_unit_zdo)

target_include_directories(app PRIVATE ${ZEPHYR_ZZB_MODULE_DIR}/subsys/zzb)
target_sources(app PRIVATE
  src/client.c
  src/desc.c
  src/fakes.c
  src/mgmt.c
  src/server.c
  src/zdo.c
)
```

## prj.conf
```kconfig
# SPDX-License-Identifier: Apache-2.0

CONFIG_ZTEST=y
CONFIG_ZZB=y
# APS and NWK are faked
CONFIG_ZZB_ZDO=y
# BDB is faked
CONFIG_ZZB_BDB=n
```

## src/client.c
```c
/* SPDX-License-Identifier: Apache-2.0 */

#include <errno.h>
#include <zephyr/ztest.h>

#include "common/node.h"
#include "fakes.h"

#define IEEE_ADDR_REQ   0x0001
#define NODE_DESC_REQ   0x0002
#define SIMPLE_DESC_REQ 0x0004
#define DEVICE_ANNCE    0x0013
#define PERMIT_JOIN     0x0036
#define TC_ADDR         0x0000

static struct zzb_node *node;

static void *setup(void)
{
	node = test_node();
	return NULL;
}

static void before(void *fixture)
{
	reset_fakes();
}

static void after(void *fixture)
{
	check_no_buffer_leak();
}

/*
 * Node_Desc_rsp of a trust center: primary trust center and network manager, stack compliance
 * revision 21
 */
static void receive_node_desc_rsp(uint8_t tsn, uint16_t src_addr, uint8_t status, size_t len)
{
	/* TSN, status, NWKAddrOfInterest, node descriptor */
	uint8_t rsp[] = {0x00, 0x00, 0x00, 0x00, 0x00, 0x40, 0x8f, 0x00, 0x00,
			 0x50, 0xa0, 0x00, 0x41, 0x2a, 0x80, 0x00, 0x00};
	const struct zzb_apsde_ind ind = {
		.dst_addr = NODE_ADDR,
		.src_addr = src_addr,
		.cluster = NODE_DESC_REQ | 0x8000,
	};

	rsp[0] = tsn;
	rsp[1] = status;
	receive_ind(&ind, rsp, len);
}

/* BDB 10.2.5 step 3 */
ZTEST(zzb_zdo_client, test_node_desc_req)
{
	uint8_t tsn = node->zdo.tsn;

	zassert_ok(zzb_zdo_node_desc_req(node, TC_ADDR));
	zassert_equal(zzb_apsde_data_req_fake.call_count, 1);
	zassert_equal(sent[0].req.dst_addr, TC_ADDR);
	zassert_equal(sent[0].req.cluster, NODE_DESC_REQ);
	zassert_equal(sent[0].req.tx_options, ZZB_APS_TX_ACK);
	zassert_equal(sent[0].len, 3);
	zassert_mem_equal(sent[0].data, ((uint8_t[]){tsn, 0x00, 0x00}), 3);
	zassert_equal(node->zdo.tsn, (uint8_t)(tsn + 1));

	receive_node_desc_rsp(tsn, TC_ADDR, 0x00, 17);
	zassert_equal(zzb_zdo_node_desc_conf_fake.call_count, 1);
	zassert_equal(zzb_zdo_node_desc_conf_fake.arg1_val, 0x00);
	zassert_equal(zzb_zdo_node_desc_conf_fake.arg2_val, TC_ADDR);
	zassert_equal(zzb_zdo_node_desc_conf_fake.arg3_val, 0x2a41);

	/* The transaction has ended */
	receive_node_desc_rsp(tsn, TC_ADDR, 0x00, 17);
	k_sleep(K_MSEC(5100));
	zassert_equal(zzb_zdo_node_desc_conf_fake.call_count, 1);
}

/* A response matches by TSN, cluster and source */
ZTEST(zzb_zdo_client, test_unmatched_responses_and_timeout)
{
	uint8_t tsn = node->zdo.tsn;

	zassert_ok(zzb_zdo_node_desc_req(node, TC_ADDR));
	receive_node_desc_rsp(tsn + 1, TC_ADDR, 0x00, 17);
	receive_node_desc_rsp(tsn, 0x1234, 0x00, 17);
	/* A short descriptor */
	receive_node_desc_rsp(tsn, TC_ADDR, 0x00, 16);

	k_sleep(K_MSEC(4900));
	zassert_equal(zzb_zdo_node_desc_conf_fake.call_count, 0);
	k_sleep(K_MSEC(200));
	zassert_equal(zzb_zdo_node_desc_conf_fake.call_count, 1);
	zassert_equal(zzb_zdo_node_desc_conf_fake.arg1_val, 0x85);
}

ZTEST(zzb_zdo_client, test_error_status)
{
	uint8_t tsn = node->zdo.tsn;

	zassert_ok(zzb_zdo_node_desc_req(node, 0x1234));
	receive_node_desc_rsp(tsn, 0x1234, 0x80, 4);
	zassert_equal(zzb_zdo_node_desc_conf_fake.call_count, 1);
	zassert_equal(zzb_zdo_node_desc_conf_fake.arg1_val, 0x80);
	zassert_equal(zzb_zdo_node_desc_conf_fake.arg2_val, 0x1234);
}

ZTEST(zzb_zdo_client, test_rejected_requests)
{
	for (int i = 0; i < CONFIG_ZZB_ZDO_TRANSACTION_COUNT; i++) {
		zassert_ok(zzb_zdo_node_desc_req(node, TC_ADDR));
	}

	zassert_equal(zzb_zdo_node_desc_req(node, TC_ADDR), -ENOBUFS);
	k_sleep(K_MSEC(5100));
	zassert_equal(zzb_zdo_node_desc_conf_fake.call_count, CONFIG_ZZB_ZDO_TRANSACTION_COUNT);

	/* An error of APSDE-DATA.request takes no entry */
	zzb_apsde_data_req_fake.custom_fake = NULL;
	zzb_apsde_data_req_fake.return_val = -ENOTCONN;
	for (int i = 0; i <= CONFIG_ZZB_ZDO_TRANSACTION_COUNT; i++) {
		zassert_equal(zzb_zdo_node_desc_req(node, TC_ADDR), -ENOTCONN);
	}
}

/* R22 2.4.3.1.11: to the devices with the receiver on, without APS ACK */
ZTEST(zzb_zdo_client, test_device_annce)
{
	uint8_t tsn = node->zdo.tsn;

	zassert_ok(zzb_zdo_device_annce_req(node));
	zassert_equal(zzb_apsde_data_req_fake.call_count, 1);
	zassert_equal(sent[0].req.dst_addr, 0xfffd);
	zassert_equal(sent[0].req.cluster, DEVICE_ANNCE);
	zassert_equal(sent[0].req.tx_options, 0);
	zassert_equal(sent[0].len, 12);
	zassert_mem_equal(sent[0].data,
			  ((uint8_t[]){tsn, 0x78, 0x56, 0x04, 0x03, 0x02, 0x01, 0x00, 0x4b, 0x12,
				       0x00, 0x88}),
			  12);

	zzb_apsde_data_req_fake.custom_fake = NULL;
	zzb_apsde_data_req_fake.return_val = -ENOTCONN;
	zassert_equal(zzb_zdo_device_annce_req(node), -ENOTCONN);
}

/* BDB 8.2 step 14: to all routers and the coordinator, without APS ACK */
ZTEST(zzb_zdo_client, test_mgmt_permit_joining_req)
{
	uint8_t tsn = node->zdo.tsn;

	zassert_ok(zzb_zdo_mgmt_permit_joining_req(node, 180, true));
	zassert_equal(zzb_apsde_data_req_fake.call_count, 1);
	zassert_equal(sent[0].req.dst_addr, 0xfffc);
	zassert_equal(sent[0].req.cluster, PERMIT_JOIN);
	zassert_equal(sent[0].req.tx_options, 0);
	zassert_equal(sent[0].len, 3);
	zassert_mem_equal(sent[0].data, ((uint8_t[]){tsn, 180, 0x01}), 3);
	zassert_equal(node->zdo.tsn, (uint8_t)(tsn + 1));
}

static void receive_rsp(uint16_t cluster, uint16_t src_addr, const uint8_t *rsp, size_t len)
{
	const struct zzb_apsde_ind ind = {
		.dst_addr = NODE_ADDR,
		.src_addr = src_addr,
		.cluster = cluster | 0x8000,
	};

	receive_ind(&ind, rsp, len);
}

/* BDB 8.5 steps 5 and 6 */
ZTEST(zzb_zdo_client, test_simple_desc_req)
{
	uint8_t tsn = node->zdo.tsn;
	/* Endpoint 1 of an On/Off Light: Identify and On/Off servers, OTA Upgrade client */
	uint8_t rsp[] = {tsn,  0x00, 0x34, 0x12, 0x0e, 0x01, 0x04, 0x01, 0x00, 0x01,
			 0x01, 0x02, 0x03, 0x00, 0x06, 0x00, 0x01, 0x19, 0x00};

	zassert_ok(zzb_zdo_simple_desc_req(node, 0x1234, 1));
	zassert_equal(sent[0].req.dst_addr, 0x1234);
	zassert_equal(sent[0].req.cluster, SIMPLE_DESC_REQ);
	zassert_equal(sent[0].req.tx_options, ZZB_APS_TX_ACK);
	zassert_equal(sent[0].len, 4);
	zassert_mem_equal(sent[0].data, ((uint8_t[]){tsn, 0x34, 0x12, 0x01}), 4);

	/* A descriptor shorter than its length field is dropped */
	receive_rsp(SIMPLE_DESC_REQ, 0x1234, rsp, sizeof(rsp) - 1);
	zassert_equal(zzb_zdo_simple_desc_conf_fake.call_count, 0);

	receive_rsp(SIMPLE_DESC_REQ, 0x1234, rsp, sizeof(rsp));
	zassert_equal(zzb_zdo_simple_desc_conf_fake.call_count, 1);
	zassert_equal(zzb_zdo_simple_desc_conf_fake.arg1_val, 0x00);
	zassert_equal(zzb_zdo_simple_desc_conf_fake.arg2_val, 0x1234);
	zassert_equal(simple_desc.ep, 1);
	zassert_equal(simple_desc.profile, 0x0104);
	zassert_equal(simple_desc.device_id, 0x0100);
	zassert_equal(simple_desc.in_count, 2);
	zassert_mem_equal(simple_desc_in, ((uint8_t[]){0x03, 0x00, 0x06, 0x00}), 4);
	zassert_equal(simple_desc.out_count, 1);
	zassert_mem_equal(simple_desc_out, ((uint8_t[]){0x19, 0x00}), 2);

	/* NOT_ACTIVE without a descriptor */
	tsn = node->zdo.tsn;
	zassert_ok(zzb_zdo_simple_desc_req(node, 0x1234, 7));
	receive_rsp(SIMPLE_DESC_REQ, 0x1234, (uint8_t[]){tsn, 0x83, 0x34, 0x12, 0x00}, 5);
	zassert_equal(zzb_zdo_simple_desc_conf_fake.call_count, 2);
	zassert_equal(zzb_zdo_simple_desc_conf_fake.arg1_val, 0x83);
	zassert_is_null(zzb_zdo_simple_desc_conf_fake.arg3_val);
}

/* BDB 8.5 step 8: the IEEE address of a respondent goes to nwkAddressMap */
ZTEST(zzb_zdo_client, test_ieee_addr_req)
{
	uint8_t tsn = node->zdo.tsn;
	const uint8_t rsp[] = {tsn, 0x00, 1, 2, 3, 4, 5, 6, 7, 8, 0x34, 0x12};

	zassert_ok(zzb_zdo_ieee_addr_req(node, 0x1234));
	zassert_equal(sent[0].req.dst_addr, 0x1234);
	zassert_equal(sent[0].req.cluster, IEEE_ADDR_REQ);
	zassert_mem_equal(sent[0].data, ((uint8_t[]){tsn, 0x34, 0x12, 0x00, 0x00}), 5);

	receive_rsp(IEEE_ADDR_REQ, 0x1234, rsp, sizeof(rsp) - 1);
	zassert_equal(zzb_zdo_ieee_addr_conf_fake.call_count, 0);
	receive_rsp(IEEE_ADDR_REQ, 0x1234, rsp, sizeof(rsp));
	zassert_equal(zzb_zdo_ieee_addr_conf_fake.call_count, 1);
	zassert_equal(zzb_zdo_ieee_addr_conf_fake.arg1_val, 0x00);
	zassert_equal(zzb_zdo_ieee_addr_conf_fake.arg2_val, 0x1234);
	zassert_equal(zzb_zdo_ieee_addr_conf_fake.arg3_val, 0x0807060504030201ULL);
	zassert_equal(zzb_nlme_set_addr_map_fake.call_count, 1);
	zassert_equal(zzb_nlme_set_addr_map_fake.arg1_val, 0x0807060504030201ULL);
	zassert_equal(zzb_nlme_set_addr_map_fake.arg2_val, 0x1234);

	/* No response */
	zassert_ok(zzb_zdo_ieee_addr_req(node, 0x2222));
	k_sleep(K_MSEC(5100));
	zassert_equal(zzb_zdo_ieee_addr_conf_fake.call_count, 2);
	zassert_equal(zzb_zdo_ieee_addr_conf_fake.arg1_val, 0x85);
	zassert_equal(zzb_nlme_set_addr_map_fake.call_count, 1);
}

/* Whether the last call of the zzb_nwk_poll_hold() fake set the hold of ZDO */
static bool held(void)
{
	return zzb_nwk_poll_hold_fake.arg1_val == ZZB_NWK_HOLD_ZDO &&
	       zzb_nwk_poll_hold_fake.arg2_val;
}

/* A sleepy node fetches the response from its parent at the short poll interval (section 5) */
ZTEST(zzb_zdo_client, test_transactions_hold_the_poll_rate)
{
	uint8_t tsn = node->zdo.tsn;

	zassert_ok(zzb_zdo_node_desc_req(node, TC_ADDR));
	zassert_true(held());
	receive_node_desc_rsp(tsn, TC_ADDR, 0x00, 17);
	zassert_false(held());

	/* The hold lasts until the last transaction ends */
	zassert_ok(zzb_zdo_ieee_addr_req(node, 0x2222));
	k_sleep(K_MSEC(1000));
	zassert_ok(zzb_zdo_node_desc_req(node, TC_ADDR));
	k_sleep(K_MSEC(4100));
	zassert_equal(zzb_zdo_ieee_addr_conf_fake.arg1_val, 0x85);
	zassert_true(held());
	k_sleep(K_MSEC(1000));
	zassert_equal(zzb_zdo_node_desc_conf_fake.arg1_val, 0x85);
	zassert_false(held());

	/* The init of ZDO clears the table without a confirm */
	zassert_ok(zzb_zdo_node_desc_req(node, TC_ADDR));
	zzb_zdo_init(node);
	zassert_false(held());
}

ZTEST_SUITE(zzb_zdo_client, NULL, setup, before, after, NULL);
```

## src/desc.c
```c
/* SPDX-License-Identifier: Apache-2.0 */

#include <zephyr/ztest.h>

#include "common/node.h"
#include "fakes.h"

#define NODE_DESC_REQ   0x0002
#define POWER_DESC_REQ  0x0003
#define SIMPLE_DESC_REQ 0x0004
#define ACTIVE_EP_REQ   0x0005
#define MATCH_DESC_REQ  0x0006

#define NODE_ADDR_LE 0x78, 0x56

static void *setup(void)
{
	test_node();
	return NULL;
}

static void before(void *fixture)
{
	reset_fakes();
}

static void after(void *fixture)
{
	check_no_buffer_leak();
}

/* R22 2.3.2.3: stack compliance revision 22 in the server mask (BDB 10.2.5) */
ZTEST(zzb_zdo_desc, test_node_desc)
{
	static const uint8_t req[] = {0x20, NODE_ADDR_LE};
	static const uint8_t rsp[] = {0x20, 0x00, 0x78, 0x56, 0x02, 0x40, 0x88, 0x34, 0x12,
				      0x52, 0x52, 0x00, 0x00, 0x2c, 0x52, 0x00, 0x00};

	receive(NODE_DESC_REQ, NODE_ADDR, req, sizeof(req));
	check_response(0, NODE_DESC_REQ | 0x8000, rsp, sizeof(rsp));
}

/* R22 2.4.4.2.3; the request is unicast only (R22 2.4.2.1) */
ZTEST(zzb_zdo_desc, test_node_desc_of_another_device)
{
	static const uint8_t req[] = {0x21, 0x34, 0x12};
	static const uint8_t rsp[] = {0x21, 0x80, 0x34, 0x12};

	receive(NODE_DESC_REQ, 0xfffd, req, sizeof(req));
	zassert_equal(zzb_apsde_data_req_fake.call_count, 0);

	receive(NODE_DESC_REQ, NODE_ADDR, req, sizeof(req));
	check_response(0, NODE_DESC_REQ | 0x8000, rsp, sizeof(rsp));
}

/* R22 2.3.2.4: receiver synchronized with RxOnWhenIdle, mains power, level 100 % */
ZTEST(zzb_zdo_desc, test_power_desc)
{
	static const uint8_t req[] = {0x22, NODE_ADDR_LE};
	static const uint8_t rsp[] = {0x22, 0x00, NODE_ADDR_LE, 0x10, 0xc1};

	receive(POWER_DESC_REQ, NODE_ADDR, req, sizeof(req));
	check_response(0, POWER_DESC_REQ | 0x8000, rsp, sizeof(rsp));
}

/* R22 Table 2-35: the receiver of a sleepy end device comes on periodically */
ZTEST(zzb_zdo_desc, test_power_desc_of_a_sleepy_node)
{
	static const uint8_t req[] = {0x24, NODE_ADDR_LE};
	static const uint8_t rsp[] = {0x24, 0x00, NODE_ADDR_LE, 0x11, 0xc1};

	test_node()->sleepy = true;
	receive(POWER_DESC_REQ, NODE_ADDR, req, sizeof(req));
	test_node()->sleepy = false;
	check_response(0, POWER_DESC_REQ | 0x8000, rsp, sizeof(rsp));
}

/* R22 2.3.2.5 */
ZTEST(zzb_zdo_desc, test_simple_desc)
{
	uint8_t req[] = {0x23, NODE_ADDR_LE, 0x01};
	/* Status, address, length, endpoint, profile, device, version, clusters */
	static const uint8_t light[] = {0x23, 0x00, 0x78, 0x56, 0x0e, 0x01, 0x04, 0x01, 0x00, 0x01,
					0x01, 0x03, 0x00, 0x00, 0x03, 0x00, 0x06, 0x00, 0x00};
	static const uint8_t light_switch[] = {0x23, 0x00, 0x78, 0x56, 0x10, 0x02, 0x04,
					       0x01, 0x03, 0x01, 0x00, 0x02, 0x00, 0x00,
					       0x03, 0x00, 0x02, 0x03, 0x00, 0x06, 0x00};

	receive(SIMPLE_DESC_REQ, NODE_ADDR, req, sizeof(req));
	check_response(0, SIMPLE_DESC_REQ | 0x8000, light, sizeof(light));

	req[3] = 0x02;
	receive(SIMPLE_DESC_REQ, NODE_ADDR, req, sizeof(req));
	check_response(1, SIMPLE_DESC_REQ | 0x8000, light_switch, sizeof(light_switch));

	receive(SIMPLE_DESC_REQ, 0xfffd, req, sizeof(req));
	zassert_equal(zzb_apsde_data_req_fake.call_count, 2);
}

/* R22 2.4.4.2.5: the range of the endpoint, the address, then the endpoint */
ZTEST(zzb_zdo_desc, test_simple_desc_errors)
{
	uint8_t req[] = {0x24, 0x34, 0x12, 0x00};

	receive(SIMPLE_DESC_REQ, NODE_ADDR, req, sizeof(req));
	check_response(0, SIMPLE_DESC_REQ | 0x8000, (uint8_t[]){0x24, 0x82, 0x34, 0x12, 0x00}, 5);

	req[3] = 0x03;
	receive(SIMPLE_DESC_REQ, NODE_ADDR, req, sizeof(req));
	check_response(1, SIMPLE_DESC_REQ | 0x8000, (uint8_t[]){0x24, 0x80, 0x34, 0x12, 0x00}, 5);

	req[1] = 0x78;
	req[2] = 0x56;
	receive(SIMPLE_DESC_REQ, NODE_ADDR, req, sizeof(req));
	check_response(2, SIMPLE_DESC_REQ | 0x8000, (uint8_t[]){0x24, 0x83, 0x78, 0x56, 0x00}, 5);
}

ZTEST(zzb_zdo_desc, test_active_ep)
{
	uint8_t req[] = {0x25, NODE_ADDR_LE};
	static const uint8_t rsp[] = {0x25, 0x00, NODE_ADDR_LE, 0x02, 0x01, 0x02};

	receive(ACTIVE_EP_REQ, NODE_ADDR, req, sizeof(req));
	check_response(0, ACTIVE_EP_REQ | 0x8000, rsp, sizeof(rsp));

	req[1] = 0x34;
	req[2] = 0x12;
	receive(ACTIVE_EP_REQ, NODE_ADDR, req, sizeof(req));
	check_response(1, ACTIVE_EP_REQ | 0x8000, (uint8_t[]){0x25, 0x80, 0x34, 0x12, 0x00}, 5);
}

/* R22 2.4.4.2.7: input clusters match servers, output clusters match clients */
ZTEST(zzb_zdo_desc, test_match_desc)
{
	uint8_t req[] = {0x26, 0xfd, 0xff, 0x04, 0x01, 0x01, 0x06, 0x00, 0x01, 0x06, 0x00};
	static const uint8_t both[] = {0x26, 0x00, NODE_ADDR_LE, 0x02, 0x01, 0x02};
	static const uint8_t light[] = {0x26, 0x00, NODE_ADDR_LE, 0x01, 0x01};
	static const uint8_t none[] = {0x26, 0x00, NODE_ADDR_LE, 0x00};

	receive(MATCH_DESC_REQ, 0xfffd, req, sizeof(req));
	check_response(0, MATCH_DESC_REQ | 0x8000, both, sizeof(both));

	/* Any profile, input clusters only */
	req[3] = 0xff;
	req[4] = 0xff;
	req[8] = 0x00;
	receive(MATCH_DESC_REQ, 0xfffd, req, sizeof(req) - 2);
	check_response(1, MATCH_DESC_REQ | 0x8000, light, sizeof(light));

	/* Another profile matches nothing; a broadcast gets no response then */
	req[3] = 0x09;
	req[4] = 0x01;
	req[8] = 0x01;
	receive(MATCH_DESC_REQ, 0xfffd, req, sizeof(req));
	zassert_equal(zzb_apsde_data_req_fake.call_count, 2);
	req[1] = 0x78;
	req[2] = 0x56;
	receive(MATCH_DESC_REQ, NODE_ADDR, req, sizeof(req));
	check_response(2, MATCH_DESC_REQ | 0x8000, none, sizeof(none));

	/* The cluster lists exceed the payload */
	receive(MATCH_DESC_REQ, NODE_ADDR, req, sizeof(req) - 1);
	zassert_equal(zzb_apsde_data_req_fake.call_count, 3);
}

/* An input cluster matches only a server instance, an output cluster only a client instance */
ZTEST(zzb_zdo_desc, test_match_desc_roles)
{
	/* No profile filter, input Identify, then output Identify, then output Basic */
	static const uint8_t req[] = {0x28, NODE_ADDR_LE, 0xff, 0xff, 0x01, 0x03, 0x00, 0x00};
	static const uint8_t servers[] = {0x28, 0x00, NODE_ADDR_LE, 0x02, 0x01, 0x02};
	static const uint8_t client[] = {0x28, 0x00, NODE_ADDR_LE, 0x01, 0x02};
	static const uint8_t none[] = {0x28, 0x00, NODE_ADDR_LE, 0x00};

	receive(MATCH_DESC_REQ, NODE_ADDR, req, sizeof(req));
	check_response(0, MATCH_DESC_REQ | 0x8000, servers, sizeof(servers));

	receive(MATCH_DESC_REQ, NODE_ADDR,
		(uint8_t[]){0x28, NODE_ADDR_LE, 0xff, 0xff, 0x00, 0x01, 0x03, 0x00}, sizeof(req));
	check_response(1, MATCH_DESC_REQ | 0x8000, client, sizeof(client));

	receive(MATCH_DESC_REQ, NODE_ADDR,
		(uint8_t[]){0x28, NODE_ADDR_LE, 0xff, 0xff, 0x00, 0x01, 0x00, 0x00}, sizeof(req));
	check_response(2, MATCH_DESC_REQ | 0x8000, none, sizeof(none));
}

/* R22 2.4.4.2.7 step 2 */
ZTEST(zzb_zdo_desc, test_match_desc_for_another_device)
{
	static const uint8_t req[] = {0x27, 0x34, 0x12, 0x04, 0x01, 0x01, 0x06, 0x00, 0x00};

	receive(MATCH_DESC_REQ, 0xfffd, req, sizeof(req));
	zassert_equal(zzb_apsde_data_req_fake.call_count, 0);

	receive(MATCH_DESC_REQ, NODE_ADDR, req, sizeof(req));
	check_response(0, MATCH_DESC_REQ | 0x8000, (uint8_t[]){0x27, 0x80, 0x34, 0x12, 0x00}, 5);
}

ZTEST_SUITE(zzb_zdo_desc, NULL, setup, before, after, NULL);
```

## src/fakes.c
```c
/* SPDX-License-Identifier: Apache-2.0 */

#include <errno.h>
#include <string.h>
#include <zephyr/fff.h>
#include <zephyr/ztest.h>
#include <zzb/zzb.h>

#include "common/node.h"
#include "fakes.h"
#include "zdo/zdo.h"

DEFINE_FFF_GLOBALS;

DEFINE_FAKE_VALUE_FUNC(int, zzb_apsde_data_req, struct zzb_node *, struct net_buf *,
		       const struct zzb_apsde_req *);
DEFINE_FAKE_VALUE_FUNC(int, zzb_apsme_set_tc_addr, struct zzb_node *, uint64_t);
DEFINE_FAKE_VALUE_FUNC(int, zzb_nlme_set_active_key, struct zzb_node *, uint8_t);
DEFINE_FAKE_VALUE_FUNC(uint16_t, zzb_nlme_get_short_addr, const struct zzb_node *);
DEFINE_FAKE_VALUE_FUNC(uint8_t, zzb_nlme_get_capability, const struct zzb_node *);
DEFINE_FAKE_VALUE_FUNC(uint64_t, zzb_nlme_get_ext_pan_id, const struct zzb_node *);
DEFINE_FAKE_VALUE_FUNC(int, zzb_nlme_set_channel, struct zzb_node *, uint8_t, uint8_t);
DEFINE_FAKE_VALUE_FUNC(int, zzb_nwk_addr_map_find, struct zzb_node *, uint64_t, uint16_t *);
DEFINE_FAKE_VALUE_FUNC(int, zzb_nlme_set_addr_map, struct zzb_node *, uint64_t, uint16_t);
DEFINE_FAKE_VOID_FUNC(zzb_nwk_poll_hold, struct zzb_node *, enum zzb_nwk_hold, bool);
DEFINE_FAKE_VOID_FUNC(zzb_bdb_nwk_key_ind, struct zzb_node *);
DEFINE_FAKE_VOID_FUNC(zzb_bdb_leave, struct zzb_node *, bool);
DEFINE_FAKE_VOID_FUNC(zzb_bdb_tc_link_key_ind, struct zzb_node *, uint64_t, const uint8_t *);
DEFINE_FAKE_VOID_FUNC(zzb_zdo_node_desc_conf, struct zzb_node *, uint8_t, uint16_t, uint16_t);
DEFINE_FAKE_VOID_FUNC(zzb_zdo_simple_desc_conf, struct zzb_node *, uint8_t, uint16_t,
		      const struct zzb_zdo_simple_desc *);
DEFINE_FAKE_VOID_FUNC(zzb_zdo_ieee_addr_conf, struct zzb_node *, uint8_t, uint16_t, uint64_t);
DEFINE_FAKE_VALUE_FUNC(int, zzb_apsme_bind_req, struct zzb_node *, const struct zzb_aps_binding *);
DEFINE_FAKE_VALUE_FUNC(int, zzb_apsme_unbind_req, struct zzb_node *,
		       const struct zzb_aps_binding *);
DEFINE_FAKE_VOID_FUNC(zzb_zcl_data_ind, struct zzb_node *, struct net_buf *,
		      const struct zzb_apsde_ind *);

struct frame_copy sent[8];
struct set_nwk_key_calls set_nwk_key;
struct zzb_aps_binding binding;

static void zcl_data_ind_drop(struct zzb_node *node, struct net_buf *buf,
			      const struct zzb_apsde_ind *ind)
{
	net_buf_unref(buf);
}

static int bind_copy(struct zzb_node *node, const struct zzb_aps_binding *arg)
{
	binding = *arg;
	return 0;
}

void zzb_nlme_set_nwk_key(struct zzb_node *node, const uint8_t key[ZZB_SEC_KEY_LEN], uint8_t seq)
{
	set_nwk_key.count++;
	set_nwk_key.key = key;
	set_nwk_key.seq = seq;
}

/* Basic, Identify and On/Off servers of an On/Off Light */
static const struct zzb_zcl_cluster light[] = {
	{.id = 0x0000, .server = true},
	{.id = 0x0003, .server = true},
	{.id = 0x0006, .server = true},
};

/* Basic and Identify servers, Identify and On/Off clients of an On/Off Light Switch */
static const struct zzb_zcl_cluster light_switch[] = {
	{.id = 0x0000, .server = true},
	{.id = 0x0003, .server = true},
	{.id = 0x0003},
	{.id = 0x0006},
};

static const struct zzb_endpoint endpoints[] = {
	{
		.id = 1,
		.profile = 0x0104,
		.device_id = 0x0100,
		.device_version = 1,
		.clusters = light,
		.cluster_count = ARRAY_SIZE(light),
	},
	{
		.id = 2,
		.profile = 0x0104,
		.device_id = 0x0103,
		.clusters = light_switch,
		.cluster_count = ARRAY_SIZE(light_switch),
	},
};

static const struct zzb_device device = {
	.manufacturer_code = 0x1234,
	.power_source = ZZB_POWER_MAINS,
	.endpoints = endpoints,
	.endpoint_count = ARRAY_SIZE(endpoints),
};

static int apsde_data_req_take(struct zzb_node *node, struct net_buf *buf,
			       const struct zzb_apsde_req *req)
{
	struct frame_copy *copy = &sent[zzb_apsde_data_req_fake.call_count - 1];

	zassert_true(zzb_apsde_data_req_fake.call_count <= ARRAY_SIZE(sent));
	zassert_true(buf->len <= sizeof(copy->data));
	copy->req = *req;
	copy->handle = zzb_frame_meta(buf)->handle;
	memcpy(copy->data, buf->data, buf->len);
	copy->len = buf->len;
	net_buf_unref(buf);
	return 0;
}

struct zzb_node *test_node(void)
{
	static struct zzb_node *node;
	const struct zzb_node_config cfg = {
		.eui64 = NODE_EUI64,
		.device = &device,
	};

	if (node == NULL) {
		zassert_ok(zzb_node_init(&cfg, &node));
	}

	return node;
}

struct zzb_zdo_simple_desc simple_desc;
uint8_t simple_desc_in[16];
uint8_t simple_desc_out[16];

static void simple_desc_copy(struct zzb_node *node, uint8_t status, uint16_t addr,
			     const struct zzb_zdo_simple_desc *desc)
{
	if (desc == NULL) {
		return;
	}

	zassert_true(2 * desc->in_count <= sizeof(simple_desc_in));
	zassert_true(2 * desc->out_count <= sizeof(simple_desc_out));
	simple_desc = *desc;
	memcpy(simple_desc_in, desc->in, 2 * desc->in_count);
	memcpy(simple_desc_out, desc->out, 2 * desc->out_count);
}

void reset_fakes(void)
{
	RESET_FAKE(zzb_apsde_data_req);
	RESET_FAKE(zzb_apsme_set_tc_addr);
	RESET_FAKE(zzb_nlme_set_active_key);
	RESET_FAKE(zzb_nlme_get_short_addr);
	RESET_FAKE(zzb_nlme_get_capability);
	RESET_FAKE(zzb_nlme_get_ext_pan_id);
	RESET_FAKE(zzb_nlme_set_channel);
	RESET_FAKE(zzb_nwk_addr_map_find);
	RESET_FAKE(zzb_nlme_set_addr_map);
	RESET_FAKE(zzb_nwk_poll_hold);
	RESET_FAKE(zzb_bdb_nwk_key_ind);
	RESET_FAKE(zzb_bdb_leave);
	RESET_FAKE(zzb_bdb_tc_link_key_ind);
	RESET_FAKE(zzb_zdo_node_desc_conf);
	RESET_FAKE(zzb_zdo_simple_desc_conf);
	RESET_FAKE(zzb_zdo_ieee_addr_conf);
	RESET_FAKE(zzb_apsme_bind_req);
	RESET_FAKE(zzb_apsme_unbind_req);
	RESET_FAKE(zzb_zcl_data_ind);
	FFF_RESET_HISTORY();
	set_nwk_key = (struct set_nwk_key_calls){0};

	zzb_apsde_data_req_fake.custom_fake = apsde_data_req_take;
	zzb_apsme_bind_req_fake.custom_fake = bind_copy;
	zzb_apsme_unbind_req_fake.custom_fake = bind_copy;
	zzb_zcl_data_ind_fake.custom_fake = zcl_data_ind_drop;
	zzb_zdo_simple_desc_conf_fake.custom_fake = simple_desc_copy;
	binding = (struct zzb_aps_binding){0};
	zzb_nlme_get_short_addr_fake.return_val = NODE_ADDR;
	zzb_nwk_addr_map_find_fake.return_val = -ENOENT;
	/* Receiver on when idle, allocate address */
	zzb_nlme_get_capability_fake.return_val = 0x88;
}

void check_no_buffer_leak(void)
{
	struct net_buf *bufs[CONFIG_ZZB_BUF_COUNT];

	ARRAY_FOR_EACH(bufs, i) {
		bufs[i] = zzb_buf_alloc(K_NO_WAIT);
		zassert_not_null(bufs[i], "buffer leak");
	}

	ARRAY_FOR_EACH(bufs, i) {
		net_buf_unref(bufs[i]);
	}
}

void receive_ind(const struct zzb_apsde_ind *ind, const uint8_t *asdu, size_t len)
{
	struct net_buf *buf = zzb_buf_alloc(K_NO_WAIT);

	zassert_not_null(buf);
	net_buf_add_mem(buf, asdu, len);
	zzb_apsde_data_ind(test_node(), buf, ind);
}

void receive(uint16_t cluster, uint16_t dst_addr, const uint8_t *asdu, size_t len)
{
	const struct zzb_apsde_ind ind = {
		.dst_addr = dst_addr,
		.src_addr = REQUESTER_ADDR,
		.cluster = cluster,
		.security = ZZB_APS_SECURED_NWK_KEY,
	};

	receive_ind(&ind, asdu, len);
}

void check_response(int i, uint16_t cluster, const uint8_t *asdu, size_t len)
{
	const struct frame_copy *copy = &sent[i];

	zassert_true(zzb_apsde_data_req_fake.call_count > i);
	zassert_equal(copy->req.dst_mode, ZZB_APS_ADDR_SHORT);
	zassert_equal(copy->req.dst_addr, REQUESTER_ADDR);
	zassert_equal(copy->req.dst_ep, 0);
	zassert_equal(copy->req.src_ep, 0);
	zassert_equal(copy->req.profile, 0x0000);
	zassert_equal(copy->req.cluster, cluster);
	zassert_equal(copy->req.tx_options, ZZB_APS_TX_ACK);
	zassert_equal(copy->handle, ZZB_ZDO_HANDLE);
	zassert_equal(copy->len, len);
	zassert_mem_equal(copy->data, asdu, len);
}
```

## src/fakes.h
```c
/* SPDX-License-Identifier: Apache-2.0 */

#ifndef ZZB_TESTS_UNIT_ZDO_FAKES_H_
#define ZZB_TESTS_UNIT_ZDO_FAKES_H_

#include <stddef.h>
#include <stdint.h>
#include <zephyr/fff.h>
#include <zephyr/net_buf.h>

#include "aps/aps.h"
#include "common/buf.h"
#include "nwk/nwk.h"

DECLARE_FAKE_VALUE_FUNC(int, zzb_apsde_data_req, struct zzb_node *, struct net_buf *,
			const struct zzb_apsde_req *);
DECLARE_FAKE_VALUE_FUNC(int, zzb_apsme_set_tc_addr, struct zzb_node *, uint64_t);
DECLARE_FAKE_VALUE_FUNC(int, zzb_nlme_set_active_key, struct zzb_node *, uint8_t);
DECLARE_FAKE_VALUE_FUNC(uint16_t, zzb_nlme_get_short_addr, const struct zzb_node *);
DECLARE_FAKE_VALUE_FUNC(uint8_t, zzb_nlme_get_capability, const struct zzb_node *);
DECLARE_FAKE_VALUE_FUNC(uint64_t, zzb_nlme_get_ext_pan_id, const struct zzb_node *);
DECLARE_FAKE_VALUE_FUNC(int, zzb_nlme_set_channel, struct zzb_node *, uint8_t, uint8_t);
DECLARE_FAKE_VALUE_FUNC(int, zzb_nwk_addr_map_find, struct zzb_node *, uint64_t, uint16_t *);
DECLARE_FAKE_VALUE_FUNC(int, zzb_nlme_set_addr_map, struct zzb_node *, uint64_t, uint16_t);
DECLARE_FAKE_VOID_FUNC(zzb_nwk_poll_hold, struct zzb_node *, enum zzb_nwk_hold, bool);
DECLARE_FAKE_VOID_FUNC(zzb_bdb_nwk_key_ind, struct zzb_node *);
DECLARE_FAKE_VOID_FUNC(zzb_bdb_leave, struct zzb_node *, bool);
DECLARE_FAKE_VOID_FUNC(zzb_bdb_tc_link_key_ind, struct zzb_node *, uint64_t, const uint8_t *);
DECLARE_FAKE_VOID_FUNC(zzb_zdo_node_desc_conf, struct zzb_node *, uint8_t, uint16_t, uint16_t);
DECLARE_FAKE_VOID_FUNC(zzb_zdo_simple_desc_conf, struct zzb_node *, uint8_t, uint16_t,
		       const struct zzb_zdo_simple_desc *);
DECLARE_FAKE_VOID_FUNC(zzb_zdo_ieee_addr_conf, struct zzb_node *, uint8_t, uint16_t, uint64_t);
DECLARE_FAKE_VALUE_FUNC(int, zzb_apsme_bind_req, struct zzb_node *, const struct zzb_aps_binding *);
DECLARE_FAKE_VALUE_FUNC(int, zzb_apsme_unbind_req, struct zzb_node *,
			const struct zzb_aps_binding *);
DECLARE_FAKE_VOID_FUNC(zzb_zcl_data_ind, struct zzb_node *, struct net_buf *,
		       const struct zzb_apsde_ind *);

#define NODE_EUI64 0x00124b0001020304ULL
#define NODE_ADDR  0x5678

/* The coordinator sends the requests */
#define REQUESTER_ADDR 0x0000

/* The descriptor of the last zzb_zdo_simple_desc_conf() with SUCCESS, and its cluster lists */
extern struct zzb_zdo_simple_desc simple_desc;
extern uint8_t simple_desc_in[16];
extern uint8_t simple_desc_out[16];

/* Copy of a frame passed to APSDE-DATA.request */
struct frame_copy {
	struct zzb_apsde_req req;
	uint8_t handle;
	uint8_t data[ZZB_BUF_SIZE];
	size_t len;
};

/* By default the zzb_apsde_data_req() fake takes the buffer and copies the frame here */
extern struct frame_copy sent[8];

/*
 * Calls of the zzb_nlme_set_nwk_key() fake. FFF declares the array parameter as a pointer, which
 * -Werror=array-parameter rejects.
 */
struct set_nwk_key_calls {
	int count;
	const uint8_t *key;
	uint8_t seq;
};

extern struct set_nwk_key_calls set_nwk_key;

/* The binding of the last APSME-BIND or APSME-UNBIND */
extern struct zzb_aps_binding binding;

struct zzb_node *test_node(void);

/* Resets every fake */
void reset_fakes(void);

/* Checks that every frame buffer is free */
void check_no_buffer_leak(void);

/* Passes the ASDU to ZDO as APSDE-DATA.indication with the parameters of ind */
void receive_ind(const struct zzb_apsde_ind *ind, const uint8_t *asdu, size_t len);

/* Passes a ZDO frame of cluster from REQUESTER_ADDR to dst_addr */
void receive(uint16_t cluster, uint16_t dst_addr, const uint8_t *asdu, size_t len);

/* Checks that frame i is the ZDO response of cluster to REQUESTER_ADDR with the ASDU */
void check_response(int i, uint16_t cluster, const uint8_t *asdu, size_t len);

#endif /* ZZB_TESTS_UNIT_ZDO_FAKES_H_ */
```

## src/mgmt.c
```c
/* SPDX-License-Identifier: Apache-2.0 */

#include <errno.h>
#include <string.h>
#include <zephyr/ztest.h>

#include "common/node.h"
#include "fakes.h"

#define MGMT_LQI_REQ            0x0031
#define MGMT_BIND_REQ           0x0033
#define MGMT_LEAVE_REQ          0x0034
#define MGMT_PERMIT_JOINING_REQ 0x0036
#define MGMT_NWK_UPDATE_REQ     0x0038

static struct zzb_node *node;

static void *setup(void)
{
	node = test_node();
	return NULL;
}

static void before(void *fixture)
{
	reset_fakes();
	memset(node->nwk.neighbors, 0, sizeof(node->nwk.neighbors));
	memset(node->aps.aib.bindings, 0, sizeof(node->aps.aib.bindings));
	zzb_nlme_get_ext_pan_id_fake.return_val = 0x0102030405060708ULL;
}

static void after(void *fixture)
{
	check_no_buffer_leak();
}

static struct zzb_nwk_neighbor *add_neighbor(int i, enum zzb_nwk_relationship relationship)
{
	struct zzb_nwk_neighbor *nb = &node->nwk.neighbors[i];

	*nb = (struct zzb_nwk_neighbor){
		.in_use = true,
		.ext_addr = 0x00124b0000000010ULL + i,
		.short_addr = 0x1110 + i,
		.device_type = ZZB_NWK_DEVICE_ROUTER,
		.relationship = relationship,
		.lqi = 200,
		.beacon.depth = 1,
	};
	return nb;
}

/* R22 Table 2-130 */
ZTEST(zzb_zdo_mgmt, test_mgmt_lqi)
{
	static const uint8_t req[] = {0x40, 0x00};
	static const uint8_t rsp[] = {
		0x40, 0x00, 0x01, 0x00, 0x01,
		/* Extended PAN ID, extended address, network address */
		0x08, 0x07, 0x06, 0x05, 0x04, 0x03, 0x02, 0x01, 0x10, 0x00, 0x00, 0x00, 0x00, 0x4b,
		0x12, 0x00, 0x10, 0x11,
		/* Router, receiver on, parent; permit joining unknown; depth, LQI */
		0x05, 0x02, 0x01, 0xc8};

	add_neighbor(0, ZZB_NWK_REL_PARENT);
	/* An entry from a beacon is not a neighbor of the network */
	add_neighbor(1, ZZB_NWK_REL_NONE);

	receive(MGMT_LQI_REQ, NODE_ADDR, req, sizeof(req));
	check_response(0, MGMT_LQI_REQ | 0x8000, rsp, sizeof(rsp));

	receive(MGMT_LQI_REQ, 0xfffd, req, sizeof(req));
	zassert_equal(zzb_apsde_data_req_fake.call_count, 1);
}

/* As many records from the start index as fit in an ASDU (R22 2.4.4.4.2) */
ZTEST(zzb_zdo_mgmt, test_mgmt_lqi_pages)
{
	uint8_t req[] = {0x41, 0x00};

	for (int i = 0; i < 5; i++) {
		add_neighbor(i, ZZB_NWK_REL_CHILD);
	}

	receive(MGMT_LQI_REQ, NODE_ADDR, req, sizeof(req));
	zassert_equal(sent[0].len, 5 + 3 * 22);
	zassert_mem_equal(sent[0].data, ((uint8_t[]){0x41, 0x00, 0x05, 0x00, 0x03}), 5);

	req[1] = 0x03;
	receive(MGMT_LQI_REQ, NODE_ADDR, req, sizeof(req));
	zassert_equal(sent[1].len, 5 + 2 * 22);
	zassert_mem_equal(sent[1].data, ((uint8_t[]){0x41, 0x00, 0x05, 0x03, 0x02}), 5);
	zassert_equal(sent[1].data[5 + 16], 0x13);

	req[1] = 0x05;
	receive(MGMT_LQI_REQ, NODE_ADDR, req, sizeof(req));
	check_response(2, MGMT_LQI_REQ | 0x8000, (uint8_t[]){0x41, 0x00, 0x05, 0x05, 0x00}, 5);
}

/* R22 Table 2-134 */
ZTEST(zzb_zdo_mgmt, test_mgmt_bind)
{
	static const uint8_t req[] = {0x42, 0x00};
	static const uint8_t rsp[] = {
		0x42, 0x00, 0x02, 0x00, 0x02,
		/* To an IEEE address and endpoint */
		0x04, 0x03, 0x02, 0x01, 0x00, 0x4b, 0x12, 0x00, 0x01, 0x06, 0x00, 0x03, 0x01, 0x02,
		0x03, 0x04, 0x05, 0x06, 0x07, 0x08, 0x02,
		/* To a group */
		0x04, 0x03, 0x02, 0x01, 0x00, 0x4b, 0x12, 0x00, 0x01, 0x08, 0x00, 0x01, 0x34, 0x12};

	node->aps.aib.bindings[0] = (struct zzb_aps_binding){
		.in_use = true,
		.src_ep = 0x01,
		.cluster = 0x0006,
		.dst_mode = ZZB_APS_ADDR_EXT,
		.dst_ext = 0x0807060504030201ULL,
		.dst_ep = 0x02,
	};
	node->aps.aib.bindings[2] = (struct zzb_aps_binding){
		.in_use = true,
		.src_ep = 0x01,
		.cluster = 0x0008,
		.dst_mode = ZZB_APS_ADDR_GROUP,
		.dst_addr = 0x1234,
	};

	receive(MGMT_BIND_REQ, NODE_ADDR, req, sizeof(req));
	check_response(0, MGMT_BIND_REQ | 0x8000, rsp, sizeof(rsp));
}

ZTEST(zzb_zdo_mgmt, test_mgmt_bind_pages)
{
	static const uint8_t req[] = {0x43, 0x00};

	receive(MGMT_BIND_REQ, NODE_ADDR, req, sizeof(req));
	check_response(0, MGMT_BIND_REQ | 0x8000, (uint8_t[]){0x43, 0x00, 0x00, 0x00, 0x00}, 5);

	for (int i = 0; i < 4; i++) {
		node->aps.aib.bindings[i] = (struct zzb_aps_binding){
			.in_use = true,
			.src_ep = 0x01,
			.cluster = i,
			.dst_mode = ZZB_APS_ADDR_EXT,
		};
	}

	receive(MGMT_BIND_REQ, NODE_ADDR, req, sizeof(req));
	zassert_equal(sent[1].len, 5 + 3 * 21);
	zassert_mem_equal(sent[1].data, ((uint8_t[]){0x43, 0x00, 0x04, 0x00, 0x03}), 5);
}

/* An end device does not permit joining (R22 3.2.2.7.3) */
ZTEST(zzb_zdo_mgmt, test_mgmt_permit_joining)
{
	static const uint8_t req[] = {0x44, 0xfe, 0x01};

	receive(MGMT_PERMIT_JOINING_REQ, NODE_ADDR, req, sizeof(req));
	check_response(0, MGMT_PERMIT_JOINING_REQ | 0x8000, (uint8_t[]){0x44, 0xc2}, 2);

	receive(MGMT_PERMIT_JOINING_REQ, 0xfffc, req, sizeof(req));
	zassert_equal(zzb_apsde_data_req_fake.call_count, 1);
}

/* R22 2.4.3.3.5: the response goes out before the node leaves */
ZTEST(zzb_zdo_mgmt, test_mgmt_leave)
{
	uint8_t req[] = {0x45, 0x04, 0x03, 0x02, 0x01, 0x00, 0x4b, 0x12, 0x00, 0x80};

	receive(MGMT_LEAVE_REQ, NODE_ADDR, req, sizeof(req));
	zassert_equal(zzb_apsde_data_req_fake.call_count, 1);
	zassert_equal(sent[0].req.cluster, MGMT_LEAVE_REQ | 0x8000);
	zassert_equal(sent[0].handle, 0xfe);
	zassert_equal(sent[0].len, 2);
	zassert_mem_equal(sent[0].data, ((uint8_t[]){0x45, 0x00}), 2);
	zassert_equal(zzb_bdb_leave_fake.call_count, 0);

	/* The rejoin flag of the request, as in R23 */
	zzb_apsde_data_conf(node, 0xff, ZZB_APS_STATUS_SUCCESS);
	zzb_apsde_data_conf(node, 0xfe, ZZB_APS_STATUS_NO_ACK);
	zassert_equal(zzb_bdb_leave_fake.call_count, 1);
	zassert_true(zzb_bdb_leave_fake.arg1_val);
	zassert_true(node->zdo.leave_rejoin);
	zzb_apsde_data_conf(node, 0xfe, ZZB_APS_STATUS_SUCCESS);
	zassert_equal(zzb_bdb_leave_fake.call_count, 1);

	/* The address 0 means the node; a response that cannot be sent does not stop the leave */
	memset(req + 1, 0, 9);
	zzb_apsde_data_req_fake.custom_fake = NULL;
	zzb_apsde_data_req_fake.return_val = -ENOBUFS;
	receive(MGMT_LEAVE_REQ, NODE_ADDR, req, sizeof(req));
	zassert_equal(zzb_bdb_leave_fake.call_count, 2);
	zassert_false(zzb_bdb_leave_fake.arg1_val);
}

ZTEST(zzb_zdo_mgmt, test_mgmt_leave_of_another_device)
{
	static const uint8_t req[] = {0x46, 1, 2, 3, 4, 5, 6, 7, 8, 0x00};

	receive(MGMT_LEAVE_REQ, 0xfffd, req, sizeof(req));
	zassert_equal(zzb_apsde_data_req_fake.call_count, 0);

	receive(MGMT_LEAVE_REQ, NODE_ADDR, req, sizeof(req));
	check_response(0, MGMT_LEAVE_REQ | 0x8000, (uint8_t[]){0x46, 0xc8}, 2);
	zassert_equal(zzb_bdb_leave_fake.call_count, 0);
}

/* R22 Annex E: the node switches after nwkNetworkBroadcastDeliveryTime, 9 s */
ZTEST(zzb_zdo_mgmt, test_channel_change)
{
	/* Channel 15, scan duration 0xfe, nwkUpdateId 7 */
	uint8_t req[] = {0x47, 0x00, 0x80, 0x00, 0x00, 0xfe, 0x07};

	receive(MGMT_NWK_UPDATE_REQ, 0xfffd, req, sizeof(req));
	k_sleep(K_MSEC(8900));
	zassert_equal(zzb_nlme_set_channel_fake.call_count, 0);
	k_sleep(K_MSEC(200));
	zassert_equal(zzb_nlme_set_channel_fake.call_count, 1);
	zassert_equal(zzb_nlme_set_channel_fake.arg1_val, 15);
	/* Copied from the request, as in R23 Annex E */
	zassert_equal(zzb_nlme_set_channel_fake.arg2_val, 7);

	/* A new request replaces the pending one: channel 26 */
	receive(MGMT_NWK_UPDATE_REQ, 0xfffd, req, sizeof(req));
	k_sleep(K_MSEC(5000));
	req[2] = 0x00;
	req[4] = 0x04;
	req[6] = 0x08;
	receive(MGMT_NWK_UPDATE_REQ, NODE_ADDR, req, sizeof(req));
	k_sleep(K_MSEC(9100));
	zassert_equal(zzb_nlme_set_channel_fake.call_count, 2);
	zassert_equal(zzb_nlme_set_channel_fake.arg1_val, 26);
	zassert_equal(zzb_nlme_set_channel_fake.arg2_val, 8);

	zassert_equal(zzb_apsde_data_req_fake.call_count, 0);
}

/* R22 2.4.3.3.9: errors answer only a unicast request */
ZTEST(zzb_zdo_mgmt, test_rejected_mgmt_nwk_update)
{
	/* Channels 15 and 16 */
	uint8_t req[] = {0x48, 0x00, 0x80, 0x01, 0x00, 0xfe, 0x07};
	/* Scan duration 0xff with nwkUpdateId and nwkManagerAddr */
	static const uint8_t manager[] = {0x48, 0x00, 0x80, 0x00, 0x00, 0xff, 0x07, 0x00, 0x00};

	receive(MGMT_NWK_UPDATE_REQ, 0xfffd, req, sizeof(req));
	zassert_equal(zzb_apsde_data_req_fake.call_count, 0);
	receive(MGMT_NWK_UPDATE_REQ, NODE_ADDR, req, sizeof(req));
	check_response(0, MGMT_NWK_UPDATE_REQ | 0x8000, (uint8_t[]){0x48, 0xc2}, 2);

	/* Channel page 1 */
	req[2] = 0x00;
	req[3] = 0x00;
	req[4] = 0x08;
	receive(MGMT_NWK_UPDATE_REQ, NODE_ADDR, req, sizeof(req));
	check_response(1, MGMT_NWK_UPDATE_REQ | 0x8000, (uint8_t[]){0x48, 0xc2}, 2);

	/* The MAC has no energy scan */
	req[5] = 0x03;
	req[6] = 0x01;
	receive(MGMT_NWK_UPDATE_REQ, 0xfffd, req, sizeof(req));
	receive(MGMT_NWK_UPDATE_REQ, NODE_ADDR, req, sizeof(req));
	check_response(2, MGMT_NWK_UPDATE_REQ | 0x8000, (uint8_t[]){0x48, 0x84}, 2);

	req[5] = 0x06;
	receive(MGMT_NWK_UPDATE_REQ, NODE_ADDR, req, sizeof(req));
	check_response(3, MGMT_NWK_UPDATE_REQ | 0x8000, (uint8_t[]){0x48, 0xc2}, 2);

	/* apsChannelMaskList and nwkManagerAddr are not kept */
	receive(MGMT_NWK_UPDATE_REQ, NODE_ADDR, manager, sizeof(manager));
	zassert_equal(zzb_apsde_data_req_fake.call_count, 4);

	k_sleep(K_MSEC(9100));
	zassert_equal(zzb_nlme_set_channel_fake.call_count, 0);
}

ZTEST_SUITE(zzb_zdo_mgmt, NULL, setup, before, after, NULL);
```

## src/server.c
```c
/* SPDX-License-Identifier: Apache-2.0 */

#include <errno.h>
#include <zephyr/ztest.h>

#include "fakes.h"

#define NWK_ADDR_REQ  0x0000
#define IEEE_ADDR_REQ 0x0001
#define DEVICE_ANNCE  0x0013
#define BIND_REQ      0x0021
#define UNBIND_REQ    0x0022

/* EUI-64 and network address of the node, little-endian */
#define NODE_EUI64_LE 0x04, 0x03, 0x02, 0x01, 0x00, 0x4b, 0x12, 0x00
#define NODE_ADDR_LE  0x78, 0x56

static void *setup(void)
{
	test_node();
	return NULL;
}

static void before(void *fixture)
{
	reset_fakes();
}

static void after(void *fixture)
{
	check_no_buffer_leak();
}

/* R22 2.4.3.1.1; an end device has no associated devices (R22 Table 2-92) */
ZTEST(zzb_zdo_server, test_nwk_addr_req)
{
	uint8_t req[] = {0x10, NODE_EUI64_LE, 0x00, 0x00};
	static const uint8_t rsp[] = {0x10, 0x00, NODE_EUI64_LE, NODE_ADDR_LE, 0x00};
	static const uint8_t inv[] = {0x10, 0x80, NODE_EUI64_LE, NODE_ADDR_LE};

	receive(NWK_ADDR_REQ, 0xfffd, req, sizeof(req));
	check_response(0, NWK_ADDR_REQ | 0x8000, rsp, sizeof(rsp) - 1);

	req[9] = 0x01;
	receive(NWK_ADDR_REQ, NODE_ADDR, req, sizeof(req));
	check_response(1, NWK_ADDR_REQ | 0x8000, rsp, sizeof(rsp));

	/* Reserved request type */
	req[9] = 0x02;
	receive(NWK_ADDR_REQ, 0xfffd, req, sizeof(req));
	zassert_equal(zzb_apsde_data_req_fake.call_count, 2);
	receive(NWK_ADDR_REQ, NODE_ADDR, req, sizeof(req));
	check_response(2, NWK_ADDR_REQ | 0x8000, inv, sizeof(inv));

	receive(NWK_ADDR_REQ, NODE_ADDR, req, sizeof(req) - 1);
	zassert_equal(zzb_apsde_data_req_fake.call_count, 3);
}

ZTEST(zzb_zdo_server, test_nwk_addr_req_for_another_device)
{
	static const uint8_t req[] = {0x11, 1, 2, 3, 4, 5, 6, 7, 8, 0x00, 0x00};
	static const uint8_t rsp[] = {0x11, 0x81, 1, 2, 3, 4, 5, 6, 7, 8, 0xff, 0xff};

	receive(NWK_ADDR_REQ, 0xfffd, req, sizeof(req));
	zassert_equal(zzb_apsde_data_req_fake.call_count, 0);

	receive(NWK_ADDR_REQ, NODE_ADDR, req, sizeof(req));
	check_response(0, NWK_ADDR_REQ | 0x8000, rsp, sizeof(rsp));
}

/* R22 2.4.3.1.2 */
ZTEST(zzb_zdo_server, test_ieee_addr_req)
{
	uint8_t req[] = {0x12, NODE_ADDR_LE, 0x00, 0x00};
	static const uint8_t rsp[] = {0x12, 0x00, NODE_EUI64_LE, NODE_ADDR_LE};
	static const uint8_t not_found[] = {0x12, 0x81, 0xff, 0xff, 0xff, 0xff,
					    0xff, 0xff, 0xff, 0xff, 0x34, 0x12};

	receive(IEEE_ADDR_REQ, NODE_ADDR, req, sizeof(req));
	check_response(0, IEEE_ADDR_REQ | 0x8000, rsp, sizeof(rsp));

	req[1] = 0x34;
	req[2] = 0x12;
	receive(IEEE_ADDR_REQ, 0xfffd, req, sizeof(req));
	zassert_equal(zzb_apsde_data_req_fake.call_count, 1);
	receive(IEEE_ADDR_REQ, 0x1234, req, sizeof(req));
	check_response(1, IEEE_ADDR_REQ | 0x8000, not_found, sizeof(not_found));
}

static int no_room(struct zzb_node *node, const struct zzb_aps_binding *arg)
{
	return -ENOMEM;
}

/* R22 2.4.3.2.2: ZHA binds clusters of the device to the coordinator */
ZTEST(zzb_zdo_server, test_bind_req)
{
	static const uint8_t req[] = {
		0x30, NODE_EUI64_LE, 0x01, 0x06, 0x00, 0x03, 1, 2, 3, 4, 5, 6, 7, 8, 0x02};

	receive(BIND_REQ, NODE_ADDR, req, sizeof(req));
	check_response(0, BIND_REQ | 0x8000, (uint8_t[]){0x30, 0x00}, 2);
	zassert_equal(binding.src_ep, 0x01);
	zassert_equal(binding.cluster, 0x0006);
	zassert_equal(binding.dst_mode, ZZB_APS_ADDR_EXT);
	zassert_equal(binding.dst_ext, 0x0807060504030201ULL);
	zassert_equal(binding.dst_ep, 0x02);

	zzb_apsme_bind_req_fake.custom_fake = no_room;
	receive(BIND_REQ, NODE_ADDR, req, sizeof(req));
	check_response(1, BIND_REQ | 0x8000, (uint8_t[]){0x30, 0x8c}, 2);

	receive(BIND_REQ, 0xfffd, req, sizeof(req));
	receive(BIND_REQ, NODE_ADDR, req, sizeof(req) - 1);
	zassert_equal(zzb_apsde_data_req_fake.call_count, 2);
}

ZTEST(zzb_zdo_server, test_unbind_req)
{
	static const uint8_t req[] = {0x31, NODE_EUI64_LE, 0x01, 0x06, 0x00, 0x01, 0x34, 0x12};

	receive(UNBIND_REQ, NODE_ADDR, req, sizeof(req));
	check_response(0, UNBIND_REQ | 0x8000, (uint8_t[]){0x31, 0x00}, 2);
	zassert_equal(binding.dst_mode, ZZB_APS_ADDR_GROUP);
	zassert_equal(binding.dst_addr, 0x1234);

	zzb_apsme_unbind_req_fake.custom_fake = NULL;
	zzb_apsme_unbind_req_fake.return_val = -ENOENT;
	receive(UNBIND_REQ, NODE_ADDR, req, sizeof(req));
	check_response(1, UNBIND_REQ | 0x8000, (uint8_t[]){0x31, 0x88}, 2);
}

/* R22 2.4.4.3.2: the binding table holds bindings of the node */
ZTEST(zzb_zdo_server, test_rejected_bind_req)
{
	uint8_t req[] = {0x32, NODE_EUI64_LE, 0x01, 0x06, 0x00, 0x01, 0x34, 0x12};

	req[1] = 0x05;
	receive(BIND_REQ, NODE_ADDR, req, sizeof(req));
	check_response(0, BIND_REQ | 0x8000, (uint8_t[]){0x32, 0x84}, 2);

	req[1] = 0x04;
	req[9] = 0x00;
	receive(BIND_REQ, NODE_ADDR, req, sizeof(req));
	check_response(1, BIND_REQ | 0x8000, (uint8_t[]){0x32, 0x82}, 2);

	req[9] = 0x01;
	req[12] = ZZB_APS_ADDR_SHORT;
	receive(BIND_REQ, NODE_ADDR, req, sizeof(req));
	check_response(2, BIND_REQ | 0x8000, (uint8_t[]){0x32, 0x84}, 2);
	zassert_equal(zzb_apsme_bind_req_fake.call_count, 0);
}

/* R22 2.5.4.5.5: Device_annce updates the nwkAddressMap entry of a known IEEE address */
ZTEST(zzb_zdo_server, test_device_annce)
{
	static const uint8_t annce[] = {0x46, 0x22, 0x44, 1, 2, 3, 4, 5, 6, 7, 8, 0x80};

	receive(DEVICE_ANNCE, 0xfffd, annce, sizeof(annce));
	zassert_equal(zzb_nlme_set_addr_map_fake.call_count, 0);

	zzb_nwk_addr_map_find_fake.return_val = 0;
	receive(DEVICE_ANNCE, 0xfffd, annce, sizeof(annce));
	zassert_equal(zzb_nlme_set_addr_map_fake.call_count, 1);
	zassert_equal(zzb_nlme_set_addr_map_fake.arg1_val, 0x0807060504030201ULL);
	zassert_equal(zzb_nlme_set_addr_map_fake.arg2_val, 0x4422);

	/* Without the capability octet */
	receive(DEVICE_ANNCE, 0xfffd, annce, sizeof(annce) - 1);
	zassert_equal(zzb_nlme_set_addr_map_fake.call_count, 1);
	zassert_equal(zzb_apsde_data_req_fake.call_count, 0);
}

ZTEST_SUITE(zzb_zdo_server, NULL, setup, before, after, NULL);
```

## src/zdo.c
```c
/* SPDX-License-Identifier: Apache-2.0 */

#include <errno.h>
#include <zephyr/ztest.h>

#include "fakes.h"

#define MGMT_RTG_REQ 0x0032
#define DEVICE_ANNCE 0x0013
#define PARENT_ANNCE 0x001f
#define TC_EUI64     0x00124b0000000001ULL

static const uint8_t key[ZZB_SEC_KEY_LEN] = {0x01, 0x02, 0x03};

static void *setup(void)
{
	test_node();
	return NULL;
}

static void before(void *fixture)
{
	reset_fakes();
}

static void after(void *fixture)
{
	check_no_buffer_leak();
}

/* R22 2.4.4.1: the response holds the TSN and the status */
ZTEST(zzb_zdo, test_unsupported_request)
{
	static const uint8_t req[] = {0x42, 0x00};
	static const uint8_t rsp[] = {0x42, 0x84};

	receive(MGMT_RTG_REQ, NODE_ADDR, req, sizeof(req));
	zassert_equal(zzb_apsde_data_req_fake.call_count, 1);
	check_response(0, MGMT_RTG_REQ | 0x8000, rsp, sizeof(rsp));

	/* No error status answers a broadcast */
	receive(MGMT_RTG_REQ, 0xfffd, req, sizeof(req));
	zassert_equal(zzb_apsde_data_req_fake.call_count, 1);
}

ZTEST(zzb_zdo, test_dropped_frames)
{
	static const uint8_t req[] = {0x43, 0x00};
	struct zzb_apsde_ind ind = {
		.dst_addr = NODE_ADDR,
		.dst_ep = 0x01,
		.src_addr = REQUESTER_ADDR,
		.cluster = MGMT_RTG_REQ,
	};

	/* An application endpoint goes to ZCL */
	receive_ind(&ind, req, sizeof(req));
	zassert_equal(zzb_zcl_data_ind_fake.call_count, 1);
	zassert_equal(zzb_zcl_data_ind_fake.arg2_val->dst_ep, 0x01);

	/* A group frame has destination endpoint 0 in the indication */
	ind.dst_ep = 0x00;
	ind.profile = 0x0104;
	ind.group = true;
	receive_ind(&ind, req, sizeof(req));
	zassert_equal(zzb_zcl_data_ind_fake.call_count, 2);

	/* A ZDO endpoint frame of another profile */
	ind.group = false;
	receive_ind(&ind, req, sizeof(req));
	zassert_equal(zzb_zcl_data_ind_fake.call_count, 2);

	/* Without a TSN */
	receive(MGMT_RTG_REQ, NODE_ADDR, req, 0);

	/* A response without a transaction */
	receive(MGMT_RTG_REQ | 0x8000, NODE_ADDR, req, sizeof(req));

	/* Announcements get no response (R22 2.4.3.1.11, 2.4.3.1.12) */
	receive(DEVICE_ANNCE, NODE_ADDR,
		(uint8_t[]){0x44, 0x34, 0x12, 1, 2, 3, 4, 5, 6, 7, 8, 0x80}, 12);
	receive(PARENT_ANNCE, NODE_ADDR, (uint8_t[]){0x45, 0x00}, 2);

	zassert_equal(zzb_apsde_data_req_fake.call_count, 0);
}

/* The network key reaches NLME-SET through ZDO (section 5) */
ZTEST(zzb_zdo, test_network_key)
{
	zzb_apsme_transport_key_ind(test_node(), TC_EUI64, ZZB_APS_KEY_NWK, key, 3);
	zassert_equal(zzb_apsme_set_tc_addr_fake.call_count, 1);
	zassert_equal(zzb_apsme_set_tc_addr_fake.arg1_val, TC_EUI64);
	zassert_equal(set_nwk_key.count, 1);
	zassert_equal_ptr(set_nwk_key.key, key);
	zassert_equal(set_nwk_key.seq, 3);
	zassert_equal(zzb_bdb_nwk_key_ind_fake.call_count, 1);

	/* Without a key-pair entry for the trust center the key stays unset */
	zzb_apsme_set_tc_addr_fake.return_val = -ENOMEM;
	zzb_apsme_transport_key_ind(test_node(), TC_EUI64, ZZB_APS_KEY_NWK, key, 4);
	zassert_equal(set_nwk_key.count, 1);
	zassert_equal(zzb_bdb_nwk_key_ind_fake.call_count, 1);
}

/* BDB decides about a trust center link key (BDB 10.2.6) */
ZTEST(zzb_zdo, test_trust_center_link_key_goes_to_bdb)
{
	zzb_apsme_transport_key_ind(test_node(), TC_EUI64, ZZB_APS_KEY_TC_LINK, key, 0);
	zassert_equal(zzb_bdb_tc_link_key_ind_fake.call_count, 1);
	zassert_equal(zzb_bdb_tc_link_key_ind_fake.arg1_val, TC_EUI64);
	zassert_equal_ptr(zzb_bdb_tc_link_key_ind_fake.arg2_val, key);
	zassert_equal(zzb_apsme_set_tc_addr_fake.call_count, 0);
	zassert_equal(set_nwk_key.count, 0);
	zassert_equal(zzb_bdb_nwk_key_ind_fake.call_count, 0);
}

ZTEST(zzb_zdo, test_switch_key)
{
	zzb_apsme_switch_key_ind(test_node(), TC_EUI64, 3);
	zassert_equal(zzb_nlme_set_active_key_fake.call_count, 1);
	zassert_equal(zzb_nlme_set_active_key_fake.arg1_val, 3);
}

ZTEST_SUITE(zzb_zdo, NULL, setup, before, after, NULL);
```
