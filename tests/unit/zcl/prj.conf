## CMakeLists.txt
```
# SPDX-License-Identifier: Apache-2.0

cmake_minimum_required(VERSION 3.20.0)

find_package(Zephyr REQUIRED HINTS $ENV{ZEPHYR_BASE})
project(zzb_unit_zcl)

target_include_directories(app PRIVATE ${ZEPHYR_ZZB_MODULE_DIR}/subsys/zzb)
target_sources(app PRIVATE
  src/alarms.c
  src/appliances.c
  src/attr.c
  src/ballast.c
  src/basic.c
  src/binary_input.c
  src/client.c
  src/color.c
  src/device_temp.c
  src/door_lock.c
  src/fakes.c
  src/foundation.c
  src/frame.c
  src/groups.c
  src/hvac.c
  src/ias_ace.c
  src/ias_wd.c
  src/ias_zone.c
  src/identify.c
  src/level.c
  src/metering.c
  src/on_off.c
  src/ota.c
  src/ota_file.c
  src/poll_control.c
  src/power_config.c
  src/power_profile.c
  src/report.c
  src/scenes.c
  src/schedule.c
  src/sensors.c
  src/thermostat.c
  src/time.c
  src/window_covering.c
  src/zcl.c
)

include(${ZEPHYR_ZZB_MODULE_DIR}/tests/common/ota_file.cmake)
set(gen_dir ${ZEPHYR_BINARY_DIR}/include/generated)
set(image ${ZEPHYR_ZZB_MODULE_DIR}/tests/common/mcuboot_image.bin)
generate_inc_file_for_target(app ${image} ${gen_dir}/mcuboot_image.bin.inc)
zzb_ota_file(${image} 0x1234 0x0042 0x01020400 ${gen_dir}/mcuboot_image.zigbee.inc
  ${ZEPHYR_ZZB_MODULE_DIR}/tests/common/ota_index.json ${gen_dir}/ota_index.json.inc)
```

## prj.conf
```kconfig
# SPDX-License-Identifier: Apache-2.0

CONFIG_ZTEST=y
CONFIG_ZZB=y
# BDB, ZDO, APS and NWK are faked
CONFIG_ZZB_ZCL=y
CONFIG_ZZB_ZCL_REPORT_COUNT=4
CONFIG_ZZB_ZCL_SCENE_COUNT=4
CONFIG_ZZB_ZCL_ALARM_COUNT=4
CONFIG_FLASH=y
CONFIG_FLASH_MAP=y
CONFIG_NVS=y
# Every run starts with erased flash
CONFIG_NATIVE_EXTRA_CMDLINE_ARGS="--flash_in_ram"
# The Time, Poll Control and OTA Upgrade tests have a node of their own each
CONFIG_ZZB_NODE_COUNT=4
# The OTA Upgrade client writes the upload slot of the flash simulator without a bootloader
CONFIG_STREAM_FLASH=y
CONFIG_IMG_MANAGER=y
CONFIG_ZZB_ZCL_OTA=y
```

## src/alarms.c
```c
/* SPDX-License-Identifier: Apache-2.0 */

#include <errno.h>
#include <string.h>
#include <zephyr/settings/settings.h>
#include <zephyr/ztest.h>
#include <zzb/zcl/alarms.h>

#include "common/node.h"
#include "fakes.h"
#include "zcl/zcl.h"

static void *setup(void)
{
	test_node();
	return NULL;
}

static void before(void *fixture)
{
	reset_node();
	reset_fakes();
}

static void after(void *fixture)
{
	check_no_buffer_leak();
}

static uint8_t tsn;

/* Sends the Alarms command id with the payload to ep and checks its Default Response */
static void command(uint8_t ep, uint8_t id, const uint8_t *payload, size_t len, uint8_t status)
{
	int frames = zzb_apsde_data_req_fake.call_count;
	uint8_t frame[8] = {0x01, ++tsn, id};
	const uint8_t expected[] = {0x18, tsn, 0x0b, id, status};

	memcpy(frame + 3, payload, len);
	receive_ep(ep, ZZB_ZCL_ALARMS, frame, 3 + len);
	check_frame(frames, ep, ZZB_ZCL_ALARMS, expected, sizeof(expected));
}

/* Sends Get Alarm to ep and checks that its response has the payload rsp */
static void get_alarm_rsp(uint8_t ep, const uint8_t *rsp, size_t len)
{
	int frames = zzb_apsde_data_req_fake.call_count;
	const uint8_t req[] = {0x01, ++tsn, ZZB_ZCL_ALARMS_GET_ALARM};
	uint8_t expected[16] = {0x19, tsn, ZZB_ZCL_ALARMS_GET_ALARM_RSP};

	memcpy(expected + 3, rsp, len);
	receive_ep(ep, ZZB_ZCL_ALARMS, req, sizeof(req));
	check_frame(frames, ep, ZZB_ZCL_ALARMS, expected, 3 + len);
}

/* ZCL 3.11.2.5.2: the alarm code of cluster 0x0001 and no time stamp */
static void get_alarm(uint8_t ep, uint8_t code)
{
	get_alarm_rsp(ep, (uint8_t[]){0x00, code, 0x01, 0x00, 0xff, 0xff, 0xff, 0xff}, 8);
}

static void get_no_alarm(uint8_t ep)
{
	get_alarm_rsp(ep, (uint8_t[]){ZZB_ZCL_NOT_FOUND}, 1);
}

/* Enters alarm code of cluster 0x0001 into the table without sending Alarm or calling zcl_cb */
static void alarm(uint8_t ep, uint8_t code)
{
	zzb_zcl_alarm_raise(test_node(), ep, 0x0001, code, false, false);
}

/* ZCL 3.11.2.2.1: AlarmCount is a uint16; ClusterRevision 1 */
ZTEST(zzb_zcl_alarms, test_attributes)
{
	static const uint8_t req[] = {0x00, 0x90, 0x00, 0x00, 0x00, 0xfd, 0xff};
	static const uint8_t rsp[] = {0x18, 0x90, 0x01, 0x00, 0x00, 0x00, 0x21, 0x02,
				      0x00, 0xfd, 0xff, 0x00, 0x21, 0x01, 0x00};

	alarm(20, 0x10);
	alarm(20, 0x11);
	receive_ep(20, ZZB_ZCL_ALARMS, req, sizeof(req));
	check_frame(0, 20, ZZB_ZCL_ALARMS, rsp, sizeof(rsp));
}

/* ZCL 3.11.2.4.3: Get Alarm reports the earliest entry of the endpoint and removes it */
ZTEST(zzb_zcl_alarms, test_get_alarm)
{
	alarm(20, 0x10);
	alarm(21, 0x20);
	alarm(20, 0x11);
	zassert_equal(alarms20.alarm_count, 2);
	zassert_equal(alarms21.alarm_count, 1);
	zassert_equal(zcl_cb_calls.count, 0);

	get_alarm(20, 0x10);
	zassert_equal(alarms20.alarm_count, 1);
	zassert_equal(zcl_cb_calls.count, 1);
	zassert_equal(zcl_cb_calls.ep[0], 20);
	zassert_equal(zcl_cb_calls.cluster[0], ZZB_ZCL_ALARMS);
	zassert_equal(zcl_cb_calls.attr[0], ZZB_ZCL_ALARMS_ALARM_COUNT);
	get_alarm(20, 0x11);
	get_no_alarm(20);
	zassert_equal(alarms20.alarm_count, 0);
	zassert_equal(alarms21.alarm_count, 1);
}

/* Get Alarm Response also answers a broadcast */
ZTEST(zzb_zcl_alarms, test_get_alarm_broadcast)
{
	const struct zzb_apsde_ind ind = {
		.dst_addr = 0xfffd,
		.dst_ep = 20,
		.src_addr = REQUESTER_ADDR,
		.src_ep = REQUESTER_EP,
		.profile = 0x0104,
		.cluster = ZZB_ZCL_ALARMS,
	};
	static const uint8_t req[] = {0x01, 0x91, 0x02};
	static const uint8_t rsp[] = {0x19, 0x91, 0x01, 0x00, 0x10, 0x01,
				      0x00, 0xff, 0xff, 0xff, 0xff};

	alarm(20, 0x10);
	receive_ind(&ind, req, sizeof(req));
	check_frame(0, 20, ZZB_ZCL_ALARMS, rsp, sizeof(rsp));
}

/* ZCL 3.11.2.3: a full table replaces its earliest entry, also of another endpoint */
ZTEST(zzb_zcl_alarms, test_full_table)
{
	alarm(21, 0x20);
	for (int i = 0; i < CONFIG_ZZB_ZCL_ALARM_COUNT; i++) {
		alarm(20, 0x10 + i);
	}

	zassert_equal(alarms20.alarm_count, CONFIG_ZZB_ZCL_ALARM_COUNT);
	zassert_equal(alarms21.alarm_count, 0);
	get_no_alarm(21);
	get_alarm(20, 0x10);

	alarm(21, 0x21);
	alarm(21, 0x22);
	zassert_equal(alarms20.alarm_count, 2);
	get_alarm(20, 0x12);
	get_alarm(21, 0x21);
}

/* ZCL 3.11.2.4.4: Reset Alarm Log clears the entries of the endpoint */
ZTEST(zzb_zcl_alarms, test_reset_alarm_log)
{
	alarm(20, 0x10);
	alarm(20, 0x11);
	alarm(21, 0x20);
	command(20, ZZB_ZCL_ALARMS_RESET_ALARM_LOG, NULL, 0, ZZB_ZCL_SUCCESS);
	zassert_equal(alarms20.alarm_count, 0);
	zassert_equal(zcl_cb_calls.count, 1);
	get_no_alarm(20);
	get_alarm(21, 0x20);
}

/* ZCL 3.11.2.5.1: an alarm of the application goes as Alarm to the bound destinations */
ZTEST(zzb_zcl_alarms, test_alarm_command)
{
	uint8_t tsn = test_node()->zcl.tsn;

	zassert_ok(zzb_zcl_alarm(test_node(), 20, 0x0001, 0x3a));
	zassert_equal(zzb_apsde_data_req_fake.call_count, 1);
	zassert_equal(sent[0].req.dst_mode, ZZB_APS_ADDR_BINDING);
	zassert_equal(sent[0].req.src_ep, 20);
	zassert_equal(sent[0].req.profile, 0x0104);
	zassert_equal(sent[0].req.cluster, ZZB_ZCL_ALARMS);
	zassert_equal(sent[0].req.tx_options, ZZB_APS_TX_ACK);
	zassert_equal(sent[0].len, 6);
	zassert_mem_equal(sent[0].data, ((uint8_t[]){0x19, tsn, 0x00, 0x3a, 0x01, 0x00}), 6);
	zassert_equal(alarms20.alarm_count, 1);

	/* Without a binding the alarm stays in the table */
	zzb_apsde_data_req_fake.custom_fake = NULL;
	zzb_apsde_data_req_fake.return_val = -ENOENT;
	zassert_ok(zzb_zcl_alarm(test_node(), 20, 0x0001, 0x3b));
	zassert_equal(alarms20.alarm_count, 2);
}

/* ZCL 3.11.1: an alarm that its mask disables enters the table without Alarm */
ZTEST(zzb_zcl_alarms, test_masked_alarm)
{
	zzb_zcl_alarm_raise(test_node(), 20, 0x0001, 0x10, false, true);
	zassert_equal(zzb_apsde_data_req_fake.call_count, 0);
	zassert_equal(alarms20.alarm_count, 1);
	zassert_equal(zcl_cb_calls.count, 1);
}

ZTEST(zzb_zcl_alarms, test_alarm_without_server)
{
	zassert_equal(zzb_zcl_alarm(test_node(), 1, 0x0001, 0x10), -ENOENT);
	zassert_equal(zzb_zcl_alarm(test_node(), 9, 0x0001, 0x10), -ENOENT);
}

/* The reset of the node clears the table */
ZTEST(zzb_zcl_alarms, test_reset)
{
	alarm(20, 0x10);
	alarm(21, 0x20);
	reset_node();
	zassert_equal(alarms20.alarm_count, 0);
	zassert_equal(alarms21.alarm_count, 0);
	zassert_equal(zcl_cb_calls.count, 2);
	get_no_alarm(20);
	get_no_alarm(21);
}

/* ZCL 3.11.2.4.1: Reset Alarm calls the alarm_reset hook of the server of its cluster */
ZTEST(zzb_zcl_alarms, test_reset_alarm)
{
	command(20, ZZB_ZCL_ALARMS_RESET_ALARM, (uint8_t[]){0x05, 0x02, 0x0f}, 3, ZZB_ZCL_SUCCESS);
	zassert_equal(alarm_reset_calls.count, 1);
	zassert_equal(alarm_reset_calls.ep, 20);
	zassert_equal_ptr(alarm_reset_calls.values, &values20);
	zassert_equal(alarm_reset_calls.code, 0x05);

	/* A cluster that the endpoint does not have, and a truncated command */
	command(21, ZZB_ZCL_ALARMS_RESET_ALARM, (uint8_t[]){0x05, 0x02, 0x0f}, 3, ZZB_ZCL_SUCCESS);
	command(20, ZZB_ZCL_ALARMS_RESET_ALARM, (uint8_t[]){0x05, 0x02}, 2,
		ZZB_ZCL_MALFORMED_COMMAND);
	zassert_equal(alarm_reset_calls.count, 1);
}

/* ZCL 3.11.2.4.2: Reset All Alarms calls the hook of every server on the endpoint with 0xff */
ZTEST(zzb_zcl_alarms, test_reset_all_alarms)
{
	command(20, ZZB_ZCL_ALARMS_RESET_ALL_ALARMS, NULL, 0, ZZB_ZCL_SUCCESS);
	zassert_equal(alarm_reset_calls.count, 1);
	zassert_equal(alarm_reset_calls.ep, 20);
	zassert_equal(alarm_reset_calls.code, 0xff);

	command(21, ZZB_ZCL_ALARMS_RESET_ALL_ALARMS, NULL, 0, ZZB_ZCL_SUCCESS);
	zassert_equal(alarm_reset_calls.count, 1);
}

/* The table survives a reboot, and new alarms follow the loaded ones; loading calls no zcl_cb */
ZTEST(zzb_zcl_alarms, test_table_survives_a_reboot)
{
	alarm(20, 0x10);
	alarm(21, 0x20);
	alarm(20, 0x11);
	get_alarm(20, 0x10);
	command(21, ZZB_ZCL_ALARMS_RESET_ALARM_LOG, NULL, 0, ZZB_ZCL_SUCCESS);
	zcl_cb_calls.count = 0;
	zassert_ok(reboot());

	zassert_equal(alarms20.alarm_count, 1);
	zassert_equal(alarms21.alarm_count, 0);
	zassert_equal(zcl_cb_calls.count, 0);
	alarm(20, 0x12);
	get_alarm(20, 0x11);
	get_alarm(20, 0x12);

	alarm(20, 0x13);
	reset_node();
	zassert_ok(reboot());
	zassert_equal(alarms20.alarm_count, 0);
}

/* ZCL Table 3-66: the time stamp is the UTC time of the clock of the node; it is saved */
ZTEST(zzb_zcl_alarms, test_time_stamp)
{
	static const uint8_t rsp[] = {0x00, 0x10, 0x01, 0x00, 0x78, 0x56, 0x34, 0x12};
	uint8_t rec[16];

	zzb_zcl_clock_set(test_node(), 0x12345678, 3600);
	alarm(20, 0x10);
	zassert_equal(settings_load_one("zzb/0/zcl/alarm/0", rec, sizeof(rec)), 13);
	zassert_ok(reboot());
	get_alarm_rsp(20, rsp, sizeof(rsp));
}

ZTEST(zzb_zcl_alarms, test_bad_records)
{
	/* Sequence number 5, endpoint 20, alarm code 0x10 of cluster 0x0001 */
	uint8_t rec[] = {2, 5, 0, 0, 0, 20, 0x10, 0x01, 0x00};

	zassert_ok(settings_save_one("zzb/0/zcl/alarm/0", rec, sizeof(rec)));
	zassert_equal(reboot(), -EINVAL);

	rec[0] = 1;
	zassert_ok(settings_save_one("zzb/0/zcl/alarm/0", rec, sizeof(rec) - 1));
	zassert_equal(reboot(), -EINVAL);

	/* A record of an endpoint without an Alarms server, or of an unknown one, is ignored */
	rec[5] = 1;
	zassert_ok(settings_save_one("zzb/0/zcl/alarm/0", rec, sizeof(rec)));
	zassert_ok(reboot());
	zassert_false(test_node()->zcl.alarms[0].in_use);
	rec[5] = 9;
	zassert_ok(settings_save_one("zzb/0/zcl/alarm/0", rec, sizeof(rec)));
	zassert_ok(reboot());
	zassert_false(test_node()->zcl.alarms[0].in_use);

	/* A record of 9 octets from an earlier build has no time stamp */
	rec[5] = 20;
	zassert_ok(settings_save_one("zzb/0/zcl/alarm/0", rec, sizeof(rec)));
	zassert_ok(reboot());
	zassert_equal(alarms20.alarm_count, 1);
	get_alarm(20, 0x10);
}

ZTEST_SUITE(zzb_zcl_alarms, NULL, setup, before, after, NULL);
```

## src/appliances.c
```c
/* SPDX-License-Identifier: Apache-2.0 */

#include <errno.h>
#include <string.h>
#include <zephyr/ztest.h>
#include <zzb/zcl/appliance_control.h>
#include <zzb/zcl/appliance_events.h>
#include <zzb/zcl/appliance_stats.h>

#include "common/node.h"
#include "fakes.h"
#include "zcl/zcl.h"

/* A command with its payload */
struct test_cmd {
	uint8_t id;
	uint8_t len;
	uint8_t payload[32];
};

static void *setup(void)
{
	test_node();
	return NULL;
}

static void before(void *fixture)
{
	reset_fakes();
}

static void after(void *fixture)
{
	check_no_buffer_leak();
}

static uint8_t tsn;

/* Sends c of cluster to the server on endpoint 140 and checks the Default Response */
static void to_server(uint16_t cluster, const struct test_cmd *c, uint8_t status)
{
	const uint8_t rsp[] = {0x18, ++tsn, 0x0b, c->id, status};
	int frames = zzb_apsde_data_req_fake.call_count;
	uint8_t frame[40] = {0x01, tsn, c->id};

	memcpy(frame + 3, c->payload, c->len);
	receive_ep(WHITE_GOODS_EP, cluster, frame, 3 + c->len);
	check_frame(frames, WHITE_GOODS_EP, cluster, rsp, sizeof(rsp));
}

/* Sends the server command c of cluster to the client on endpoint 141 and checks the reply */
static void to_client(uint16_t cluster, const struct test_cmd *c, uint8_t status)
{
	const uint8_t rsp[] = {0x10, ++tsn, 0x0b, c->id, status};
	int frames = zzb_apsde_data_req_fake.call_count;
	uint8_t frame[40] = {0x09, tsn, c->id};

	memcpy(frame + 3, c->payload, c->len);
	receive_ep(GATEWAY_EP, cluster, frame, 3 + c->len);
	check_frame(frames, GATEWAY_EP, cluster, rsp, sizeof(rsp));
}

/*
 * Sends each of the count commands of cluster to the server or the client, and checks that it
 * reaches zcl_cmd_cb as received
 */
static void check_passed(uint16_t cluster, bool server, const struct test_cmd *commands,
			 size_t count)
{
	const struct zzb_zcl_cmd *cmd = &zcl_cmd_calls.cmd[0];

	for (const struct test_cmd *c = commands; c < commands + count; c++) {
		reset_fakes();
		if (server) {
			to_server(cluster, c, ZZB_ZCL_SUCCESS);
		} else {
			to_client(cluster, c, ZZB_ZCL_SUCCESS);
		}

		zassert_equal(zcl_cmd_calls.count, 1);
		zassert_equal(cmd->ep, server ? WHITE_GOODS_EP : GATEWAY_EP);
		zassert_equal(cmd->cluster, cluster);
		zassert_equal(cmd->id, c->id);
		zassert_equal(cmd->server, server);
		zassert_equal(cmd->len, c->len);
		zassert_mem_equal(zcl_cmd_calls.payload[0], c->payload, c->len);
	}
}

/*
 * Sends each of the count commands of cluster to the server or the client, and checks that it gets
 * status without reaching zcl_cmd_cb
 */
static void check_refused(uint16_t cluster, bool server, const struct test_cmd *commands,
			  size_t count, uint8_t status)
{
	for (const struct test_cmd *c = commands; c < commands + count; c++) {
		reset_fakes();
		if (server) {
			to_server(cluster, c, status);
		} else {
			to_client(cluster, c, status);
		}

		zassert_equal(zcl_cmd_calls.count, 0);
	}
}

/*
 * The commands of ZCL 15.2.4 reach zcl_cmd_cb of the Appliance Control server as received:
 * Execution of a Command with START, Signal State, Write Functions of StartTime 14:30 absolute
 * (uint16) and of a function 0x0100 with the character string "eco", Write Functions without
 * records, Overload Pause Resume, Overload Pause, and Overload Warning with its enum8 and with the
 * 2 octets of ZCL Figure 15-5
 */
ZTEST(zzb_zcl_appliances, test_control_server_commands)
{
	static const struct test_cmd commands[] = {
		{0x00, 1, {0x01}},
		{0x01, 0, {0}},
		{0x02, 12, {0x00, 0x00, 0x21, 0x5e, 0x0e, 0x00, 0x01, 0x42, 0x03, 'e', 'c', 'o'}},
		{0x02, 0, {0}},
		{0x03, 0, {0}},
		{0x04, 0, {0}},
		{0x05, 1, {0x01}},
		{0x05, 2, {0x01, 0x00}},
	};

	check_passed(ZZB_ZCL_APPLIANCE_CONTROL, true, commands, ARRAY_SIZE(commands));
}

/*
 * A payload shorter than its fields gives MALFORMED_COMMAND: Execution of a Command and Overload
 * Warning without their field, and Write Functions with a record without its data type, with 1 of
 * the 2 octets of a uint16, with a string shorter than its length, and with an array, whose length
 * the stack does not know. An unknown command gives UNSUP_COMMAND. None reaches zcl_cmd_cb.
 */
ZTEST(zzb_zcl_appliances, test_control_server_malformed)
{
	static const struct test_cmd commands[] = {
		{0x00, 0, {0}},
		{0x05, 0, {0}},
		{0x02, 2, {0x00, 0x00}},
		{0x02, 4, {0x00, 0x00, 0x21, 0x5e}},
		{0x02, 10, {0x00, 0x00, 0x21, 0x5e, 0x0e, 0x00, 0x01, 0x42, 0x03, 'e'}},
		{0x02, 6, {0x00, 0x01, 0x48, 0x20, 0x00, 0x00}},
	};

	check_refused(ZZB_ZCL_APPLIANCE_CONTROL, true, commands, ARRAY_SIZE(commands),
		      ZZB_ZCL_MALFORMED_COMMAND);
	check_refused(ZZB_ZCL_APPLIANCE_CONTROL, true, &(struct test_cmd){0x06}, 1,
		      ZZB_ZCL_UNSUP_COMMAND);
}

/*
 * Signal State Response of a running appliance with remote control enabled, and Signal State
 * Notification of a paused appliance with Appliance Status 2 as IRIS symptom code, reach zcl_cmd_cb
 * of the client as received. Signal State Response with one octet and Signal State Notification
 * without fields give MALFORMED_COMMAND, an unknown command UNSUP_COMMAND.
 */
ZTEST(zzb_zcl_appliances, test_control_client_commands)
{
	static const struct test_cmd commands[] = {
		{0x00, 2, {0x05, 0x0f}},
		{0x01, 5, {0x06, 0x2f, 0x01, 0x02, 0x03}},
	};
	static const struct test_cmd malformed[] = {
		{0x00, 1, {0x05}},
		{0x01, 0, {0}},
	};

	check_passed(ZZB_ZCL_APPLIANCE_CONTROL, false, commands, ARRAY_SIZE(commands));
	check_refused(ZZB_ZCL_APPLIANCE_CONTROL, false, malformed, ARRAY_SIZE(malformed),
		      ZZB_ZCL_MALFORMED_COMMAND);
	check_refused(ZZB_ZCL_APPLIANCE_CONTROL, false, &(struct test_cmd){0x02}, 1,
		      ZZB_ZCL_UNSUP_COMMAND);
}

/* Execution of a Command with STOP goes from the client on endpoint 141 to the bound servers */
ZTEST(zzb_zcl_appliances, test_execution_of_command)
{
	uint8_t node_tsn = test_node()->zcl.tsn;

	zassert_ok(zzb_zcl_appliance_control_execution_of_command(test_node(), GATEWAY_EP,
								  ZZB_ZCL_APPLIANCE_STOP));
	zassert_equal(zzb_apsde_data_req_fake.call_count, 1);
	zassert_equal(sent[0].req.src_ep, GATEWAY_EP);
	zassert_equal(sent[0].req.cluster, ZZB_ZCL_APPLIANCE_CONTROL);
	zassert_equal(sent[0].len, 4);
	zassert_mem_equal(sent[0].data, ((uint8_t[]){0x11, node_tsn, 0x00, 0x02}), 4);
}

/* The server reads Command Identification of Execution of a Command */
ZTEST(zzb_zcl_appliances, test_execution_of_command_parse)
{
	const struct zzb_zcl_cmd cmd = {.payload = (uint8_t[]){0x03}, .len = 1};
	struct zzb_zcl_appliance_control_execution_of_command fields;

	zzb_zcl_appliance_control_execution_of_command_parse(&cmd, &fields);
	zassert_equal(fields.command, ZZB_ZCL_APPLIANCE_PAUSE);
}

static int answer_signal_state(struct zzb_node *node, const struct zzb_zcl_cmd *cmd)
{
	return zzb_zcl_appliance_control_signal_state_rsp(
		node, cmd, ZZB_ZCL_APPLIANCE_RUNNING, ZZB_ZCL_APPLIANCE_REMOTE_CONTROL,
		ZZB_ZCL_APPLIANCE_DEVICE_STATUS2_PROPRIETARY_1);
}

/*
 * ZCL 15.2.4.2.1: Signal State gets Signal State Response of a running appliance with remote
 * control enabled and Device Status 2 0x1, without Appliance Status 2
 */
ZTEST(zzb_zcl_appliances, test_signal_state_rsp)
{
	static const uint8_t req[] = {0x01, 0x30, 0x01};
	static const uint8_t rsp[] = {0x19, 0x30, 0x00, 0x05, 0x1f};

	zcl_cmd_answer = answer_signal_state;
	receive_ep(WHITE_GOODS_EP, ZZB_ZCL_APPLIANCE_CONTROL, req, sizeof(req));
	zassert_ok(zcl_cmd_respond_err);
	zassert_equal(zzb_apsde_data_req_fake.call_count, 1);
	check_frame(0, WHITE_GOODS_EP, ZZB_ZCL_APPLIANCE_CONTROL, rsp, sizeof(rsp));
}

/*
 * The client reads Signal State Response of a paused appliance with remote control enabled and
 * Appliance Status 2 as IRIS symptom code
 */
ZTEST(zzb_zcl_appliances, test_signal_state_rsp_parse)
{
	const struct zzb_zcl_cmd cmd = {.payload = (uint8_t[]){0x06, 0x2f, 0x01, 0x02, 0x03},
					.len = 5};
	struct zzb_zcl_appliance_control_signal_state_rsp fields;

	zzb_zcl_appliance_control_signal_state_rsp_parse(&cmd, &fields);
	zassert_equal(fields.appliance_status, ZZB_ZCL_APPLIANCE_PAUSED);
	zassert_equal(fields.remote, ZZB_ZCL_APPLIANCE_REMOTE_CONTROL);
	zassert_equal(fields.device_status2, ZZB_ZCL_APPLIANCE_DEVICE_STATUS2_IRIS_SYMPTOM_CODE);
	zassert_equal(fields.appliance_status2, 0x030201);
}

/*
 * ZCL 15.2.4.1.2: Signal State Notification of a paused appliance with remote control temporarily
 * locked goes from the server on endpoint 140 to the bound clients
 */
ZTEST(zzb_zcl_appliances, test_signal_state_notification)
{
	uint8_t node_tsn = test_node()->zcl.tsn;

	zassert_ok(zzb_zcl_appliance_control_signal_state_notification(
		test_node(), WHITE_GOODS_EP, ZZB_ZCL_APPLIANCE_PAUSED,
		ZZB_ZCL_APPLIANCE_REMOTE_TEMPORARILY_LOCKED,
		ZZB_ZCL_APPLIANCE_DEVICE_STATUS2_PROPRIETARY_0));
	zassert_equal(zzb_apsde_data_req_fake.call_count, 1);
	zassert_equal(sent[0].req.src_ep, WHITE_GOODS_EP);
	zassert_equal(sent[0].req.cluster, ZZB_ZCL_APPLIANCE_CONTROL);
	zassert_equal(sent[0].len, 5);
	zassert_mem_equal(sent[0].data, ((uint8_t[]){0x19, node_tsn, 0x01, 0x06, 0x07}), 5);
}

/*
 * The client reads Signal State Notification of a running appliance with remote and energy
 * control enabled; Appliance Status 2, which the payload lacks, is 0
 */
ZTEST(zzb_zcl_appliances, test_signal_state_notification_parse)
{
	const struct zzb_zcl_cmd cmd = {.payload = (uint8_t[]){0x05, 0x01}, .len = 2};
	struct zzb_zcl_appliance_control_signal_state_rsp fields = {.appliance_status2 = 1};

	zzb_zcl_appliance_control_signal_state_notification_parse(&cmd, &fields);
	zassert_equal(fields.appliance_status, ZZB_ZCL_APPLIANCE_RUNNING);
	zassert_equal(fields.remote, ZZB_ZCL_APPLIANCE_REMOTE_AND_ENERGY_CONTROL);
	zassert_equal(fields.device_status2, ZZB_ZCL_APPLIANCE_DEVICE_STATUS2_PROPRIETARY_0);
	zassert_equal(fields.appliance_status2, 0);
}

/*
 * Get Alerts reaches zcl_cmd_cb of the Appliance Events and Alerts server, an unknown command gets
 * UNSUP_COMMAND
 */
ZTEST(zzb_zcl_appliances, test_events_server_commands)
{
	static const struct test_cmd commands[] = {
		{0x00, 0, {0}},
	};

	check_passed(ZZB_ZCL_APPLIANCE_EVENTS, true, commands, ARRAY_SIZE(commands));
	check_refused(ZZB_ZCL_APPLIANCE_EVENTS, true, &(struct test_cmd){0x01}, 1,
		      ZZB_ZCL_UNSUP_COMMAND);
}

/*
 * The commands of ZCL 15.4.2.4 reach zcl_cmd_cb of the client as received: Get Alerts Response of
 * a present warning and a recovered failure, whose Alerts Count has bits 4 to 7 set, which do not
 * count, Alerts Notification of one alert and of none, and Event Notification of the end of the
 * cycle
 */
ZTEST(zzb_zcl_appliances, test_events_client_commands)
{
	static const struct test_cmd commands[] = {
		{0x00, 7, {0x12, 0x01, 0x11, 0x00, 0x02, 0x03, 0x00}},
		{0x01, 4, {0x01, 0x01, 0x11, 0x00}},
		{0x01, 1, {0x00}},
		{0x02, 2, {0x00, 0x01}},
	};

	check_passed(ZZB_ZCL_APPLIANCE_EVENTS, false, commands, ARRAY_SIZE(commands));
}

/*
 * A payload shorter than its fields gives MALFORMED_COMMAND: Get Alerts Response without Alerts
 * Count and with 2 of the 3 octets of its second alert, Alerts Notification with 2 octets of its
 * alert and Event Notification with one octet. An unknown command gives UNSUP_COMMAND. None
 * reaches zcl_cmd_cb.
 */
ZTEST(zzb_zcl_appliances, test_events_client_malformed)
{
	static const struct test_cmd commands[] = {
		{0x00, 0, {0}},
		{0x00, 6, {0x02, 0x01, 0x11, 0x00, 0x02, 0x03}},
		{0x01, 3, {0x01, 0x01, 0x11}},
		{0x02, 1, {0x00}},
	};

	check_refused(ZZB_ZCL_APPLIANCE_EVENTS, false, commands, ARRAY_SIZE(commands),
		      ZZB_ZCL_MALFORMED_COMMAND);
	check_refused(ZZB_ZCL_APPLIANCE_EVENTS, false, &(struct test_cmd){0x03}, 1,
		      ZZB_ZCL_UNSUP_COMMAND);
}

/* The number of alerts or log IDs that the answers of the tests send */
static size_t answer_count;

/* A present warning with ID 0x11 and a recovered failure with ID 0x02 and manufacturer bits 0x80 */
static const uint32_t alerts[ZZB_ZCL_APPLIANCE_ALERTS_MAX + 1] = {
	FIELD_PREP(ZZB_ZCL_APPLIANCE_ALERT_ID, 0x11) |
		FIELD_PREP(ZZB_ZCL_APPLIANCE_ALERT_CATEGORY, ZZB_ZCL_APPLIANCE_ALERT_WARNING) |
		FIELD_PREP(ZZB_ZCL_APPLIANCE_ALERT_PRESENCE_RECOVERY,
			   ZZB_ZCL_APPLIANCE_ALERT_PRESENCE),
	FIELD_PREP(ZZB_ZCL_APPLIANCE_ALERT_ID, 0x02) |
		FIELD_PREP(ZZB_ZCL_APPLIANCE_ALERT_CATEGORY, ZZB_ZCL_APPLIANCE_ALERT_FAILURE) |
		FIELD_PREP(ZZB_ZCL_APPLIANCE_ALERT_MANUFACTURER, 0x80),
};

static int answer_alerts(struct zzb_node *node, const struct zzb_zcl_cmd *cmd)
{
	return zzb_zcl_appliance_events_get_alerts_rsp(node, cmd, alerts, answer_count);
}

/*
 * ZCL 15.4.2.3.1.2: Get Alerts gets Get Alerts Response with two unstructured alerts. The 15
 * alerts that Alerts Count holds go out, 16 give -EMSGSIZE.
 */
ZTEST(zzb_zcl_appliances, test_get_alerts_rsp)
{
	static const uint8_t req[] = {0x01, 0x30, 0x00};
	static const uint8_t rsp[] = {0x19, 0x30, 0x00, 0x02, 0x11, 0x11, 0x00, 0x02, 0x03, 0x80};

	zcl_cmd_answer = answer_alerts;
	answer_count = 2;
	receive_ep(WHITE_GOODS_EP, ZZB_ZCL_APPLIANCE_EVENTS, req, sizeof(req));
	zassert_ok(zcl_cmd_respond_err);
	zassert_equal(zzb_apsde_data_req_fake.call_count, 1);
	check_frame(0, WHITE_GOODS_EP, ZZB_ZCL_APPLIANCE_EVENTS, rsp, sizeof(rsp));

	answer_count = ZZB_ZCL_APPLIANCE_ALERTS_MAX;
	receive_ep(WHITE_GOODS_EP, ZZB_ZCL_APPLIANCE_EVENTS, req, sizeof(req));
	zassert_ok(zcl_cmd_respond_err);
	zassert_equal(sent[1].data[3], 0x0f);

	answer_count = ZZB_ZCL_APPLIANCE_ALERTS_MAX + 1;
	receive_ep(WHITE_GOODS_EP, ZZB_ZCL_APPLIANCE_EVENTS, req, sizeof(req));
	zassert_equal(zcl_cmd_respond_err, -EMSGSIZE);
}

/*
 * Log Request of log 5 and Log Queue Request reach zcl_cmd_cb of the Appliance Statistics server
 * as received. Log Request with 3 octets gives MALFORMED_COMMAND, an unknown command
 * UNSUP_COMMAND.
 */
ZTEST(zzb_zcl_appliances, test_stats_server_commands)
{
	static const struct test_cmd commands[] = {
		{0x00, 4, {0x05, 0x00, 0x00, 0x00}},
		{0x01, 0, {0}},
	};

	check_passed(ZZB_ZCL_APPLIANCE_STATS, true, commands, ARRAY_SIZE(commands));
	check_refused(ZZB_ZCL_APPLIANCE_STATS, true, &(struct test_cmd){0x00, 3, {0x05}}, 1,
		      ZZB_ZCL_MALFORMED_COMMAND);
	check_refused(ZZB_ZCL_APPLIANCE_STATS, true, &(struct test_cmd){0x02}, 1,
		      ZZB_ZCL_UNSUP_COMMAND);
}

static const uint32_t log_ids[ZZB_ZCL_APPLIANCE_STATS_LOG_IDS_MAX + 1] = {5, 0x01020304};

static int answer_log_queue(struct zzb_node *node, const struct zzb_zcl_cmd *cmd)
{
	return zzb_zcl_appliance_stats_log_queue_rsp(node, cmd, log_ids, answer_count);
}

/*
 * ZCL 15.5.2.2.3: Log Queue Request gets Log Queue Response with logs 5 and 0x01020304. The most
 * log IDs that a frame holds go out, one more gives -EMSGSIZE.
 */
ZTEST(zzb_zcl_appliances, test_log_queue_rsp)
{
	static const uint8_t req[] = {0x01, 0x30, 0x01};
	static const uint8_t rsp[] = {0x19, 0x30, 0x02, 0x02, 0x05, 0x00,
				      0x00, 0x00, 0x04, 0x03, 0x02, 0x01};

	zcl_cmd_answer = answer_log_queue;
	answer_count = 2;
	receive_ep(WHITE_GOODS_EP, ZZB_ZCL_APPLIANCE_STATS, req, sizeof(req));
	zassert_ok(zcl_cmd_respond_err);
	zassert_equal(zzb_apsde_data_req_fake.call_count, 1);
	check_frame(0, WHITE_GOODS_EP, ZZB_ZCL_APPLIANCE_STATS, rsp, sizeof(rsp));

	answer_count = ZZB_ZCL_APPLIANCE_STATS_LOG_IDS_MAX;
	receive_ep(WHITE_GOODS_EP, ZZB_ZCL_APPLIANCE_STATS, req, sizeof(req));
	zassert_ok(zcl_cmd_respond_err);

	answer_count = ZZB_ZCL_APPLIANCE_STATS_LOG_IDS_MAX + 1;
	receive_ep(WHITE_GOODS_EP, ZZB_ZCL_APPLIANCE_STATS, req, sizeof(req));
	zassert_equal(zcl_cmd_respond_err, -EMSGSIZE);
}

/*
 * The commands of ZCL 15.5.2.2 reach zcl_cmd_cb of the client as received: Log Notification of log
 * 5 without a time stamp and with 3 octets of log payload, Log Response of log 5 with the time
 * stamp 0x30001000 and an empty log, Log Queue Response of logs 5 and 6, and Statistics Available
 * of no log
 */
ZTEST(zzb_zcl_appliances, test_stats_client_commands)
{
	static const struct test_cmd commands[] = {
		{0x00, 15, {0xff, 0xff, 0xff, 0xff, 0x05, 0x00, 0x00, 0x00, 0x03}},
		{0x01, 12, {0x00, 0x10, 0x00, 0x30, 0x05}},
		{0x02, 9, {0x02, 0x05, 0x00, 0x00, 0x00, 0x06, 0x00, 0x00, 0x00}},
		{0x03, 1, {0x00}},
	};

	check_passed(ZZB_ZCL_APPLIANCE_STATS, false, commands, ARRAY_SIZE(commands));
}

/*
 * A payload shorter than its fields gives MALFORMED_COMMAND: Log Notification with 11 octets, with
 * 2 of the 3 octets of its log payload and with Log Length 0xffffffff, Log Response without
 * fields, Log Queue Response with 3 octets of its second log ID and Statistics Available without
 * its count. An unknown command gives UNSUP_COMMAND. None reaches zcl_cmd_cb.
 */
ZTEST(zzb_zcl_appliances, test_stats_client_malformed)
{
	static const struct test_cmd commands[] = {
		{0x00, 11, {0xff, 0xff, 0xff, 0xff, 0x05, 0x00, 0x00, 0x00, 0x03, 0x00, 0x00}},
		{0x00, 14, {0xff, 0xff, 0xff, 0xff, 0x05, 0x00, 0x00, 0x00, 0x03}},
		{0x00,
		 13,
		 {0xff, 0xff, 0xff, 0xff, 0x05, 0x00, 0x00, 0x00, 0xff, 0xff, 0xff, 0xff, 0x01}},
		{0x01, 0, {0}},
		{0x02, 8, {0x02, 0x05, 0x00, 0x00, 0x00, 0x06, 0x00, 0x00}},
		{0x03, 0, {0}},
	};

	check_refused(ZZB_ZCL_APPLIANCE_STATS, false, commands, ARRAY_SIZE(commands),
		      ZZB_ZCL_MALFORMED_COMMAND);
	check_refused(ZZB_ZCL_APPLIANCE_STATS, false, &(struct test_cmd){0x04}, 1,
		      ZZB_ZCL_UNSUP_COMMAND);
}

ZTEST_SUITE(zzb_zcl_appliances, NULL, setup, before, after, NULL);
```

## src/attr.c
```c
/* SPDX-License-Identifier: Apache-2.0 */

#include <errno.h>
#include <zephyr/settings/settings.h>
#include <zephyr/ztest.h>

#include "fakes.h"

static void *setup(void)
{
	test_node();
	return NULL;
}

/* The records of the saved attributes of the test cluster */
#define RECORD       "zzb/0/zcl/1/0f00/0002"
#define RECORD_I16   "zzb/0/zcl/1/0f00/0008"
#define RECORD_U24   "zzb/0/zcl/1/0f00/0009"
#define RECORD_MAP32 "zzb/0/zcl/1/0f00/000a"
#define RECORD_I8    "zzb/0/zcl/1/0f00/000c"
#define RECORD_U32   "zzb/0/zcl/1/0f00/000d"
#define RECORD_E16   "zzb/0/zcl/1/0f00/000e"
#define RECORD_EUI64 "zzb/0/zcl/1/0f00/000f"
#define RECORD_I24   "zzb/0/zcl/1/0f00/0010"
#define RECORD_U48   "zzb/0/zcl/1/0f00/0013"
#define RECORD_U56   "zzb/0/zcl/1/0f00/0014"

/* Every test starts without the record, since ztest orders tests by name */
static void before(void *fixture)
{
	reset_fakes();
	values1 = (struct test_values){0};
	zassert_ok(settings_delete(RECORD));
	zassert_ok(settings_delete(RECORD_I16));
	zassert_ok(settings_delete(RECORD_U24));
	zassert_ok(settings_delete(RECORD_MAP32));
	zassert_ok(settings_delete(RECORD_I8));
	zassert_ok(settings_delete(RECORD_U32));
	zassert_ok(settings_delete(RECORD_E16));
	zassert_ok(settings_delete(RECORD_EUI64));
	zassert_ok(settings_delete(RECORD_I24));
	zassert_ok(settings_delete("zzb/0/zcl/1/0f00/0011"));
	zassert_ok(settings_delete("zzb/0/zcl/1/0f00/0012"));
	zassert_ok(settings_delete(RECORD_U48));
	zassert_ok(settings_delete(RECORD_U56));
}

static void after(void *fixture)
{
	check_no_buffer_leak();
}

/* Section 15: a non-volatile attribute is saved at every change and loaded at boot */
ZTEST(zzb_zcl_attr, test_saved_attribute)
{
	static const uint8_t req[] = {0x00, 0x60, 0x02, 0x01, 0x00, 0x20,
				      0x34, 0x02, 0x00, 0x21, 0x78, 0x56};

	receive(TEST_CLUSTER, req, sizeof(req));
	values1 = (struct test_values){0};
	zassert_ok(reboot());
	zassert_equal(values1.u16, 0x5678);
	zassert_equal(values1.u8, 0);
}

/* Section 16: wide and signed values are written, saved in the length of their type and loaded */
ZTEST(zzb_zcl_attr, test_wide_types)
{
	static const uint8_t req[] = {0x00, 0x62, 0x02, 0x08, 0x00, 0x29, 0xfe, 0xff, 0x09, 0x00,
				      0x22, 0x56, 0x34, 0x12, 0x0a, 0x00, 0x1b, 0xef, 0xcd, 0xab,
				      0x89, 0x0c, 0x00, 0x28, 0xfd, 0x0d, 0x00, 0x23, 0x04, 0x03,
				      0x02, 0x01, 0x0e, 0x00, 0x31, 0x15, 0x00, 0x0f, 0x00, 0xf0,
				      0x88, 0x77, 0x66, 0x55, 0x44, 0x33, 0x22, 0x11};
	static const uint8_t rsp[] = {0x18, 0x62, 0x04, 0x00};
	uint8_t rec[9];

	receive(TEST_CLUSTER, req, sizeof(req));
	check_frame(0, 1, TEST_CLUSTER, rsp, sizeof(rsp));
	zassert_equal(values1.i16, -2);
	zassert_equal(values1.u24, 0x123456);
	zassert_equal(values1.map32, 0x89abcdef);
	zassert_equal(values1.i8, -3);
	zassert_equal(values1.u32, 0x01020304);
	zassert_equal(values1.e16, 0x0015);
	zassert_equal(values1.eui64, 0x1122334455667788);
	zassert_equal(settings_load_one(RECORD_U24, rec, sizeof(rec)), 4);
	zassert_mem_equal(rec, ((uint8_t[]){0x01, 0x56, 0x34, 0x12}), 4);
	zassert_equal(settings_load_one(RECORD_I8, rec, sizeof(rec)), 2);
	zassert_mem_equal(rec, ((uint8_t[]){0x01, 0xfd}), 2);
	zassert_equal(settings_load_one(RECORD_E16, rec, sizeof(rec)), 3);
	zassert_mem_equal(rec, ((uint8_t[]){0x01, 0x15, 0x00}), 3);
	zassert_equal(settings_load_one(RECORD_EUI64, rec, sizeof(rec)), 9);
	zassert_mem_equal(rec, ((uint8_t[]){0x01, 0x88, 0x77, 0x66, 0x55, 0x44, 0x33, 0x22, 0x11}),
			  9);

	values1 = (struct test_values){0};
	zassert_ok(reboot());
	zassert_equal(values1.i16, -2);
	zassert_equal(values1.u24, 0x123456);
	zassert_equal(values1.map32, 0x89abcdef);
	zassert_equal(values1.i8, -3);
	zassert_equal(values1.u32, 0x01020304);
	zassert_equal(values1.e16, 0x0015);
	zassert_equal(values1.eui64, 0x1122334455667788);
}

/* Section 16: an int24 is sign-extended in its field; uint48 and uint56 have 64-bit fields */
ZTEST(zzb_zcl_attr, test_long_types)
{
	static const uint8_t req[] = {
		0x00, 0x64, 0x02, 0x10, 0x00, 0x2a, 0xfe, 0xff, 0xff, 0x11, 0x00, 0x2b, 0xfd, 0xff,
		0xff, 0xff, 0x12, 0x00, 0xe2, 0x78, 0x56, 0x34, 0x12, 0x13, 0x00, 0x25, 0x06, 0x05,
		0x04, 0x03, 0x02, 0x01, 0x14, 0x00, 0x26, 0x07, 0x06, 0x05, 0x04, 0x03, 0x02, 0x01};
	static const uint8_t read[] = {0x00, 0x65, 0x00, 0x10, 0x00, 0x13, 0x00, 0x14, 0x00};
	static const uint8_t rsp[] = {0x18, 0x65, 0x01, 0x10, 0x00, 0x00, 0x2a, 0xfe,
				      0xff, 0xff, 0x13, 0x00, 0x00, 0x25, 0x06, 0x05,
				      0x04, 0x03, 0x02, 0x01, 0x14, 0x00, 0x00, 0x26,
				      0x07, 0x06, 0x05, 0x04, 0x03, 0x02, 0x01};
	uint8_t rec[9];

	receive(TEST_CLUSTER, req, sizeof(req));
	zassert_equal(values1.i24, -2);
	zassert_equal(values1.i32, -3);
	zassert_equal(values1.utc, 0x12345678);
	zassert_equal(values1.u48, 0x010203040506);
	zassert_equal(values1.u56, 0x01020304050607);
	zassert_equal(settings_load_one(RECORD_I24, rec, sizeof(rec)), 4);
	zassert_mem_equal(rec, ((uint8_t[]){0x01, 0xfe, 0xff, 0xff}), 4);
	zassert_equal(settings_load_one(RECORD_U48, rec, sizeof(rec)), 7);
	zassert_equal(settings_load_one(RECORD_U56, rec, sizeof(rec)), 8);

	receive(TEST_CLUSTER, read, sizeof(read));
	check_frame(1, 1, TEST_CLUSTER, rsp, sizeof(rsp));

	values1 = (struct test_values){0};
	zassert_ok(reboot());
	zassert_equal(values1.i24, -2);
	zassert_equal(values1.i32, -3);
	zassert_equal(values1.utc, 0x12345678);
	zassert_equal(values1.u48, 0x010203040506);
	zassert_equal(values1.u56, 0x01020304050607);
}

/* zzb_zcl_attr_set() takes int32_t for int24 and uint64_t for uint48 and uint56 */
ZTEST(zzb_zcl_attr, test_attr_set_long_types)
{
	struct zzb_node *node = test_node();
	int32_t i24 = -0x800000;
	uint64_t u48 = 0xffffffffffff;
	uint64_t u56 = 0xffffffffffffff;

	zassert_ok(zzb_zcl_attr_set(node, 1, TEST_CLUSTER, 0x0010, &i24));
	zassert_ok(zzb_zcl_attr_set(node, 1, TEST_CLUSTER, 0x0013, &u48));
	zassert_ok(zzb_zcl_attr_set(node, 1, TEST_CLUSTER, 0x0014, &u56));
	zassert_equal(values1.i24, -0x800000);
	zassert_equal(values1.u48, 0xffffffffffff);
	zassert_equal(values1.u56, 0xffffffffffffff);
	zassert_equal(hook_calls.count, 3);

	i24 = 0x800000;
	zassert_equal(zzb_zcl_attr_set(node, 1, TEST_CLUSTER, 0x0010, &i24), -EINVAL);
	i24 = -0x800001;
	zassert_equal(zzb_zcl_attr_set(node, 1, TEST_CLUSTER, 0x0010, &i24), -EINVAL);
	u48++;
	zassert_equal(zzb_zcl_attr_set(node, 1, TEST_CLUSTER, 0x0013, &u48), -EINVAL);
	u56++;
	zassert_equal(zzb_zcl_attr_set(node, 1, TEST_CLUSTER, 0x0014, &u56), -EINVAL);
	zassert_equal(hook_calls.count, 3);
}

/* The check hook gets the value struct of the instance on the endpoint */
ZTEST(zzb_zcl_attr, test_check_values)
{
	static const uint8_t req[] = {0x00, 0x63, 0x02, 0x03, 0x00, 0x30, 0x01};

	receive_ep(2, TEST_CLUSTER, req, sizeof(req));
	zassert_equal_ptr(check_values, &values2);
	receive_ep(1, TEST_CLUSTER, req, sizeof(req));
	zassert_equal_ptr(check_values, &values1);
}

/* Section 16: READ_ONLY from the check hook refuses a remote write, not zzb_zcl_attr_set() */
ZTEST(zzb_zcl_attr, test_check_read_only)
{
	static const uint8_t req[] = {0x00, 0x66, 0x02, 0x04, 0x00, 0x18, 0x0f};
	static const uint8_t rsp[] = {0x18, 0x66, 0x04, 0x88, 0x04, 0x00};
	uint8_t map8 = 0x0f;

	values1.map16 = BIT(0);
	receive(TEST_CLUSTER, req, sizeof(req));
	check_frame(0, 1, TEST_CLUSTER, rsp, sizeof(rsp));
	zassert_equal(values1.map8, 0);

	zassert_ok(zzb_zcl_attr_set(test_node(), 1, TEST_CLUSTER, 0x0004, &map8));
	zassert_equal(values1.map8, 0x0f);
}

/* Section 16: the refresh hook updates the values before a read and before the checks of a write */
ZTEST(zzb_zcl_attr, test_refresh)
{
	static const uint8_t read[] = {0x00, 0x67, 0x00, 0x0b, 0x00};
	static const uint8_t read_rsp[] = {0x18, 0x67, 0x01, 0x0b, 0x00, 0x00, 0x19, 0x01, 0x00};
	static const uint8_t write[] = {0x00, 0x68, 0x02, 0x04, 0x00, 0x18, 0x0f};
	static const uint8_t write_rsp[] = {0x18, 0x68, 0x04, 0x88, 0x04, 0x00};
	uint8_t map8 = 1;

	refresh_bits = BIT(0);
	receive(TEST_CLUSTER, read, sizeof(read));
	check_frame(0, 1, TEST_CLUSTER, read_rsp, sizeof(read_rsp));
	zassert_equal(refresh_calls, 1);

	values1.map16 = 0;
	receive(TEST_CLUSTER, write, sizeof(write));
	check_frame(1, 1, TEST_CLUSTER, write_rsp, sizeof(write_rsp));
	zassert_equal(refresh_calls, 2);

	zassert_ok(zzb_zcl_attr_set(test_node(), 1, TEST_CLUSTER, 0x0004, &map8));
	zassert_equal(refresh_calls, 3);
}

/* Section 15: a record with an unknown version or length fails the boot */
ZTEST(zzb_zcl_attr, test_bad_record)
{
	zassert_ok(settings_save_one(RECORD, (uint8_t[]){0x02, 0x78, 0x56}, 3));
	zassert_equal(reboot(), -EINVAL);
	zassert_ok(settings_save_one(RECORD, (uint8_t[]){0x01, 0x78}, 2));
	zassert_equal(reboot(), -EINVAL);
	zassert_ok(settings_delete(RECORD));
	zassert_ok(settings_save_one(RECORD_EUI64, (uint8_t[]){0x01, 0x04, 0x03, 0x02, 0x01}, 5));
	zassert_equal(reboot(), -EINVAL);
	zassert_ok(settings_delete(RECORD_EUI64));
	zassert_ok(reboot());
}

/* Records of attributes that the device definition does not have are ignored */
ZTEST(zzb_zcl_attr, test_unknown_records)
{
	static const uint8_t rec[] = {0x01, 0x78, 0x56};

	zassert_ok(settings_save_one("zzb/0/zcl/9/0f00/0002", rec, sizeof(rec)));
	zassert_ok(settings_save_one("zzb/0/zcl/1/0300/0002", rec, sizeof(rec)));
	zassert_ok(settings_save_one("zzb/0/zcl/1/0f00/0100", rec, sizeof(rec)));
	zassert_ok(settings_save_one("zzb/0/zcl/1/0f00/0001", rec, sizeof(rec)));
	zassert_ok(reboot());
	zassert_equal(values1.u8, 0);
	zassert_equal(values1.u16, 0);
	zassert_equal(values2.u16, 0);
	zassert_ok(settings_delete("zzb/0/zcl/9/0f00/0002"));
	zassert_ok(settings_delete("zzb/0/zcl/1/0300/0002"));
	zassert_ok(settings_delete("zzb/0/zcl/1/0f00/0100"));
	zassert_ok(settings_delete("zzb/0/zcl/1/0f00/0001"));
}

/* Section 16: the reset sets the defaults as a remote change does, then deletes the records */
ZTEST(zzb_zcl_attr, test_reset)
{
	static const uint8_t req[] = {0x00, 0x61, 0x02, 0x01, 0x00, 0x20, 0x05, 0x02,
				      0x00, 0x21, 0x07, 0x00, 0x0f, 0x00, 0xf0, 0x08,
				      0x07, 0x06, 0x05, 0x04, 0x03, 0x02, 0x01};

	receive(TEST_CLUSTER, req, sizeof(req));
	reset_fakes();
	reset_node();
	zassert_equal(values1.u8, 0);
	zassert_equal(values1.u16, 0);
	zassert_equal(values1.eui64, 0);
	zassert_equal(zcl_cb_calls.count, 3);
	zassert_equal(zcl_cb_calls.attr[0], 0x0001);
	zassert_equal(zcl_cb_calls.attr[1], 0x0002);
	zassert_equal(zcl_cb_calls.attr[2], 0x000f);

	values1.u16 = 9;
	zassert_ok(reboot());
	zassert_equal(values1.u16, 9);
}

/* The application sets a value on the stack thread: saved, the changed hook, no zcl_cb */
ZTEST(zzb_zcl_attr, test_attr_set)
{
	struct zzb_node *node = test_node();
	uint16_t u16 = 0x1111;
	uint8_t u8 = 0;

	zassert_ok(zzb_zcl_attr_set(node, 1, TEST_CLUSTER, 0x0002, &u16));
	zassert_equal(values1.u16, 0x1111);
	zassert_equal(hook_calls.count, 1);
	zassert_equal(hook_calls.attr[0], 0x0002);
	zassert_equal(zcl_cb_calls.count, 0);

	values1.u16 = 0;
	zassert_ok(reboot());
	zassert_equal(values1.u16, 0x1111);

	/* The same value changes nothing */
	zassert_ok(zzb_zcl_attr_set(node, 1, TEST_CLUSTER, 0x0001, &u8));
	zassert_equal(hook_calls.count, 1);
}

ZTEST(zzb_zcl_attr, test_attr_set_errors)
{
	struct zzb_node *node = test_node();
	uint8_t big = TEST_E8_MAX + 1;
	uint8_t two = 2;
	uint16_t u16 = 1;
	uint32_t u24 = 0x1000000;
	uint64_t eui64 = 1;

	zassert_equal(zzb_zcl_attr_set(node, 9, TEST_CLUSTER, 0x0002, &u16), -ENOENT);
	zassert_equal(zzb_zcl_attr_set(node, 1, 0x0300, 0x0002, &u16), -ENOENT);
	zassert_equal(zzb_zcl_attr_set(node, 1, TEST_CLUSTER, 0x0100, &u16), -ENOENT);
	/* On/Off is a client on endpoint 1 */
	zassert_equal(zzb_zcl_attr_set(node, 1, ON_OFF, 0x0000, &two), -ENOENT);

	zassert_equal(zzb_zcl_attr_set(node, 1, TEST_CLUSTER, 0xfffd, &u16), -EINVAL);
	zassert_equal(zzb_zcl_attr_set(node, 1, TEST_CLUSTER, 0x0005, &u16), -EINVAL);
	zassert_equal(zzb_zcl_attr_set(node, 1, TEST_CLUSTER, 0x0000, &two), -EINVAL);
	zassert_equal(zzb_zcl_attr_set(node, 1, TEST_CLUSTER, 0x0003, &big), -EINVAL);
	zassert_equal(zzb_zcl_attr_set(node, 1, TEST_CLUSTER, 0x0009, &u24), -EINVAL);
	zassert_equal(zzb_zcl_attr_set(node, 1, TEST_CLUSTER, 0x000f, &eui64), -EINVAL);
	zassert_equal(hook_calls.count, 0);
}

ZTEST_SUITE(zzb_zcl_attr, NULL, setup, before, after, NULL);
```

## src/ballast.c
```c
/* SPDX-License-Identifier: Apache-2.0 */

#include <zephyr/ztest.h>
#include <zzb/zcl/ballast.h>

#include "fakes.h"

static void *setup(void)
{
	test_node();
	return NULL;
}

/* Each test starts with the defaults, without records */
static void before(void *fixture)
{
	reset_node();
	reset_fakes();
}

static void after(void *fixture)
{
	check_no_buffer_leak();
}

static void set_hours(uint16_t attr, uint32_t hours)
{
	zassert_ok(zzb_zcl_attr_set(test_node(), SENSOR_EP, ZZB_ZCL_BALLAST, attr, &hours));
}

static void set_lamp_alarm_mode(uint8_t mode)
{
	zassert_ok(zzb_zcl_attr_set(test_node(), SENSOR_EP, ZZB_ZCL_BALLAST,
				    ZZB_ZCL_BALLAST_LAMP_ALARM_MODE, &mode));
}

/*
 * ZCL 5.3.2.2.2: MinLevel and MaxLevel stay within the physical levels and in order, and
 * BallastFactorAdjustment is 0x64 or above. The first command writes MinLevel 0x0f, MaxLevel 0xe1
 * and BallastFactorAdjustment 0x63, the second MinLevel 0x40 and BallastFactorAdjustment 0x64,
 * the third MaxLevel 0x3f, MinLevel 0xe1 and BallastFactorAdjustment 0xff.
 */
ZTEST(zzb_zcl_ballast, test_checks)
{
	static const uint8_t req1[] = {0x00, 0x40, 0x02, 0x10, 0x00, 0x20, 0x0f, 0x11,
				       0x00, 0x20, 0xe1, 0x15, 0x00, 0x20, 0x63};
	static const uint8_t rsp1[] = {0x18, 0x40, 0x04, 0x87, 0x10, 0x00,
				       0x87, 0x11, 0x00, 0x87, 0x15, 0x00};
	static const uint8_t req2[] = {0x00, 0x41, 0x02, 0x10, 0x00, 0x20,
				       0x40, 0x15, 0x00, 0x20, 0x64};
	static const uint8_t req3[] = {0x00, 0x42, 0x02, 0x11, 0x00, 0x20, 0x3f, 0x10,
				       0x00, 0x20, 0xe1, 0x15, 0x00, 0x20, 0xff};
	static const uint8_t rsp3[] = {0x18, 0x42, 0x04, 0x87, 0x11, 0x00, 0x87, 0x10, 0x00};

	receive_ep(SENSOR_EP, ZZB_ZCL_BALLAST, req1, sizeof(req1));
	check_frame(0, SENSOR_EP, ZZB_ZCL_BALLAST, rsp1, sizeof(rsp1));
	zassert_equal(ballast.min_level, PHYSICAL_MIN);
	zassert_equal(ballast.max_level, PHYSICAL_MAX);
	zassert_equal(ballast.ballast_factor_adjustment, 0xff);

	receive_ep(SENSOR_EP, ZZB_ZCL_BALLAST, req2, sizeof(req2));
	check_frame(1, SENSOR_EP, ZZB_ZCL_BALLAST, (uint8_t[]){0x18, 0x41, 0x04, 0x00}, 4);
	zassert_equal(ballast.min_level, 0x40);
	zassert_equal(ballast.ballast_factor_adjustment, 0x64);

	receive_ep(SENSOR_EP, ZZB_ZCL_BALLAST, req3, sizeof(req3));
	check_frame(2, SENSOR_EP, ZZB_ZCL_BALLAST, rsp3, sizeof(rsp3));
	zassert_equal(ballast.min_level, 0x40);
	zassert_equal(ballast.max_level, PHYSICAL_MAX);
	zassert_equal(ballast.ballast_factor_adjustment, 0xff);
}

/*
 * The settings are saved, and the reset restores the defaults, the physical levels for MinLevel
 * and MaxLevel. The records are MinLevel 0x20, IntrinsicBallastFactor 0x50, LampBurnHours 0x1234
 * and LampAlarmMode 0x01.
 */
ZTEST(zzb_zcl_ballast, test_settings)
{
	static const uint8_t req[] = {0x00, 0x43, 0x02, 0x10, 0x00, 0x20, 0x20,
				      0x14, 0x00, 0x20, 0x50, 0x33, 0x00, 0x22,
				      0x34, 0x12, 0x00, 0x34, 0x00, 0x18, 0x01};
	static const uint16_t reset_attrs[] = {0x0010, 0x0014, 0x0033, 0x0034};

	receive_ep(SENSOR_EP, ZZB_ZCL_BALLAST, req, sizeof(req));
	check_frame(0, SENSOR_EP, ZZB_ZCL_BALLAST, (uint8_t[]){0x18, 0x43, 0x04, 0x00}, 4);

	zassert_ok(reboot());
	zassert_equal(ballast.min_level, 0x20);
	zassert_equal(ballast.intrinsic_ballast_factor, 0x50);
	zassert_equal(ballast.lamp_burn_hours, 0x1234);
	zassert_equal(ballast.lamp_alarm_mode, 0x01);
	zassert_equal(ballast.lamp_burn_hours_trip_point, 0xffffff);

	reset_fakes();
	reset_node();
	zassert_equal(ballast.min_level, PHYSICAL_MIN);
	zassert_equal(ballast.intrinsic_ballast_factor, 0xff);
	zassert_equal(ballast.lamp_burn_hours, 0);
	zassert_equal(ballast.lamp_alarm_mode, 0);
	check_zcl_cb(SENSOR_EP, ZZB_ZCL_BALLAST, reset_attrs, ARRAY_SIZE(reset_attrs));
}

/* Without records MinLevel and MaxLevel take the physical levels that the application set */
ZTEST(zzb_zcl_ballast, test_physical_defaults)
{
	ballast.physical_max_level = 0xd0;
	zassert_ok(reboot());
	zassert_equal(ballast.min_level, PHYSICAL_MIN);
	zassert_equal(ballast.max_level, 0xd0);

	ballast.physical_max_level = PHYSICAL_MAX;
	zassert_ok(reboot());
	zassert_equal(ballast.max_level, PHYSICAL_MAX);
}

/*
 * ZCL 5.3.2.2.4.6: LampBurnHours at or above LampBurnHoursTripPoint raises alarm 0x01 once, without
 * zcl_cb, and Alarm goes only with bit 0 of LampAlarmMode. A trip point of 0xffffff and unknown
 * burn hours give no alarm.
 */
ZTEST(zzb_zcl_ballast, test_lamp_burn_hours_alarm)
{
	set_hours(ZZB_ZCL_BALLAST_LAMP_BURN_HOURS_TRIP_POINT, 100);
	set_lamp_alarm_mode(0x01);

	set_hours(ZZB_ZCL_BALLAST_LAMP_BURN_HOURS, 99);
	zassert_equal(alarms30.alarm_count, 0);
	set_hours(ZZB_ZCL_BALLAST_LAMP_BURN_HOURS, 100);
	check_alarm(0, SENSOR_EP, ZZB_ZCL_BALLAST, 0x01);
	zassert_equal(zcl_cb_calls.count, 0);
	set_hours(ZZB_ZCL_BALLAST_LAMP_BURN_HOURS, 101);
	zassert_equal(alarms30.alarm_count, 1);

	/* A new lamp */
	set_hours(ZZB_ZCL_BALLAST_LAMP_BURN_HOURS, 0);
	set_lamp_alarm_mode(0);
	set_hours(ZZB_ZCL_BALLAST_LAMP_BURN_HOURS, 100);
	zassert_equal(alarm_entries(SENSOR_EP, ZZB_ZCL_BALLAST, 0x01), 2);
	zassert_equal(zzb_apsde_data_req_fake.call_count, 1);

	set_hours(ZZB_ZCL_BALLAST_LAMP_BURN_HOURS, 0xffffff);
	set_hours(ZZB_ZCL_BALLAST_LAMP_BURN_HOURS_TRIP_POINT, 0xffffff);
	set_hours(ZZB_ZCL_BALLAST_LAMP_BURN_HOURS, 200);
	zassert_equal(alarms30.alarm_count, 2);
}

/*
 * A write of the trip point raises the alarm with zcl_cb for AlarmCount, and Reset Alarm raises it
 * again while LampBurnHours stays at or above the trip point (ZCL 3.11.2.4.1)
 */
ZTEST(zzb_zcl_ballast, test_lamp_burn_hours_reset_alarm)
{
	/* Write Attributes No Response: LampBurnHoursTripPoint 100 */
	static const uint8_t write[] = {0x10, 0x46, 0x05, 0x35, 0x00, 0x22, 0x64, 0x00, 0x00};
	static const uint16_t alarm_count[] = {ZZB_ZCL_ALARMS_ALARM_COUNT};

	set_hours(ZZB_ZCL_BALLAST_LAMP_BURN_HOURS, 150);
	receive_ep(SENSOR_EP, ZZB_ZCL_BALLAST, write, sizeof(write));
	zassert_equal(alarms30.alarm_count, 1);
	check_zcl_cb(SENSOR_EP, ZZB_ZCL_ALARMS, alarm_count, 1);

	reset_alarm(SENSOR_EP, ZZB_ZCL_BALLAST, 0x00);
	zassert_equal(alarms30.alarm_count, 1);
	reset_alarm(SENSOR_EP, ZZB_ZCL_BALLAST, 0x01);
	zassert_equal(alarms30.alarm_count, 2);
	zassert_equal(zzb_apsde_data_req_fake.call_count, 0);

	set_lamp_alarm_mode(0x01);
	reset_all_alarms(SENSOR_EP);
	zassert_equal(alarms30.alarm_count, 3);
	check_alarm(0, SENSOR_EP, ZZB_ZCL_BALLAST, 0x01);

	set_hours(ZZB_ZCL_BALLAST_LAMP_BURN_HOURS, 0);
	reset_all_alarms(SENSOR_EP);
	zassert_equal(alarms30.alarm_count, 3);
	zassert_equal(zzb_apsde_data_req_fake.call_count, 1);
}

/* The saved burn hours at or above the saved trip point raise the alarm again at boot */
ZTEST(zzb_zcl_ballast, test_lamp_burn_hours_at_boot)
{
	set_hours(ZZB_ZCL_BALLAST_LAMP_BURN_HOURS_TRIP_POINT, 100);
	set_hours(ZZB_ZCL_BALLAST_LAMP_BURN_HOURS, 120);
	zassert_ok(reboot());
	zassert_equal(alarm_entries(SENSOR_EP, ZZB_ZCL_BALLAST, 0x01), 2);
}

ZTEST_SUITE(zzb_zcl_ballast, NULL, setup, before, after, NULL);
```
