## CMakeLists.txt
```
# SPDX-License-Identifier: Apache-2.0

cmake_minimum_required(VERSION 3.20.0)

find_package(Zephyr REQUIRED HINTS $ENV{ZEPHYR_BASE})
project(zzb_unit_nwk)

target_include_directories(app PRIVATE ${ZEPHYR_ZZB_MODULE_DIR}/subsys/zzb)
target_sources(app PRIVATE
  src/addr_map.c
  src/data.c
  src/ed_timeout.c
  src/fakes.c
  src/fc.c
  src/frame.c
  src/join.c
  src/leave.c
  src/neighbor.c
  src/nib.c
  src/poll.c
  src/rejoin.c
  src/security.c
  src/status.c
)
```

## prj.conf
```kconfig
# SPDX-License-Identifier: Apache-2.0

CONFIG_ZTEST=y
CONFIG_ZZB=y
# The MAC is faked
CONFIG_ZZB_NWK=y
# The test defines the NLDE callbacks
CONFIG_ZZB_APS=n
CONFIG_ZZB_NODE_COUNT=2
CONFIG_ZZB_FRAME_COUNTER_JUMP=16
# 10 s, so the keepalive runs every 3.33 s
CONFIG_ZZB_NWK_ED_TIMEOUT=0
CONFIG_FLASH=y
CONFIG_FLASH_MAP=y
CONFIG_NVS=y
# Every run starts with erased flash
CONFIG_NATIVE_EXTRA_CMDLINE_ARGS="--flash_in_ram"
```

## src/addr_map.c
```c
/* SPDX-License-Identifier: Apache-2.0 */

#include <errno.h>
#include <zephyr/settings/settings.h>
#include <zephyr/ztest.h>

#include "common/node.h"
#include "fakes.h"
#include "nwk/nwk.h"

#define EXT_A 0x00124b00000000aaULL
#define EXT_B 0x00124b00000000bbULL

static struct zzb_node *node;

static void *setup(void)
{
	node = test_node(0);
	return NULL;
}

static void before(void *fixture)
{
	zassert_ok(zzb_nlme_reset_req(node));
	zassert_ok(nwk_reboot());
}

static uint16_t find(uint64_t ext_addr)
{
	uint16_t addr;

	zassert_ok(zzb_nwk_addr_map_find(node, ext_addr, &addr));
	return addr;
}

ZTEST(zzb_nwk_addr_map, test_set_and_find)
{
	uint16_t addr;

	zassert_ok(zzb_nlme_set_addr_map(node, EXT_A, 0x1111));
	zassert_ok(zzb_nlme_set_addr_map(node, EXT_B, 0x2222));
	zassert_equal(find(EXT_A), 0x1111);
	zassert_equal(zzb_nwk_addr_map_ext(node, 0x2222), EXT_B);
	zassert_equal(zzb_nwk_addr_map_find(node, 0x00124b00000000ccULL, &addr), -ENOENT);
	zassert_equal(zzb_nwk_addr_map_ext(node, 0x3333), 0);

	/* A new address replaces the old one */
	zassert_ok(zzb_nlme_set_addr_map(node, EXT_A, 0x1112));
	zassert_equal(find(EXT_A), 0x1112);
	zassert_equal(zzb_nwk_addr_map_ext(node, 0x1111), 0);
}

ZTEST(zzb_nwk_addr_map, test_full_table)
{
	for (int i = 0; i < CONFIG_ZZB_NWK_ADDR_MAP_COUNT; i++) {
		zassert_ok(zzb_nlme_set_addr_map(node, EXT_A + i, 0x1000 + i));
	}

	zassert_equal(zzb_nlme_set_addr_map(node, EXT_B, 0x2222), -ENOMEM);
	zassert_ok(zzb_nlme_set_addr_map(node, EXT_A, 0x1fff));
}

/* The entries survive a reboot; a leave and NLME-RESET clear them */
ZTEST(zzb_nwk_addr_map, test_records)
{
	uint16_t addr;

	zassert_ok(zzb_nlme_set_addr_map(node, EXT_A, 0x1111));
	zassert_ok(nwk_reboot());
	zassert_equal(find(EXT_A), 0x1111);

	zassert_ok(zzb_nlme_reset_req(node));
	zassert_equal(zzb_nwk_addr_map_find(node, EXT_A, &addr), -ENOENT);
	zassert_ok(nwk_reboot());
	zassert_equal(zzb_nwk_addr_map_find(node, EXT_A, &addr), -ENOENT);
}

ZTEST(zzb_nwk_addr_map, test_unknown_record_version)
{
	uint8_t rec[11] = {2};

	zassert_ok(settings_save_one("zzb/0/nwk/addr/0", rec, sizeof(rec)));
	zassert_equal(nwk_reboot(), -EINVAL);

	rec[0] = 1;
	zassert_ok(settings_save_one("zzb/0/nwk/addr/0", rec, sizeof(rec) - 1));
	zassert_equal(nwk_reboot(), -EINVAL);

	zassert_ok(settings_delete("zzb/0/nwk/addr/0"));
	zassert_ok(nwk_reboot());
}

ZTEST_SUITE(zzb_nwk_addr_map, NULL, setup, before, NULL, NULL);
```

## src/data.c
```c
/* SPDX-License-Identifier: Apache-2.0 */

#include <errno.h>
#include <string.h>
#include <zephyr/net_buf.h>
#include <zephyr/ztest.h>

#include "common/buf.h"
#include "common/node.h"
#include "fakes.h"
#include "mac/frame.h"
#include "nwk/frame.h"
#include "nwk/nwk.h"
#include "sec/ccm.h"

#define HANDLE 5

static const uint8_t nsdu[] = {0x40, 0x00, 0x06, 0x00, 0x04, 0x01, 0x01, 0x10};

/* Node 0 is the child of node 1 */
static struct zzb_node *child;
static struct zzb_node *parent;

static struct net_buf *nsdu_buf(void)
{
	struct net_buf *buf = zzb_buf_alloc(K_NO_WAIT);

	zassert_not_null(buf);
	net_buf_reserve(buf, ZZB_NLDE_HEADROOM);
	net_buf_add_mem(buf, nsdu, sizeof(nsdu));
	zzb_frame_meta(buf)->handle = HANDLE;
	return buf;
}

static void check_mac_dst(int i, uint16_t short_addr, uint8_t flags)
{
	zassert_equal(sent[i].meta.dst.mode, ZZB_MAC_ADDR_SHORT);
	zassert_equal(sent[i].meta.dst.pan_id, PAN_ID);
	zassert_equal(sent[i].meta.dst.short_addr, short_addr);
	zassert_equal(sent[i].meta.flags, flags);
	zassert_equal(sent[i].meta.handle, HANDLE);
}

static void *setup(void)
{
	child = test_node(0);
	parent = test_node(1);
	return NULL;
}

static void before(void *fixture)
{
	reset_fakes();
	pair_nodes(child, parent);
}

static void after(void *fixture)
{
	child->sleepy = false;
	check_no_buffer_leak();
}

ZTEST(zzb_nwk_data, test_secured_unicast_reaches_the_parent)
{
	uint8_t seq = child->nwk.nib.seq;
	struct zzb_nwk_hdr hdr;

	zassert_ok(zzb_nlde_data_req(child, nsdu_buf(), PARENT_SHORT, 0, true));
	zassert_equal(zzb_mcps_data_req_fake.call_count, 1);
	check_mac_dst(0, PARENT_SHORT, ZZB_FRAME_ACK_REQ);

	zassert_equal(zzb_nwk_hdr_parse(sent[0].data, sent[0].len, &hdr), 8);
	zassert_equal(hdr.type, ZZB_NWK_FRAME_DATA);
	zassert_equal(hdr.flags, ZZB_NWK_DISCOVER_ROUTE | ZZB_NWK_SECURITY);
	zassert_equal(hdr.dst, PARENT_SHORT);
	zassert_equal(hdr.src, CHILD_SHORT);
	zassert_equal(hdr.radius, ZZB_NWK_DEFAULT_RADIUS);
	zassert_equal(hdr.seq, seq);
	zassert_equal(child->nwk.nib.seq, (uint8_t)(seq + 1));
	zassert_equal(sent[0].len, 8 + ZZB_NWK_AUX_LEN + sizeof(nsdu) + ZZB_SEC_MIC_LEN);

	receive(parent, sent[0].data, sent[0].len, CHILD_SHORT);
	zassert_equal(zzb_nlde_data_ind_fake.call_count, 1);
	zassert_equal_ptr(zzb_nlde_data_ind_fake.arg0_val, parent);
	zassert_equal(zzb_nlde_data_ind_fake.arg2_val, PARENT_SHORT);
	zassert_equal(zzb_nlde_data_ind_fake.arg3_val, CHILD_SHORT);
	zassert_true(zzb_nlde_data_ind_fake.arg4_val);
	zassert_equal(data_ind.len, sizeof(nsdu));
	zassert_mem_equal(data_ind.data, nsdu, sizeof(nsdu));
	zassert_equal(zzb_nwk_neighbor_find_short(parent, CHILD_SHORT)->lqi, 200);
}

/* With the 9-byte MAC header of a NWK frame the secured frame fills aMaxPHYPacketSize - FCS */
ZTEST(zzb_nwk_data, test_longest_nsdu_fits_the_buffer)
{
	struct net_buf *buf = zzb_buf_alloc(K_NO_WAIT);
	const size_t len = 125 - 9 - 8 - ZZB_NWK_AUX_LEN - ZZB_SEC_MIC_LEN;

	zassert_not_null(buf);
	net_buf_reserve(buf, ZZB_NLDE_HEADROOM);
	zassert_true(net_buf_tailroom(buf) >= len + ZZB_SEC_MIC_LEN);
	memset(net_buf_add(buf, len), 0x5a, len);
	zzb_frame_meta(buf)->handle = HANDLE;

	zassert_ok(zzb_nlde_data_req(child, buf, PARENT_SHORT, 0, true));
	zassert_equal(sent[0].len, 125 - 9);
}

/* A neighbor is the next hop; the radius is the one requested */
ZTEST(zzb_nwk_data, test_unicast_to_a_neighbor)
{
	struct zzb_nwk_hdr hdr;

	zassert_ok(zzb_nlde_data_req(parent, nsdu_buf(), CHILD_SHORT, 1, false));
	check_mac_dst(0, CHILD_SHORT, ZZB_FRAME_ACK_REQ);
	zassert_equal(zzb_nwk_hdr_parse(sent[0].data, sent[0].len, &hdr), 8);
	zassert_equal(hdr.flags, ZZB_NWK_DISCOVER_ROUTE);
	zassert_equal(hdr.radius, 1);
	zassert_equal(sent[0].len, 8 + sizeof(nsdu));
}

/* R22 3.6.5: MAC unicast to the parent without ACK request */
ZTEST(zzb_nwk_data, test_broadcast_goes_to_the_parent)
{
	struct zzb_nwk_hdr hdr;

	zassert_ok(zzb_nlde_data_req(child, nsdu_buf(), 0xfffd, 0, true));
	check_mac_dst(0, PARENT_SHORT, 0);
	zassert_equal(zzb_nwk_hdr_parse(sent[0].data, sent[0].len, &hdr), 8);
	zassert_equal(hdr.flags, ZZB_NWK_SECURITY);
	zassert_equal(hdr.dst, 0xfffd);
}

ZTEST(zzb_nwk_data, test_request_rejected)
{
	struct net_buf *buf = nsdu_buf();

	zassert_equal(zzb_nlde_data_req(child, buf, 0xfffe, 0, true), -EINVAL);
	net_buf_unref(buf);

	/* Handles from 0xf0 belong to NWK command frames */
	buf = nsdu_buf();
	zzb_frame_meta(buf)->handle = 0xf0;
	zassert_equal(zzb_nlde_data_req(child, buf, PARENT_SHORT, 0, true), -EINVAL);
	net_buf_unref(buf);

	/* The parent has no parent of its own */
	buf = nsdu_buf();
	zassert_equal(zzb_nlde_data_req(parent, buf, 0x5678, 0, true), -ENOTCONN);
	net_buf_unref(buf);

	buf = zzb_buf_alloc(K_NO_WAIT);
	net_buf_reserve(buf, ZZB_NLDE_HEADROOM - 1);
	zassert_equal(zzb_nlde_data_req(child, buf, PARENT_SHORT, 0, true), -EMSGSIZE);
	net_buf_unref(buf);

	zzb_nlme_set_short_addr(child, 0xffff);
	buf = nsdu_buf();
	zassert_equal(zzb_nlde_data_req(child, buf, PARENT_SHORT, 0, true), -ENOTCONN);
	net_buf_unref(buf);

	zassert_equal(zzb_mcps_data_req_fake.call_count, 0);
}

ZTEST(zzb_nwk_data, test_errors_are_returned)
{
	struct net_buf *buf = nsdu_buf();

	zzb_nwk_init(child);
	zzb_nlme_set_short_addr(child, CHILD_SHORT);
	zzb_nwk_neighbor_add(child, parent->eui64, PARENT_SHORT, ZZB_NWK_REL_PARENT);
	zassert_equal(zzb_nlde_data_req(child, buf, PARENT_SHORT, 0, true), -ENOENT, "no key");
	net_buf_unref(buf);

	zzb_mcps_data_req_fake.custom_fake = NULL;
	zzb_mcps_data_req_fake.return_val = -EMSGSIZE;
	buf = nsdu_buf();
	zassert_equal(zzb_nlde_data_req(child, buf, PARENT_SHORT, 0, false), -EMSGSIZE);
	net_buf_unref(buf);
}

ZTEST(zzb_nwk_data, test_confirm)
{
	zzb_mcps_data_conf(child, HANDLE, ZZB_MAC_STATUS_NO_ACK);

	zassert_equal(zzb_nlde_data_conf_fake.call_count, 1);
	zassert_equal_ptr(zzb_nlde_data_conf_fake.arg0_val, child);
	zassert_equal(zzb_nlde_data_conf_fake.arg1_val, HANDLE);
	zassert_equal(zzb_nlde_data_conf_fake.arg2_val, ZZB_MAC_STATUS_NO_ACK);

	/* The confirm of a NWK command frame stays in NWK */
	zzb_mcps_data_conf(child, 0xf0 | ZZB_NWK_CMD_ED_TIMEOUT_REQ, ZZB_MAC_STATUS_SUCCESS);
	zassert_equal(zzb_nlde_data_conf_fake.call_count, 1);
}

/* R22 3.6.2.2: APS takes the Transport Key from them */
ZTEST(zzb_nwk_data, test_unsecured_data_passes_while_the_key_is_pending)
{
	/* Data to 0x1234 and to 0xffff from 0x0000 */
	static const uint8_t unicast[] = {0x08, 0x00, 0x34, 0x12, 0x00, 0x00, 0x1e, 0x01, 0x42};
	static const uint8_t broadcast[] = {0x08, 0x00, 0xff, 0xff, 0x00, 0x00, 0x1e, 0x02, 0x42};

	receive(child, unicast, sizeof(unicast), PARENT_SHORT);
	zassert_equal(zzb_nlde_data_ind_fake.call_count, 0);

	child->nwk.key_pending = true;
	receive(child, unicast, sizeof(unicast), PARENT_SHORT);
	zassert_equal(zzb_nlde_data_ind_fake.call_count, 1);
	zassert_false(zzb_nlde_data_ind_fake.arg4_val);
	zassert_equal(data_ind.len, 1);
	zassert_equal(data_ind.data[0], 0x42);
	zassert_equal(data_ind.meta.lqi, 200);

	receive(child, broadcast, sizeof(broadcast), PARENT_SHORT);
	zassert_equal(zzb_nlde_data_ind_fake.call_count, 2);
	zassert_equal(zzb_nlde_data_ind_fake.arg2_val, 0xffff);

	zzb_nlme_set_nwk_key(child, test_key, 1);
	receive(child, unicast, sizeof(unicast), PARENT_SHORT);
	zassert_equal(zzb_nlde_data_ind_fake.call_count, 2);
}

ZTEST(zzb_nwk_data, test_frames_are_dropped)
{
	static const uint8_t truncated[] = {0x08, 0x00, 0x34};
	/* To another device, to routers only, from the node itself, and a leave command */
	static const uint8_t other_dst[] = {0x08, 0x00, 0x78, 0x56, 0x00, 0x00, 0x1e, 0x01, 0x42};
	static const uint8_t routers[] = {0x08, 0x00, 0xfc, 0xff, 0x00, 0x00, 0x1e, 0x02, 0x42};
	static const uint8_t own_src[] = {0x08, 0x00, 0xff, 0xff, 0x34, 0x12, 0x1e, 0x03, 0x42};
	static const uint8_t command[] = {0x09, 0x00, 0x34, 0x12, 0x00,
					  0x00, 0x01, 0x04, 0x04, 0x00};

	receive(child, truncated, sizeof(truncated), PARENT_SHORT);
	receive(child, other_dst, sizeof(other_dst), PARENT_SHORT);
	receive(child, routers, sizeof(routers), PARENT_SHORT);
	receive(child, own_src, sizeof(own_src), PARENT_SHORT);
	receive(child, command, sizeof(command), PARENT_SHORT);

	/* A secured frame with a modified MIC */
	zassert_ok(zzb_nlde_data_req(child, nsdu_buf(), PARENT_SHORT, 0, true));
	sent[0].data[sent[0].len - 1] ^= 0x01;
	receive(parent, sent[0].data, sent[0].len, CHILD_SHORT);

	zassert_equal(zzb_nlde_data_ind_fake.call_count, 0);
}

/*
 * R22 3.6.6: a multicast data frame goes up as a broadcast, since APS checks the group. The group
 * ID here equals the address of the node; a multicast command is dropped.
 */
ZTEST(zzb_nwk_data, test_multicast)
{
	struct zzb_nwk_hdr hdr = {
		.type = ZZB_NWK_FRAME_DATA,
		.flags = ZZB_NWK_SECURITY | ZZB_NWK_MULTICAST,
		.dst = CHILD_SHORT,
		.src = PARENT_SHORT,
		.radius = 1,
	};
	const struct zzb_nwk_cmd status = {
		.id = ZZB_NWK_CMD_NWK_STATUS,
		.nwk_status = {.code = 0x0d, .has_addr = true, .addr = 0x5678},
	};

	receive_frame(child, parent, &hdr, nsdu, sizeof(nsdu));
	zassert_equal(zzb_nlde_data_ind_fake.call_count, 1);
	zassert_equal(zzb_nlde_data_ind_fake.arg2_val, 0xfffd);
	zassert_equal(zzb_nlde_data_ind_fake.arg3_val, PARENT_SHORT);
	zassert_equal(data_ind.len, sizeof(nsdu));

	hdr.type = ZZB_NWK_FRAME_CMD;
	receive_cmd(child, parent, &hdr, &status);
	zassert_equal(zzb_nlme_nwk_status_ind_fake.call_count, 0);
}

/* R22 Table 3-69 and 3.6.6: 0xfffd and multicast frames go to devices with macRxOnWhenIdle TRUE */
ZTEST(zzb_nwk_data, test_sleepy_node_drops_frames_to_receivers_on_when_idle)
{
	struct zzb_nwk_hdr hdr = {
		.type = ZZB_NWK_FRAME_DATA,
		.flags = ZZB_NWK_SECURITY,
		.dst = 0xfffd,
		.src = PARENT_SHORT,
		.radius = 1,
	};

	child->sleepy = true;
	receive_frame(child, parent, &hdr, nsdu, sizeof(nsdu));
	hdr.flags |= ZZB_NWK_MULTICAST;
	hdr.dst = 0x0001;
	receive_frame(child, parent, &hdr, nsdu, sizeof(nsdu));
	zassert_equal(zzb_nlde_data_ind_fake.call_count, 0);

	hdr.flags = ZZB_NWK_SECURITY;
	hdr.dst = 0xffff;
	receive_frame(child, parent, &hdr, nsdu, sizeof(nsdu));
	zassert_equal(zzb_nlde_data_ind_fake.call_count, 1);
	zassert_equal(zzb_nlde_data_ind_fake.arg2_val, 0xffff);
	hdr.dst = CHILD_SHORT;
	receive_frame(child, parent, &hdr, nsdu, sizeof(nsdu));
	zassert_equal(zzb_nlde_data_ind_fake.call_count, 2);
	zassert_equal(zzb_nlde_data_ind_fake.arg2_val, CHILD_SHORT);
}

/* R22 3.6.2.2 step 1 */
ZTEST(zzb_nwk_data, test_end_device_drops_frames_with_end_device_initiator)
{
	const struct zzb_nwk_hdr hdr = {
		.type = ZZB_NWK_FRAME_DATA,
		.flags = ZZB_NWK_SECURITY | ZZB_NWK_ED_INITIATOR,
		.dst = CHILD_SHORT,
		.src = PARENT_SHORT,
		.radius = 1,
	};

	receive_frame(child, parent, &hdr, nsdu, sizeof(nsdu));
	zassert_equal(zzb_nlde_data_ind_fake.call_count, 0);
}

ZTEST_SUITE(zzb_nwk_data, NULL, setup, before, after, NULL);
```

## src/ed_timeout.c
```c
/* SPDX-License-Identifier: Apache-2.0 */

#include <errno.h>
#include <zephyr/net_buf.h>
#include <zephyr/ztest.h>

#include "common/buf.h"
#include "common/node.h"
#include "fakes.h"
#include "nwk/frame.h"
#include "nwk/nwk.h"

/* Node 0 is the child of node 1 */
static struct zzb_node *child;
static struct zzb_node *parent;

static void *setup(void)
{
	child = test_node(0);
	parent = test_node(1);
	return NULL;
}

static void before(void *fixture)
{
	delete_nwk_records();
	reset_fakes();
	pair_nodes(child, parent);
}

static void after(void *fixture)
{
	child->sleepy = false;
	check_no_buffer_leak();
}

/* The network key arrives after an association join */
static void receive_key(void)
{
	child->nwk.key_pending = true;
	zzb_nlme_set_nwk_key(child, test_key, 0);
	run_stack();
}

static void receive_rsp(uint8_t status, uint8_t parent_info, uint64_t src_ext)
{
	const struct zzb_nwk_hdr hdr = {
		.type = ZZB_NWK_FRAME_CMD,
		.flags = ZZB_NWK_SECURITY | ZZB_NWK_SRC_IEEE | ZZB_NWK_DST_IEEE,
		.dst = CHILD_SHORT,
		.src = PARENT_SHORT,
		.radius = 1,
		.dst_ext = child->eui64,
		.src_ext = src_ext,
	};
	const struct zzb_nwk_cmd cmd = {
		.id = ZZB_NWK_CMD_ED_TIMEOUT_RSP,
		.ed_timeout_rsp = {.status = status, .parent_info = parent_info},
	};

	receive_cmd(child, parent, &hdr, &cmd);
}

/* R22 3.6.10.2 and 3.4.11 */
ZTEST(zzb_nwk_ed_timeout, test_request_follows_the_network_key)
{
	struct zzb_nwk_hdr hdr;
	struct zzb_nwk_cmd cmd;

	receive_key();
	zassert_equal(zzb_mcps_data_req_fake.call_count, 1);
	zassert_equal(sent[0].meta.dst.short_addr, PARENT_SHORT);
	zassert_equal(sent[0].meta.flags, ZZB_FRAME_ACK_REQ);
	zassert_equal(sent[0].meta.handle, 0xf0 | ZZB_NWK_CMD_ED_TIMEOUT_REQ);

	parse_sent_cmd(0, parent, &hdr, &cmd);
	zassert_equal(hdr.type, ZZB_NWK_FRAME_CMD);
	zassert_equal(hdr.flags, ZZB_NWK_SECURITY | ZZB_NWK_SRC_IEEE | ZZB_NWK_DST_IEEE);
	zassert_equal(hdr.dst, PARENT_SHORT);
	zassert_equal(hdr.src, CHILD_SHORT);
	zassert_equal(hdr.radius, 1);
	zassert_equal(hdr.src_ext, child->eui64);
	zassert_equal(hdr.dst_ext, parent->eui64);
	zassert_equal(cmd.id, ZZB_NWK_CMD_ED_TIMEOUT_REQ);
	zassert_equal(cmd.ed_timeout_req.timeout, CONFIG_ZZB_NWK_ED_TIMEOUT);
	zassert_equal(cmd.ed_timeout_req.config, 0);
}

/* The scheduler polls macResponseWaitTime after the request instead of the long interval */
ZTEST(zzb_nwk_ed_timeout, test_sleepy_node_polls_for_the_response)
{
	child->sleepy = true;
	zzb_nwk_poll_start(child);
	receive_key();
	zassert_equal(zzb_mcps_data_req_fake.call_count, 1);

	k_sleep(K_MSEC(400));
	zassert_equal(zzb_mlme_poll_req_fake.call_count, 0);
	k_sleep(K_MSEC(200));
	zassert_equal(zzb_mlme_poll_req_fake.call_count, 1);
	zassert_equal(poll_coord.short_addr, PARENT_SHORT);
}

/* A key update on the network sends no request */
ZTEST(zzb_nwk_ed_timeout, test_no_request_without_a_pending_key)
{
	zzb_nlme_set_nwk_key(child, test_key, 1);
	run_stack();
	zassert_equal(zzb_mcps_data_req_fake.call_count, 0);
}

ZTEST(zzb_nwk_ed_timeout, test_request_is_retried_without_a_buffer)
{
	struct net_buf *bufs[CONFIG_ZZB_BUF_COUNT];

	ARRAY_FOR_EACH(bufs, i) {
		bufs[i] = zzb_buf_alloc(K_NO_WAIT);
	}

	receive_key();
	ARRAY_FOR_EACH(bufs, i) {
		net_buf_unref(bufs[i]);
	}

	zassert_equal(zzb_mcps_data_req_fake.call_count, 0);
	k_sleep(K_MSEC(900));
	zassert_equal(zzb_mcps_data_req_fake.call_count, 0);
	k_sleep(K_MSEC(200));
	zassert_equal(zzb_mcps_data_req_fake.call_count, 1);
}

/* R22 3.6.10.2: the parent information sets the end device initiator bit (3.3.1.1.9) */
ZTEST(zzb_nwk_ed_timeout, test_response_sets_the_parent_information)
{
	static const uint8_t nsdu[] = {0x42};
	struct net_buf *buf = zzb_buf_alloc(K_NO_WAIT);
	struct zzb_nwk_hdr hdr;

	uint8_t rec[64];

	receive_rsp(0x00, 0x03, parent->eui64);
	zassert_equal(child->nwk.nib.parent_info, 0x03);
	zassert_equal(load_record("nwk/net", rec, sizeof(rec)), 28);
	zassert_equal(rec[NET_PARENT_INFO], 0x03);

	zassert_not_null(buf);
	net_buf_reserve(buf, ZZB_NLDE_HEADROOM);
	net_buf_add_mem(buf, nsdu, sizeof(nsdu));
	zassert_ok(zzb_nlde_data_req(child, buf, PARENT_SHORT, 0, true));
	zassert_true(zzb_nwk_hdr_parse(sent[0].data, sent[0].len, &hdr) > 0);
	zassert_true(hdr.flags & ZZB_NWK_ED_INITIATOR);
}

ZTEST(zzb_nwk_ed_timeout, test_other_responses_are_ignored)
{
	/* INCORRECT_VALUE, and a source IEEE address other than the parent's */
	receive_rsp(0x01, 0x03, parent->eui64);
	receive_rsp(0x00, 0x03, 0x0102030405060708ULL);
	zassert_equal(child->nwk.nib.parent_info, 0);
}

/* Timeout / 3 for the 10 s of CONFIG_ZZB_NWK_ED_TIMEOUT=0 (R22 3.6.10.3) */
#define PERIOD_MS 3333

/* R22 3.6.10.3: bit 0 of the parent information selects MAC data poll keepalives */
ZTEST(zzb_nwk_ed_timeout, test_keepalive_polls_the_parent)
{
	receive_rsp(0x00, 0x03, parent->eui64);

	k_sleep(K_MSEC(PERIOD_MS - 50));
	zassert_equal(zzb_mlme_poll_req_fake.call_count, 0);
	k_sleep(K_MSEC(100));
	zassert_equal(zzb_mlme_poll_req_fake.call_count, 1);
	zassert_equal_ptr(zzb_mlme_poll_req_fake.arg0_val, child);
	zassert_equal(poll_coord.mode, ZZB_MAC_ADDR_SHORT);
	zassert_equal(poll_coord.pan_id, PAN_ID);
	zassert_equal(poll_coord.short_addr, PARENT_SHORT);

	k_sleep(K_MSEC(PERIOD_MS));
	zassert_equal(zzb_mlme_poll_req_fake.call_count, 2);
	zassert_equal(zzb_mcps_data_req_fake.call_count, 0);
}

/* A poll that cannot start is tried again after 1 s */
ZTEST(zzb_nwk_ed_timeout, test_busy_poll_is_retried)
{
	zzb_mlme_poll_req_fake.return_val = -EBUSY;
	receive_rsp(0x00, 0x01, parent->eui64);

	k_sleep(K_MSEC(PERIOD_MS + 50));
	zassert_equal(zzb_mlme_poll_req_fake.call_count, 1);
	zzb_mlme_poll_req_fake.return_val = 0;
	k_sleep(K_MSEC(1000));
	zassert_equal(zzb_mlme_poll_req_fake.call_count, 2);
	k_sleep(K_MSEC(PERIOD_MS - 100));
	zassert_equal(zzb_mlme_poll_req_fake.call_count, 2);
}

/* With bit 1 the keepalive is an End Device Timeout Request answered in macResponseWaitTime */
ZTEST(zzb_nwk_ed_timeout, test_keepalive_without_response_reports_parent_link_failure)
{
	struct zzb_nwk_hdr hdr;
	struct zzb_nwk_cmd cmd;

	receive_rsp(0x00, 0x02, parent->eui64);
	k_sleep(K_MSEC(PERIOD_MS + 50));
	zassert_equal(zzb_mcps_data_req_fake.call_count, 1);
	parse_sent_cmd(0, parent, &hdr, &cmd);
	zassert_equal(cmd.id, ZZB_NWK_CMD_ED_TIMEOUT_REQ);
	zassert_true(hdr.flags & ZZB_NWK_ED_INITIATOR);

	receive_rsp(0x00, 0x02, parent->eui64);
	k_sleep(K_MSEC(PERIOD_MS));
	zassert_equal(zzb_mcps_data_req_fake.call_count, 2);
	zassert_equal(zzb_nlme_nwk_status_ind_fake.call_count, 0);

	/* macResponseWaitTime, 491.52 ms */
	k_sleep(K_MSEC(500));
	zassert_equal(zzb_nlme_nwk_status_ind_fake.call_count, 1);
	zassert_equal(zzb_nlme_nwk_status_ind_fake.arg1_val, 0x09);
	zassert_equal(zzb_nlme_nwk_status_ind_fake.arg2_val, PARENT_SHORT);

	/* The keepalive has stopped */
	k_sleep(K_MSEC(2 * PERIOD_MS));
	zassert_equal(zzb_mcps_data_req_fake.call_count, 2);
}

/* A response 1.5 x macResponseWaitTime after the request, fetched by the poll, is accepted */
ZTEST(zzb_nwk_ed_timeout, test_sleepy_keepalive_takes_a_response_after_the_poll)
{
	child->sleepy = true;
	receive_rsp(0x00, 0x02, parent->eui64);
	k_sleep(K_MSEC(PERIOD_MS + 50));
	zassert_equal(zzb_mcps_data_req_fake.call_count, 1);

	k_sleep(K_MSEC(600));
	zassert_equal(zzb_mlme_poll_req_fake.call_count, 1);
	zassert_equal(zzb_nlme_nwk_status_ind_fake.call_count, 0);
	k_sleep(K_MSEC(100));
	receive_rsp(0x00, 0x02, parent->eui64);
	k_sleep(K_MSEC(400));
	zassert_equal(zzb_nlme_nwk_status_ind_fake.call_count, 0);
}

ZTEST(zzb_nwk_ed_timeout, test_sleepy_keepalive_waits_twice_the_response_time)
{
	child->sleepy = true;
	receive_rsp(0x00, 0x02, parent->eui64);
	k_sleep(K_MSEC(PERIOD_MS + 50));
	zassert_equal(zzb_mcps_data_req_fake.call_count, 1);

	/* 2 x macResponseWaitTime, 983.04 ms */
	k_sleep(K_MSEC(800));
	zassert_equal(zzb_nlme_nwk_status_ind_fake.call_count, 0);
	k_sleep(K_MSEC(200));
	zassert_equal(zzb_nlme_nwk_status_ind_fake.call_count, 1);
	zassert_equal(zzb_nlme_nwk_status_ind_fake.arg1_val, 0x09);
}

ZTEST(zzb_nwk_ed_timeout, test_failed_keepalive_response_reports_parent_link_failure)
{
	receive_rsp(0x00, 0x02, parent->eui64);
	k_sleep(K_MSEC(PERIOD_MS + 50));
	receive_rsp(0x01, 0x02, parent->eui64);

	zassert_equal(zzb_nlme_nwk_status_ind_fake.call_count, 1);
	zassert_equal(zzb_nlme_nwk_status_ind_fake.arg1_val, 0x09);
	k_sleep(K_MSEC(2 * PERIOD_MS));
	zassert_equal(zzb_mcps_data_req_fake.call_count, 1);
}

ZTEST(zzb_nwk_ed_timeout, test_no_keepalive_without_parent_support)
{
	receive_rsp(0x00, 0x00, parent->eui64);
	k_sleep(K_MSEC(2 * PERIOD_MS));

	zassert_equal(zzb_mlme_poll_req_fake.call_count, 0);
	zassert_equal(zzb_mcps_data_req_fake.call_count, 0);
}

ZTEST_SUITE(zzb_nwk_ed_timeout, NULL, setup, before, after, NULL);
```

## src/fakes.c
```c
/* SPDX-License-Identifier: Apache-2.0 */

#include <string.h>
#include <zephyr/fff.h>
#include <zephyr/settings/settings.h>
#include <zephyr/sys/printk.h>
#include <zephyr/ztest.h>
#include <zzb/zzb.h>

#include "common/node.h"
#include "common/queue.h"
#include "fakes.h"
#include "storage/settings.h"

DEFINE_FFF_GLOBALS;

DEFINE_FAKE_VOID_FUNC(zzb_mlme_set_pan_id, struct zzb_node *, uint16_t);
DEFINE_FAKE_VOID_FUNC(zzb_mlme_set_short_addr, struct zzb_node *, uint16_t);
DEFINE_FAKE_VALUE_FUNC(int, zzb_mcps_data_req, struct zzb_node *, struct net_buf *);
DEFINE_FAKE_VOID_FUNC(zzb_nlde_data_conf, struct zzb_node *, uint8_t, enum zzb_mac_status);
DEFINE_FAKE_VOID_FUNC(zzb_nlde_data_ind, struct zzb_node *, struct net_buf *, uint16_t, uint16_t,
		      bool);
DEFINE_FAKE_VALUE_FUNC(int, zzb_mlme_scan_req, struct zzb_node *, uint32_t, uint8_t);
DEFINE_FAKE_VOID_FUNC(zzb_nlme_network_discovery_conf, struct zzb_node *, uint8_t,
		      const struct zzb_nwk_network *, size_t);
DEFINE_FAKE_VALUE_FUNC(int, zzb_mlme_assoc_req, struct zzb_node *, uint8_t,
		       const struct zzb_mac_addr *, uint8_t);
DEFINE_FAKE_VALUE_FUNC(uint64_t, zzb_mlme_get_coord_ext_addr, const struct zzb_node *);
DEFINE_FAKE_VOID_FUNC(zzb_nlme_join_conf, struct zzb_node *, uint8_t);
DEFINE_FAKE_VOID_FUNC(zzb_nlme_nwk_status_ind, struct zzb_node *, uint8_t, uint16_t);
DEFINE_FAKE_VALUE_FUNC(int, zzb_mlme_poll_req, struct zzb_node *, const struct zzb_mac_addr *);
DEFINE_FAKE_VALUE_FUNC(int, zzb_mlme_set_channel, struct zzb_node *, uint8_t);
DEFINE_FAKE_VOID_FUNC(zzb_nlme_leave_conf, struct zzb_node *, uint8_t);
DEFINE_FAKE_VOID_FUNC(zzb_nlme_leave_ind, struct zzb_node *, uint64_t, bool);

const uint8_t test_key[ZZB_SEC_KEY_LEN] = {0x01, 0x02, 0x03};

struct frame_copy sent[8];
struct frame_copy data_ind;
struct zzb_mac_addr assoc_coord;
struct zzb_mac_addr poll_coord;
uint8_t receive_flags;

static void copy_frame(struct frame_copy *copy, struct net_buf *buf)
{
	zassert_true(buf->len <= sizeof(copy->data));
	memcpy(copy->data, buf->data, buf->len);
	copy->len = buf->len;
	copy->meta = *zzb_frame_meta(buf);
}

static int mcps_data_req_take(struct zzb_node *node, struct net_buf *buf)
{
	zassert_true(zzb_mcps_data_req_fake.call_count <= ARRAY_SIZE(sent));
	copy_frame(&sent[zzb_mcps_data_req_fake.call_count - 1], buf);
	net_buf_unref(buf);
	return 0;
}

static int assoc_req_copy(struct zzb_node *node, uint8_t channel, const struct zzb_mac_addr *coord,
			  uint8_t capability)
{
	assoc_coord = *coord;
	return zzb_mlme_assoc_req_fake.return_val;
}

static int poll_req_copy(struct zzb_node *node, const struct zzb_mac_addr *coord)
{
	poll_coord = *coord;
	return zzb_mlme_poll_req_fake.return_val;
}

static void nlde_data_ind_take(struct zzb_node *node, struct net_buf *buf, uint16_t dst_addr,
			       uint16_t src_addr, bool security_use)
{
	copy_frame(&data_ind, buf);
	net_buf_unref(buf);
}

struct zzb_node *test_node(int index)
{
	static const uint64_t eui64[] = {NODE_EUI64, SENDER_EUI64};
	static struct zzb_node *nodes[ARRAY_SIZE(eui64)];

	if (nodes[0] == NULL) {
		ARRAY_FOR_EACH(nodes, i) {
			const struct zzb_node_config cfg = {
				.eui64 = eui64[i],
			};

			zassert_ok(zzb_node_init(&cfg, &nodes[i]));
		}
	}

	return nodes[index];
}

void reset_fakes(void)
{
	RESET_FAKE(zzb_mlme_set_pan_id);
	RESET_FAKE(zzb_mlme_set_short_addr);
	RESET_FAKE(zzb_mcps_data_req);
	RESET_FAKE(zzb_nlde_data_conf);
	RESET_FAKE(zzb_nlde_data_ind);
	RESET_FAKE(zzb_mlme_scan_req);
	RESET_FAKE(zzb_nlme_network_discovery_conf);
	RESET_FAKE(zzb_mlme_assoc_req);
	RESET_FAKE(zzb_mlme_get_coord_ext_addr);
	RESET_FAKE(zzb_nlme_join_conf);
	RESET_FAKE(zzb_nlme_nwk_status_ind);
	RESET_FAKE(zzb_mlme_poll_req);
	RESET_FAKE(zzb_mlme_set_channel);
	RESET_FAKE(zzb_nlme_leave_conf);
	RESET_FAKE(zzb_nlme_leave_ind);
	FFF_RESET_HISTORY();
	receive_flags = 0;

	zzb_mcps_data_req_fake.custom_fake = mcps_data_req_take;
	zzb_nlde_data_ind_fake.custom_fake = nlde_data_ind_take;
	zzb_mlme_assoc_req_fake.custom_fake = assoc_req_copy;
	zzb_mlme_poll_req_fake.custom_fake = poll_req_copy;
}

void check_no_buffer_leak(void)
{
	struct net_buf *bufs[CONFIG_ZZB_BUF_COUNT];

	ARRAY_FOR_EACH(bufs, i) {
		bufs[i] = zzb_buf_alloc(K_NO_WAIT);
		zassert_not_null(bufs[i], "buffer leak");
	}

	ARRAY_FOR_EACH(bufs, i) {
		net_buf_unref(bufs[i]);
	}
}

static void join(struct zzb_node *node, uint16_t short_addr, struct zzb_node *peer,
		 uint16_t peer_short, enum zzb_nwk_relationship relationship)
{
	zzb_nwk_init(node);
	zassert_ok(zzb_fc_start(&node->nwk.fc));
	zzb_nlme_set_pan_id(node, PAN_ID);
	zzb_nlme_set_short_addr(node, short_addr);
	zzb_nlme_set_ext_pan_id(node, EXT_PAN_ID);
	zzb_nlme_set_nwk_key(node, test_key, 0);
	zassert_not_null(zzb_nwk_neighbor_add(node, peer->eui64, peer_short, relationship));
}

int load_record(const char *key, uint8_t *rec, size_t len)
{
	char name[32];
	int ret;

	snprintk(name, sizeof(name), "zzb/0/%s", key);
	ret = settings_load_one(name, rec, len);
	return ret < 0 ? 0 : ret;
}

void delete_nwk_records(void)
{
	settings_delete("zzb/0/nwk/net");
	settings_delete("zzb/0/nwk/keys");
}

struct reboot_call {
	struct k_work work;
	int err;
};

static void reboot_handler(struct k_work *work)
{
	struct reboot_call *call = CONTAINER_OF(work, struct reboot_call, work);

	zzb_nwk_init(test_node(0));
	call->err = zzb_settings_load(test_node(0));
}

int nwk_reboot(void)
{
	struct reboot_call call = {0};

	reset_fakes();
	zzb_call_sync(&call.work, reboot_handler);
	return call.err;
}

/* The test thread is cooperative and has a lower priority than the stack thread */
void run_stack(void)
{
	k_yield();
}

void parse_sent_cmd(int i, struct zzb_node *receiver, struct zzb_nwk_hdr *hdr,
		    struct zzb_nwk_cmd *cmd)
{
	struct net_buf *buf = zzb_buf_alloc(K_NO_WAIT);
	int hdr_len;

	zassert_not_null(buf);
	net_buf_add_mem(buf, sent[i].data, sent[i].len);
	hdr_len = zzb_nwk_hdr_parse(buf->data, buf->len, hdr);
	zassert_true(hdr_len > 0);
	if (hdr->flags & ZZB_NWK_SECURITY) {
		zassert_ok(zzb_nwk_unsecure(receiver, buf, hdr_len));
	}

	zassert_true(zzb_nwk_cmd_parse(buf->data + hdr_len, buf->len - hdr_len, cmd) > 0);
	net_buf_unref(buf);
}

void pair_nodes(struct zzb_node *child, struct zzb_node *parent)
{
	join(child, CHILD_SHORT, parent, PARENT_SHORT, ZZB_NWK_REL_PARENT);
	join(parent, PARENT_SHORT, child, CHILD_SHORT, ZZB_NWK_REL_CHILD);
}

static void deliver(struct zzb_node *node, struct net_buf *buf, uint16_t src)
{
	struct zzb_frame_meta *meta = zzb_frame_meta(buf);

	meta->src = (struct zzb_mac_addr){
		.mode = ZZB_MAC_ADDR_SHORT,
		.pan_id = PAN_ID,
		.short_addr = src,
	};
	meta->lqi = 200;
	meta->flags = receive_flags;
	zzb_mcps_data_ind(node, buf);
}

void receive(struct zzb_node *node, const uint8_t *frame, size_t len, uint16_t src)
{
	struct net_buf *buf = zzb_buf_alloc(K_NO_WAIT);

	zassert_not_null(buf);
	net_buf_add_mem(buf, frame, len);
	deliver(node, buf, src);
}

void receive_frame(struct zzb_node *node, struct zzb_node *sender, const struct zzb_nwk_hdr *hdr,
		   const uint8_t *payload, size_t len)
{
	struct net_buf *buf = zzb_buf_alloc(K_NO_WAIT);
	size_t hdr_len = zzb_nwk_hdr_len(hdr);

	zassert_not_null(buf);
	net_buf_reserve(buf, ZZB_NWK_AUX_LEN);
	zzb_nwk_hdr_write(hdr, net_buf_add(buf, hdr_len));
	net_buf_add_mem(buf, payload, len);
	if (hdr->flags & ZZB_NWK_SECURITY) {
		zassert_ok(zzb_nwk_secure(sender, buf, hdr_len));
	}

	deliver(node, buf, sender->nwk.nib.short_addr);
}

void receive_cmd(struct zzb_node *node, struct zzb_node *sender, const struct zzb_nwk_hdr *hdr,
		 const struct zzb_nwk_cmd *cmd)
{
	uint8_t payload[ZZB_BUF_SIZE];

	receive_frame(node, sender, hdr, payload, zzb_nwk_cmd_write(cmd, payload));
}

void notify_beacon(struct zzb_node *node, const struct zzb_nwk_beacon *beacon, uint16_t pan_id,
		   uint16_t short_addr, uint8_t channel, uint16_t superframe, uint8_t lqi)
{
	struct net_buf *buf = zzb_buf_alloc(K_NO_WAIT);
	struct zzb_frame_meta *meta;

	zassert_not_null(buf);
	zzb_nwk_beacon_write(beacon, net_buf_add(buf, ZZB_NWK_BEACON_LEN));
	meta = zzb_frame_meta(buf);
	meta->src = (struct zzb_mac_addr){
		.mode = ZZB_MAC_ADDR_SHORT,
		.pan_id = pan_id,
		.short_addr = short_addr,
	};
	meta->lqi = lqi;
	zzb_mlme_beacon_notify_ind(node, buf, channel, superframe);
}
```

## src/fakes.h
```c
/* SPDX-License-Identifier: Apache-2.0 */

#ifndef ZZB_TESTS_UNIT_NWK_FAKES_H_
#define ZZB_TESTS_UNIT_NWK_FAKES_H_

#include <stdbool.h>
#include <stddef.h>
#include <stdint.h>
#include <zephyr/fff.h>
#include <zephyr/net_buf.h>

#include "common/buf.h"
#include "mac/mac.h"
#include "nwk/frame.h"
#include "nwk/nwk.h"

DECLARE_FAKE_VOID_FUNC(zzb_mlme_set_pan_id, struct zzb_node *, uint16_t);
DECLARE_FAKE_VOID_FUNC(zzb_mlme_set_short_addr, struct zzb_node *, uint16_t);
DECLARE_FAKE_VALUE_FUNC(int, zzb_mcps_data_req, struct zzb_node *, struct net_buf *);
DECLARE_FAKE_VOID_FUNC(zzb_nlde_data_conf, struct zzb_node *, uint8_t, enum zzb_mac_status);
DECLARE_FAKE_VOID_FUNC(zzb_nlde_data_ind, struct zzb_node *, struct net_buf *, uint16_t, uint16_t,
		       bool);
DECLARE_FAKE_VALUE_FUNC(int, zzb_mlme_scan_req, struct zzb_node *, uint32_t, uint8_t);
DECLARE_FAKE_VOID_FUNC(zzb_nlme_network_discovery_conf, struct zzb_node *, uint8_t,
		       const struct zzb_nwk_network *, size_t);
DECLARE_FAKE_VALUE_FUNC(int, zzb_mlme_assoc_req, struct zzb_node *, uint8_t,
			const struct zzb_mac_addr *, uint8_t);
DECLARE_FAKE_VALUE_FUNC(uint64_t, zzb_mlme_get_coord_ext_addr, const struct zzb_node *);
DECLARE_FAKE_VOID_FUNC(zzb_nlme_join_conf, struct zzb_node *, uint8_t);
DECLARE_FAKE_VOID_FUNC(zzb_nlme_nwk_status_ind, struct zzb_node *, uint8_t, uint16_t);
DECLARE_FAKE_VALUE_FUNC(int, zzb_mlme_poll_req, struct zzb_node *, const struct zzb_mac_addr *);
DECLARE_FAKE_VALUE_FUNC(int, zzb_mlme_set_channel, struct zzb_node *, uint8_t);
DECLARE_FAKE_VOID_FUNC(zzb_nlme_leave_conf, struct zzb_node *, uint8_t);
DECLARE_FAKE_VOID_FUNC(zzb_nlme_leave_ind, struct zzb_node *, uint64_t, bool);

/* Copy of a frame passed to MCPS-DATA.request or NLDE-DATA.indication */
struct frame_copy {
	uint8_t data[ZZB_BUF_SIZE];
	size_t len;
	struct zzb_frame_meta meta;
};

/* By default the zzb_mcps_data_req() fake takes the buffer and copies the frame here */
extern struct frame_copy sent[8];
extern struct frame_copy data_ind;

/* Coordinator of the last MLME-ASSOCIATE.request and MLME-POLL.request */
extern struct zzb_mac_addr assoc_coord;
extern struct zzb_mac_addr poll_coord;

/* Checks that every frame buffer is free */
void check_no_buffer_leak(void);

/* The test network of pair_nodes() */
#define PAN_ID       0x1a62
#define EXT_PAN_ID   0x00124b0000001a62ULL
#define CHILD_SHORT  0x1234
#define PARENT_SHORT 0x0000

extern const uint8_t test_key[ZZB_SEC_KEY_LEN];

#define NODE_EUI64   0x0011223344556677ULL
/* Source of the Ziggurat frame in tests/unit/sec (see NOTICE) */
#define SENDER_EUI64 0x00124b001e17efa8ULL

/* Node 0 has NODE_EUI64, node 1 SENDER_EUI64; both are initialized on the first call */
struct zzb_node *test_node(int index);

/* Resets every fake */
void reset_fakes(void);

/* Offsets in the record nwk/net */
#define NET_SHORT_ADDR   11
#define NET_PARENT_INFO  16
#define NET_PARENT_SHORT 17

/* Reads the record zzb/0/<key>; returns its length, 0 when there is none */
int load_record(const char *key, uint8_t *rec, size_t len);

/* Deletes the NWK records of node 0 */
void delete_nwk_records(void);

/* Resets the fakes, then does what zzb_node_init() does for NWK on boot for node 0 */
int nwk_reboot(void);

/* Runs the stack thread until it waits, without advancing the time */
void run_stack(void);

/* Unsecures a copy of sent frame i as receiver and parses its header and command */
void parse_sent_cmd(int i, struct zzb_node *receiver, struct zzb_nwk_hdr *hdr,
		    struct zzb_nwk_cmd *cmd);

/* Initializes both nodes and makes child the child of parent on the test network */
void pair_nodes(struct zzb_node *child, struct zzb_node *parent);

/* MAC flags of the frames that receive() and receive_frame() pass; reset_fakes() clears them */
extern uint8_t receive_flags;

/* Passes frame to node as MCPS-DATA.indication from the MAC source address src */
void receive(struct zzb_node *node, const uint8_t *frame, size_t len, uint16_t src);

/*
 * Passes a frame with hdr and payload from sender to node, secured by sender when hdr has
 * ZZB_NWK_SECURITY
 */
void receive_frame(struct zzb_node *node, struct zzb_node *sender, const struct zzb_nwk_hdr *hdr,
		   const uint8_t *payload, size_t len);
void receive_cmd(struct zzb_node *node, struct zzb_node *sender, const struct zzb_nwk_hdr *hdr,
		 const struct zzb_nwk_cmd *cmd);

/* Passes a beacon from short_addr in PAN pan_id as MLME-BEACON-NOTIFY.indication */
void notify_beacon(struct zzb_node *node, const struct zzb_nwk_beacon *beacon, uint16_t pan_id,
		   uint16_t short_addr, uint8_t channel, uint16_t superframe, uint8_t lqi);

#endif /* ZZB_TESTS_UNIT_NWK_FAKES_H_ */
```

## src/fc.c
```c
/* SPDX-License-Identifier: Apache-2.0 */

#include <errno.h>
#include <zephyr/settings/settings.h>
#include <zephyr/sys/byteorder.h>
#include <zephyr/ztest.h>

#include "common/node.h"
#include "common/queue.h"
#include "fakes.h"
#include "nwk/nwk.h"
#include "storage/settings.h"

#define JUMP CONFIG_ZZB_FRAME_COUNTER_JUMP
/* Node 0 */
#define KEY  "zzb/0/fc/nwk"

static struct zzb_node *node;

struct call {
	struct k_work work;
	int err;
	uint32_t count;
	uint32_t last;
};

/* What zzb_node_init() does for NWK on boot */
static void reboot_handler(struct k_work *work)
{
	struct call *call = CONTAINER_OF(work, struct call, work);

	zzb_nwk_init(node);
	call->err = zzb_settings_load(node);
	if (call->err == 0) {
		call->err = zzb_fc_start(&node->nwk.fc);
	}
}

static int reboot(void)
{
	struct call call = {0};

	zzb_call_sync(&call.work, reboot_handler);
	return call.err;
}

/* Takes counters on the stack thread until one fails, so a scheduled save cannot run between */
static void take_all_handler(struct k_work *work)
{
	struct call *call = CONTAINER_OF(work, struct call, work);
	uint32_t fc;

	while ((call->err = zzb_fc_next(&node->nwk.fc, &fc)) == 0) {
		call->count++;
		call->last = fc;
	}
}

static uint32_t next(void)
{
	uint32_t fc;

	zassert_ok(zzb_fc_next(&node->nwk.fc, &fc));
	return fc;
}

static uint32_t stored_watermark(void)
{
	uint8_t rec[5];

	zassert_equal(settings_load_one(KEY, rec, sizeof(rec)), sizeof(rec));
	zassert_equal(rec[0], 1);
	return sys_get_le32(rec + 1);
}

static void store(uint8_t version, uint32_t watermark)
{
	uint8_t rec[5] = {version};

	sys_put_le32(watermark, rec + 1);
	zassert_ok(settings_save_one(KEY, rec, sizeof(rec)));
}

static void *setup(void)
{
	node = test_node(0);
	return NULL;
}

static void before(void *fixture)
{
	/* A save scheduled by the previous test runs before the record is deleted */
	run_stack();
	settings_delete(KEY);
	delete_nwk_records();
	zassert_ok(reboot());
}

ZTEST(zzb_nwk_fc, test_first_boot)
{
	zassert_equal(next(), 0);
	zassert_equal(next(), 1);
	zassert_equal(stored_watermark(), JUMP);
}

/* Counters taken before a reboot are never used again */
ZTEST(zzb_nwk_fc, test_reboot_jumps_to_the_watermark)
{
	next();
	next();
	zassert_ok(reboot());

	zassert_equal(next(), JUMP);
	zassert_equal(stored_watermark(), 2 * JUMP);
}

ZTEST(zzb_nwk_fc, test_watermark_moves_at_half_jump)
{
	for (int i = 0; i < JUMP / 2; i++) {
		next();
	}

	run_stack();
	zassert_equal(stored_watermark(), JUMP / 2 + JUMP);

	for (int i = JUMP / 2; i <= JUMP; i++) {
		zassert_equal(next(), i);
	}
}

ZTEST(zzb_nwk_fc, test_busy_until_the_watermark_is_saved)
{
	struct call call = {0};

	zzb_call_sync(&call.work, take_all_handler);
	zassert_equal(call.err, -EBUSY);
	zassert_equal(call.count, JUMP);
	zassert_equal(call.last, JUMP - 1);

	/* Runs the save scheduled at JUMP / 2 */
	run_stack();
	zassert_equal(next(), JUMP);
}

ZTEST(zzb_nwk_fc, test_last_counter)
{
	uint32_t fc;

	store(1, UINT32_MAX - 1);
	zassert_ok(reboot());

	zassert_equal(next(), UINT32_MAX - 1);
	zassert_equal(zzb_fc_next(&node->nwk.fc, &fc), -EOVERFLOW);
}

ZTEST(zzb_nwk_fc, test_unknown_record_version)
{
	store(2, 100);
	zassert_equal(reboot(), -EINVAL);
}

ZTEST_SUITE(zzb_nwk_fc, NULL, setup, before, NULL, NULL);
```

## src/leave.c
```c
/* SPDX-License-Identifier: Apache-2.0 */

#include <errno.h>
#include <zephyr/net_buf.h>
#include <zephyr/ztest.h>

#include "common/buf.h"
#include "common/node.h"
#include "fakes.h"
#include "nwk/frame.h"
#include "nwk/nwk.h"

/* Node 0 is the child of node 1 */
static struct zzb_node *child;
static struct zzb_node *parent;

static void *setup(void)
{
	child = test_node(0);
	parent = test_node(1);
	return NULL;
}

static void before(void *fixture)
{
	delete_nwk_records();
	reset_fakes();
	pair_nodes(child, parent);
}

static void after(void *fixture)
{
	check_no_buffer_leak();
}

/* Checks the leave command in sent frame i and confirms it with status */
static void check_leave(int i, uint8_t options, enum zzb_mac_status status)
{
	struct zzb_nwk_hdr hdr;
	struct zzb_nwk_cmd cmd;

	zassert_equal(zzb_mcps_data_req_fake.call_count, i + 1);
	zassert_equal(sent[i].meta.dst.short_addr, PARENT_SHORT);
	zassert_equal(sent[i].meta.flags, ZZB_FRAME_ACK_REQ, "R22 3.4.4.1");
	zassert_equal(sent[i].meta.handle, 0xf0 | ZZB_NWK_CMD_LEAVE);

	parse_sent_cmd(i, parent, &hdr, &cmd);
	zassert_equal(hdr.type, ZZB_NWK_FRAME_CMD);
	zassert_equal(hdr.flags, ZZB_NWK_SECURITY | ZZB_NWK_SRC_IEEE);
	zassert_equal(hdr.dst, 0xfffd);
	zassert_equal(hdr.src, CHILD_SHORT);
	zassert_equal(hdr.radius, 1);
	zassert_equal(hdr.src_ext, child->eui64);
	zassert_equal(cmd.id, ZZB_NWK_CMD_LEAVE);
	zassert_equal(cmd.leave_options, options);

	zzb_mcps_data_conf(child, sent[i].meta.handle, status);
}

static void check_reset(void)
{
	const struct zzb_nib *nib = &child->nwk.nib;

	zassert_equal(nib->pan_id, 0xffff);
	zassert_equal(nib->short_addr, 0xffff);
	zassert_equal(nib->ext_pan_id, 0);
	zassert_false(nib->keys[0].valid);
	zassert_false(nib->keys[1].valid);
	zassert_is_null(zzb_nwk_neighbor_parent(child));
	zassert_false(k_work_delayable_is_pending(&child->nwk.keepalive));
	zassert_equal(zzb_mlme_set_pan_id_fake.arg1_val, 0xffff);
	zassert_equal(zzb_mlme_set_short_addr_fake.arg1_val, 0xffff);
}

/* R22 3.6.1.10.1 and 3.6.1.10.4 */
ZTEST(zzb_nwk_leave, test_leave_without_rejoin)
{
	struct net_buf *buf = zzb_buf_alloc(K_NO_WAIT);
	uint32_t fc = child->nwk.fc.value;
	uint8_t seq;

	zassert_not_null(buf);
	net_buf_reserve(buf, ZZB_NLDE_HEADROOM);
	zzb_nwk_ed_timeout_start(child);

	uint8_t rec[64];

	zzb_nwk_save(child);
	zassert_ok(zzb_nlme_leave_req(child, false));
	seq = child->nwk.nib.seq;
	zassert_equal(zzb_nlde_data_req(child, buf, PARENT_SHORT, 0, true), -EBUSY);
	net_buf_unref(buf);

	check_leave(0, 0, ZZB_MAC_STATUS_SUCCESS);
	zassert_equal(zzb_nlme_leave_conf_fake.call_count, 1);
	zassert_equal_ptr(zzb_nlme_leave_conf_fake.arg0_val, child);
	zassert_equal(zzb_nlme_leave_conf_fake.arg1_val, ZZB_MAC_STATUS_SUCCESS);
	check_reset();

	zassert_equal(load_record("nwk/net", rec, sizeof(rec)), 0);
	zassert_equal(load_record("nwk/keys", rec, sizeof(rec)), 0);

	/* The outgoing frame counter survives the leave (R22 4.3.4) */
	zassert_equal(child->nwk.fc.value, fc + 1);
	zassert_equal(child->nwk.nib.seq, seq);
	zassert_equal(zzb_nlme_leave_req(child, false), -ENOTCONN);
}

/* The rejoin that follows needs the network */
ZTEST(zzb_nwk_leave, test_leave_with_rejoin_keeps_the_network)
{
	uint8_t rec[64];

	zzb_nwk_save(child);
	zassert_ok(zzb_nlme_leave_req(child, true));
	check_leave(0, ZZB_NWK_LEAVE_REJOIN, ZZB_MAC_STATUS_NO_ACK);

	zassert_equal(zzb_nlme_leave_conf_fake.call_count, 1);
	zassert_equal(zzb_nlme_leave_conf_fake.arg1_val, ZZB_MAC_STATUS_NO_ACK);
	zassert_equal(child->nwk.nib.ext_pan_id, EXT_PAN_ID);
	zassert_equal(child->nwk.nib.short_addr, CHILD_SHORT);
	zassert_true(child->nwk.nib.keys[0].valid);
	zassert_not_null(zzb_nwk_neighbor_parent(child));
	zassert_equal(load_record("nwk/net", rec, sizeof(rec)), 28);
}

ZTEST(zzb_nwk_leave, test_leave_rejected)
{
	zassert_ok(zzb_nlme_network_discovery_req(child, BIT(15), 0));
	zassert_equal(zzb_nlme_leave_req(child, false), -EBUSY);
	zzb_mlme_scan_conf(child, ZZB_MAC_STATUS_NO_BEACON);

	/* Without a parent, without a network, and without a key */
	zzb_nwk_neighbor_remove(zzb_nwk_neighbor_parent(child));
	zassert_equal(zzb_nlme_leave_req(child, false), -ENOTCONN);

	pair_nodes(child, parent);
	zzb_nlme_set_ext_pan_id(child, 0);
	zassert_equal(zzb_nlme_leave_req(child, false), -ENOTCONN);

	zzb_nwk_init(child);
	zassert_ok(zzb_fc_start(&child->nwk.fc));
	zzb_nlme_set_ext_pan_id(child, EXT_PAN_ID);
	zzb_nlme_set_short_addr(child, CHILD_SHORT);
	zzb_nwk_neighbor_add(child, parent->eui64, PARENT_SHORT, ZZB_NWK_REL_PARENT);
	zassert_equal(zzb_nlme_leave_req(child, false), -ENOENT);

	zassert_equal(zzb_mcps_data_req_fake.call_count, 0);
	zassert_equal(child->nwk.op, ZZB_NWK_OP_NONE);
}

/* BDB 8.2 step 10: a join without the network key ends without a leave command */
ZTEST(zzb_nwk_leave, test_reset)
{
	uint8_t rec[64];

	zzb_nwk_save(child);
	zassert_equal(load_record("nwk/net", rec, sizeof(rec)), 28);
	child->nwk.key_pending = true;
	zzb_nwk_ed_timeout_start(child);

	zassert_ok(zzb_nlme_reset_req(child));
	check_reset();
	zassert_false(child->nwk.key_pending);
	zassert_equal(zzb_mcps_data_req_fake.call_count, 0);
	zassert_equal(load_record("nwk/net", rec, sizeof(rec)), 0);
	zassert_equal(load_record("nwk/keys", rec, sizeof(rec)), 0);

	zassert_ok(zzb_nlme_network_discovery_req(child, BIT(15), 0));
	zassert_equal(zzb_nlme_reset_req(child), -EBUSY);
	zzb_mlme_scan_conf(child, ZZB_MAC_STATUS_NO_BEACON);
}

/* A leave command from node 1 with the MAC and NWK source address of node 1 */
static void receive_leave(uint16_t dst, uint8_t options)
{
	const struct zzb_nwk_hdr hdr = {
		.type = ZZB_NWK_FRAME_CMD,
		.flags = ZZB_NWK_SECURITY | ZZB_NWK_SRC_IEEE,
		.dst = dst,
		.src = parent->nwk.nib.short_addr,
		.radius = 1,
		.src_ext = parent->eui64,
	};
	const struct zzb_nwk_cmd cmd = {
		.id = ZZB_NWK_CMD_LEAVE,
		.leave_options = options,
	};

	receive_cmd(child, parent, &hdr, &cmd);
}

static void check_leave_ind(uint64_t ext_addr, bool rejoin)
{
	zassert_equal(zzb_nlme_leave_ind_fake.call_count, 1);
	zassert_equal_ptr(zzb_nlme_leave_ind_fake.arg0_val, child);
	zassert_equal(zzb_nlme_leave_ind_fake.arg1_val, ext_addr);
	zassert_equal(zzb_nlme_leave_ind_fake.arg2_val, rejoin);
}

/* R22 3.6.1.10.3.1: the node leaves as for NLME-LEAVE.request, then indicates it */
ZTEST(zzb_nwk_leave, test_leave_request_from_the_parent)
{
	receive_leave(CHILD_SHORT, ZZB_NWK_LEAVE_REQUEST | ZZB_NWK_LEAVE_REJOIN);
	check_leave(0, ZZB_NWK_LEAVE_REJOIN, ZZB_MAC_STATUS_SUCCESS);

	check_leave_ind(0, true);
	zassert_equal(zzb_nlme_leave_conf_fake.call_count, 0);
	zassert_equal(child->nwk.nib.ext_pan_id, EXT_PAN_ID);
}

ZTEST(zzb_nwk_leave, test_leave_request_without_rejoin)
{
	receive_leave(CHILD_SHORT, ZZB_NWK_LEAVE_REQUEST);
	check_leave(0, 0, ZZB_MAC_STATUS_NO_ACK);

	check_leave_ind(0, false);
	check_reset();
}

ZTEST(zzb_nwk_leave, test_other_leave_requests_are_dropped)
{
	/* A broadcast, and a request during an NLME procedure */
	receive_leave(0xfffd, ZZB_NWK_LEAVE_REQUEST);
	zassert_ok(zzb_nlme_network_discovery_req(child, BIT(15), 0));
	receive_leave(CHILD_SHORT, ZZB_NWK_LEAVE_REQUEST);
	zzb_mlme_scan_conf(child, ZZB_MAC_STATUS_NO_BEACON);

	/* A MAC source other than the parent */
	parent->nwk.nib.short_addr = 0x2222;
	receive_leave(CHILD_SHORT, ZZB_NWK_LEAVE_REQUEST);

	zassert_equal(zzb_mcps_data_req_fake.call_count, 0);
	zassert_equal(zzb_nlme_leave_ind_fake.call_count, 0);
}

ZTEST(zzb_nwk_leave, test_parent_leaving_with_its_children)
{
	receive_leave(0xfffd, ZZB_NWK_LEAVE_REMOVE_CHILDREN);

	check_leave_ind(0, false);
	check_reset();
	zassert_equal(zzb_mcps_data_req_fake.call_count, 0);
}

/* The node stays on the network, so that BDB rejoins another parent */
ZTEST(zzb_nwk_leave, test_parent_leaving_without_its_children)
{
	receive_leave(0xfffd, ZZB_NWK_LEAVE_REJOIN);

	check_leave_ind(parent->eui64, true);
	zassert_equal(zzb_nlme_nwk_status_ind_fake.call_count, 1);
	zassert_equal(zzb_nlme_nwk_status_ind_fake.arg1_val, 0x09);
	zassert_equal(zzb_nlme_nwk_status_ind_fake.arg2_val, PARENT_SHORT);
	zassert_is_null(zzb_nwk_neighbor_parent(child));
	zassert_equal(child->nwk.nib.ext_pan_id, EXT_PAN_ID);
	zassert_true(child->nwk.nib.keys[0].valid);
}

/* R22 3.6.1.10.3 */
ZTEST(zzb_nwk_leave, test_neighbor_leaving)
{
	zzb_nwk_neighbor_parent(child)->ext_addr = 0x0102030405060708ULL;
	zassert_not_null(zzb_nwk_neighbor_add(child, parent->eui64, 0x2222, ZZB_NWK_REL_SIBLING));
	parent->nwk.nib.short_addr = 0x2222;

	receive_leave(0xfffd, 0);
	check_leave_ind(parent->eui64, false);
	zassert_is_null(zzb_nwk_neighbor_find_ext(child, parent->eui64));
	zassert_not_null(zzb_nwk_neighbor_parent(child));
	zassert_equal(zzb_nlme_nwk_status_ind_fake.call_count, 0);
}

ZTEST_SUITE(zzb_nwk_leave, NULL, setup, before, after, NULL);
```
