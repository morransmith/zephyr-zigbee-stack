## CMakeLists.txt
```
# SPDX-License-Identifier: Apache-2.0

cmake_minimum_required(VERSION 3.20.0)

find_package(Zephyr REQUIRED HINTS $ENV{ZEPHYR_BASE})
project(zzb_build_radio)

target_sources(app PRIVATE src/main.c)
if(CONFIG_ZZB_NWK)
  target_include_directories(app PRIVATE ${ZEPHYR_ZZB_MODULE_DIR}/subsys/zzb)
  target_sources(app PRIVATE src/bdb_stubs.c)
endif()
```

## prj.conf
```kconfig
# SPDX-License-Identifier: Apache-2.0

CONFIG_ZZB=y
# Settings backend for the NWK frame counter
CONFIG_FLASH=y
CONFIG_FLASH_MAP=y
CONFIG_NVS=y
```

## boards/esp32c6_devkitc_esp32c6_hpcore.conf
```kconfig
# SPDX-License-Identifier: Apache-2.0

CONFIG_NETWORKING=y
CONFIG_IEEE802154=y
CONFIG_IEEE802154_RAW_MODE=y
```

## boards/nrf52840dk_nrf52840_custom_l2.conf
```kconfig
# SPDX-License-Identifier: Apache-2.0

CONFIG_NETWORKING=y
CONFIG_NET_L2_CUSTOM_IEEE802154=y
```

## src/aps_stubs.c
```c
/* SPDX-License-Identifier: Apache-2.0 */

/* Stubs of the APS functions NWK calls, until APS defines them */

#include "nwk/nwk.h"

void zzb_nlde_data_conf(struct zzb_node *node, uint8_t handle, enum zzb_mac_status status)
{
}

void zzb_nlde_data_ind(struct zzb_node *node, struct net_buf *buf, uint16_t dst_addr,
		       uint16_t src_addr, bool security_use)
{
	net_buf_unref(buf);
}
```

## src/bdb_stubs.c
```c
/* SPDX-License-Identifier: Apache-2.0 */

/* Stubs of the BDB functions NWK, APS and ZDO call, until BDB defines them */

#include "aps/aps.h"
#include "nwk/nwk.h"
#include "zdo/zdo.h"

void zzb_apsme_confirm_key_ind(struct zzb_node *node, uint8_t status, uint64_t src_addr,
			       enum zzb_aps_key_type type)
{
}

void zzb_zdo_node_desc_conf(struct zzb_node *node, uint8_t status, uint16_t addr,
			    uint16_t server_mask)
{
}
```

## src/mac_stubs.c
```c
/* SPDX-License-Identifier: Apache-2.0 */

/* Stubs of the MAC callbacks until the MAC exists (milestone 6) */

#include "radio/port.h"

void zzb_radio_tx_done(struct zzb_radio_port *port, struct net_buf *buf, enum zzb_mac_status status,
		       bool frame_pending)
{
	net_buf_unref(buf);
}

void zzb_radio_rx(struct zzb_radio_port *port, struct net_buf *buf)
{
	net_buf_unref(buf);
}
```

## src/nwk_stubs.c
```c
/* SPDX-License-Identifier: Apache-2.0 */

/* Stubs of the NWK functions the MAC calls, until NWK defines them */

#include "mac/mac.h"

void zzb_mcps_data_conf(struct zzb_node *node, uint8_t handle, enum zzb_mac_status status)
{
}

void zzb_mcps_data_ind(struct zzb_node *node, struct net_buf *buf)
{
	net_buf_unref(buf);
}

void zzb_mlme_beacon_notify_ind(struct zzb_node *node, struct net_buf *buf, uint8_t channel,
				uint16_t superframe)
{
	net_buf_unref(buf);
}

void zzb_mlme_scan_conf(struct zzb_node *node, enum zzb_mac_status status)
{
}

void zzb_mlme_poll_conf(struct zzb_node *node, enum zzb_mac_status status)
{
}

void zzb_mlme_assoc_conf(struct zzb_node *node, uint16_t short_addr, enum zzb_mac_status status)
{
}
```

## src/raw_mode.c
```c
/* SPDX-License-Identifier: Apache-2.0 */

#include <zephyr/net/ieee802154_radio.h>
#include <zephyr/net/net_pkt.h>

int net_recv_data(struct net_if *iface, struct net_pkt *pkt)
{
	net_pkt_unref(pkt);
	return 0;
}

enum net_verdict ieee802154_handle_ack(struct net_if *iface, struct net_pkt *pkt)
{
	return NET_CONTINUE;
}
```

## src/zdo_stubs.c
```c
/* SPDX-License-Identifier: Apache-2.0 */

/* Stubs of the ZDO functions NWK and APS call, until ZDO defines them */

#include "aps/aps.h"
#include "nwk/nwk.h"

void zzb_nlme_network_discovery_conf(struct zzb_node *node, uint8_t status,
				     const struct zzb_nwk_network *networks, size_t count)
{
}

void zzb_nlme_join_conf(struct zzb_node *node, uint8_t status)
{
}

void zzb_nlme_nwk_status_ind(struct zzb_node *node, uint8_t code, uint16_t addr)
{
}

void zzb_nlme_leave_conf(struct zzb_node *node, uint8_t status)
{
}

void zzb_nlme_leave_ind(struct zzb_node *node, uint64_t ext_addr, bool rejoin)
{
}

void zzb_apsme_transport_key_ind(struct zzb_node *node, uint64_t src_addr,
				 enum zzb_aps_key_type type, const uint8_t *key, uint8_t seq)
{
}

void zzb_apsme_switch_key_ind(struct zzb_node *node, uint64_t src_addr, uint8_t seq)
{
}

void zzb_apsme_confirm_key_ind(struct zzb_node *node, uint8_t status, uint64_t src_addr,
			       enum zzb_aps_key_type type)
{
}
```
