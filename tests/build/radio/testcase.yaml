## tests/glue/custom_l2/testcase.yaml
```yaml
# SPDX-License-Identifier: Apache-2.0

tests:
  zzb.glue.custom_l2:
    platform_allow:
      - native_sim
      - native_sim/native/64
```

## tests/integration/nwk_data/testcase.yaml
```yaml
# SPDX-License-Identifier: Apache-2.0

tests:
  zzb.integration.nwk_data:
    platform_allow:
      - native_sim
      - native_sim/native/64
```

## tests/unit/common/testcase.yaml
```yaml
# SPDX-License-Identifier: Apache-2.0

tests:
  zzb.unit.common:
    platform_allow:
      - native_sim
      - native_sim/native/64
```

## tests/unit/mac/testcase.yaml
```yaml
# SPDX-License-Identifier: Apache-2.0

tests:
  zzb.unit.mac:
    platform_allow:
      - native_sim
      - native_sim/native/64
  zzb.unit.mac.pm:
    platform_allow:
      - native_sim
      - native_sim/native/64
    extra_configs:
      - CONFIG_PM=y
    extra_dtc_overlay_files:
      - pm.overlay
```

## tests/unit/nwk/testcase.yaml
```yaml
# SPDX-License-Identifier: Apache-2.0

tests:
  zzb.unit.nwk:
    platform_allow:
      - native_sim
      - native_sim/native/64
```

## west.yml
```yaml
# SPDX-License-Identifier: Apache-2.0

manifest:
  remotes:
    - name: zephyrproject-rtos
      url-base: https://github.com/zephyrproject-rtos

  projects:
    - name: zephyr
      remote: zephyrproject-rtos
      revision: v4.4.2
      import:
        name-allowlist:
          - cmsis_6
          - hal_nordic
          - hal_espressif
          - mbedtls
          - mcuboot
          - tf-psa-crypto
```
